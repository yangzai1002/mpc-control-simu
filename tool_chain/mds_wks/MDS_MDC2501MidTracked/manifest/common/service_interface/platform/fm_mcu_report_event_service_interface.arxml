AUTOSAR XML (schema 00048)
package /HuaweiMDC/MdcPlatformServices/PlatformServiceInterface/FmMcuReportFaultServiceInterface
  service interface FmMcuReportFaultService
    namespaces:
      symbol props mdc
      symbol props fm
    methods:
      operation McuReportFault: fire-and-forget=false
        arg faultData: type=FmFaultData, direction=IN
        arg result: type=Int32, direction=OUT
  someip service interface deployment FmMcuReportFaultServiceDeployment: service-interface=FmMcuReportFaultService, service-interface-id=1680, service-interface-version={major-version=1, minor-version=0}
    someip method deployment ReportFault_Someip: method=McuReportFault, method-id=1, transport-protocol=UDP
