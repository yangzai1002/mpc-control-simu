AUTOSAR XML (schema 00048)
package /HuaweiMDC/PlatformService
  service interface DiagComNotifier
    namespaces:
      symbol props ara
      symbol props diag
    events:
      data Data: type=ByteVector
  dds service interface deployment DiagComNotifierDeployment: service-interface=DiagComNotifier, service-interface-id=102
    dds event deployment DataDeployment: event=Data, frag-size=2048, list-size=256, topic-name=TopicNameOfDataDeployment, transport-protocols=UDP
