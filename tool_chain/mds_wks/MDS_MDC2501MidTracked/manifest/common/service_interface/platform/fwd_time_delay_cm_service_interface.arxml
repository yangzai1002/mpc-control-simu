AUTOSAR XML (schema 00048)
package /HuaweiMDC/PlatformServiceInterface/TimeDelayDataType
  4 x std cpp implementation data type, all with category=STRUCTURE:
    Header
      namespaces:
        symbol props ara
        symbol props timedelay
      cpp implementation data type element seq: type-reference=UInt32
      cpp implementation data type element stamp: type-reference=Time
      cpp implementation data type element frameId: type-reference=String
    Time
      namespaces:
        symbol props ara
        symbol props timedelay
      cpp implementation data type element sec: type-reference=UInt32
      cpp implementation data type element nsec: type-reference=UInt32
    TimeDelayDataType
      namespaces:
        symbol props ara
        symbol props timedelay
      8 x cpp implementation data type element:
        header: type-reference=Header
        mdcRecvTimePoint: type-reference=TimePoint
        sensorAccessRecvTimePoint: type-reference=TimePoint
        publishTimePoint: type-reference=TimePoint
        driverTimeDelay: type-reference=UInt64
        sensorAccessTimeDelay: type-reference=UInt64
        forwardTimeDelay: type-reference=UInt64
        frameTimeDelay: type-reference=UInt64
    TimePoint
      namespaces:
        symbol props ara
        symbol props timedelay
      cpp implementation data type element sec: type-reference=UInt32
      cpp implementation data type element usec: type-reference=UInt32
package /HuaweiMDC/PlatformServiceInterface/TimeDelayServiceInterface
  dds service interface deployment TimeDelayDeployment: service-interface=TimeDelayServiceInterface, service-interface-id=3587
    dds event deployment TimeDelayDdsEventDeployment: event=mdcEvent, topic-name=TimeDelayDdsEvent, transport-protocols=UDP
  service interface TimeDelayServiceInterface: is-service=true
    namespaces:
      symbol props ara
      symbol props timedelay
    events:
      data mdcEvent: type=TimeDelayDataType
