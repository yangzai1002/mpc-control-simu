AUTOSAR XML (schema 00048)
package /HuaweiMDC/PlatformServiceInterface/PlatformStateAgentServiceInterface
  service interface PlatformStateAgent: is-service=true
    namespaces:
      symbol props ara
      symbol props sm
    events:
      data PlatformStateEvent: type=PlatformStateMsg
    methods:
      operation QueryPlatformState: fire-and-forget=false
        arg platformState: type=uint8_t, direction=OUT
      operation RequestPlatformState: fire-and-forget=false
        arg platformStateIn: type=uint8_t, direction=IN
        arg data: type=Uint32Vector, direction=IN
        arg result: type=uint8_t, direction=OUT
  dds service interface deployment PlatformStateAgentDeployment: service-interface=PlatformStateAgent, service-interface-id=2983
    dds event deployment PlatformStateEventDdsDeployment: event=PlatformStateEvent, topic-name=PlatformStateEventDdsDeployment
    dds method deployment QueryPlatformStateDdsDeployment: method=QueryPlatformState, dds-rpc-service=RpcQueryPlatformStateDdsDeployment
    dds method deployment RequestPlatformStateDdsDeployment: method=RequestPlatformState, dds-rpc-service=RpcRequestPlatformStateDdsDeployment
    dds rpc service deployment RpcQueryPlatformStateDdsDeployment: reply-topic-name=ReplyRpcQueryPlatformStateDdsDeployment, request-topic-name=RequestRpcQueryPlatformStateDdsDeployment
    dds rpc service deployment RpcRequestPlatformStateDdsDeployment: reply-topic-name=ReplyRpcRequestPlatformStateDdsDeployment, request-topic-name=RequestRpcRequestPlatformStateDdsDeployment
package /HuaweiMDC/PlatformServiceInterface/PlatformStateAgentMsgDataTypes/DataTypes
  std cpp implementation data type PlatformStateMsg: category=STRUCTURE
    namespaces:
      symbol props ara
      symbol props sm
    cpp implementation data type element platformState: type-reference=uint8_t
