AUTOSAR XML (schema 00048)
package /HuaweiMDC/FunctionalSoftware/TrafficSignalMsgDataType
  std cpp implementation data type TrafficSignal: category=STRUCTURE
    namespaces:
      symbol props adsfi
    13 x cpp implementation data type element, all with category=TYPE_REFERENCE:
      confidence: type-reference=Double
      id: type-reference=UInt32
      color: type-reference=UInt8
      rect3d: type-reference=Rect3d
      laneId: type-reference=Int32Array
      position: type-reference=Point
      type: type-reference=UInt8
      distance: type-reference=Double
      flash: type-reference=Boolean
      timeTrack: type-reference=Double
      timeFlash: type-reference=Double
      timeV2X: type-reference=Double
      timeCreation: type-reference=CommonTime
  std cpp implementation data type TrafficSignalArray: category=STRUCTURE
    namespaces:
      symbol props adsfi
    cpp implementation data type element header: type-reference=CommonHeader
    cpp implementation data type element tlObject: type-reference=TrafficSignalVector
  std cpp implementation data type TrafficSignalVector: category=VECTOR, cpp-template-argument=TrafficSignal
    namespaces:
      symbol props adsfi
package /HuaweiMDC/FunctionalSoftware/TrafficSignalServiceInterface
  dds service interface deployment TrafficSignalDdsInterfaceDeployment: service-interface=TrafficSignalIntf, frag-size=409600, list-size=20, service-interface-id=3905
    dds event deployment TrafficLightArrayEventDeployment: event=TrafficSignalArray, topic-name=TrafficlightArrayDdsEvent, transport-protocols=UDP
  service interface TrafficSignalIntf
    namespaces:
      symbol props adsfi
    events:
      data TrafficSignalArray: type=TrafficSignalArray
