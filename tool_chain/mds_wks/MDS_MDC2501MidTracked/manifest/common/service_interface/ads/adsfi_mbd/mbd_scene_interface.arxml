AUTOSAR XML (schema 00048)
package /HuaweiMDC/FunctionalSoftware/SceneMsgDataType
  6 x std cpp implementation data type:
    JobVector: category=VECTOR, cpp-template-argument=String
      namespaces:
        symbol props adsfi
    Scene: category=STRUCTURE
      namespaces:
        symbol props adsfi
      cpp implementation data type element targetScene: type-reference=SingleScene
      cpp implementation data type element header: type-reference=CommonHeader
    SceneDag: category=STRUCTURE
      namespaces:
        symbol props adsfi
      cpp implementation data type element id: type-reference=UInt32
      cpp implementation data type element tasks: type-reference=TaskVector
      cpp implementation data type element name: type-reference=String
    SingleScene: category=STRUCTURE
      namespaces:
        symbol props adsfi
      cpp implementation data type element id: type-reference=UInt32
      cpp implementation data type element dag: type-reference=SceneDag
    Task: category=STRUCTURE
      namespaces:
        symbol props adsfi
      cpp implementation data type element name: type-reference=String
      cpp implementation data type element jobList: type-reference=JobVector
    TaskVector: category=VECTOR, cpp-template-argument=Task
      namespaces:
        symbol props adsfi
package /HuaweiMDC/FunctionalSoftware/SceneServiceInterface
  dds service interface deployment SceneDdsInterfaceDeployment: service-interface=SceneIntf, frag-size=409600, list-size=20, service-interface-id=6667
    dds event deployment SceneEventDeployment: event=Scene, frag-size=204800, list-size=20, topic-name=SceneFeatureDdsEvent, transport-protocols=TCP
  service interface SceneIntf: is-service=true
    namespaces:
      symbol props adsfi
    events:
      data Scene: type=Scene
