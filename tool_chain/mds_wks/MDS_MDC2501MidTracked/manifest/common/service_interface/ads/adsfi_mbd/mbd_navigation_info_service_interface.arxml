AUTOSAR XML (schema 00048)
package /HuaweiMDC/FunctionalSoftware/NavigationInfoMsgDataType
  std cpp implementation data type NavigationInfo: category=STRUCTURE
    namespaces:
      symbol props adsfi
    7 x cpp implementation data type element:
      header: type-reference=CommonHeader
      roadPieces: type-reference=RoadPieceVector
      selectPoints: type-reference=NaviRoadPointVector
      mapVersion: type-reference=String
      isReRouted: type-reference=Boolean
      blacklistRoads: type-reference=StringVector
      blacklistLanePieces: type-reference=LanePieceVector
package /HuaweiMDC/FunctionalSoftware/NavigationInfoServiceInterface
  dds service interface deployment NavigationInfoDdsServiceInterfaceDeployment: service-interface=NavigationInfoIntf, frag-size=409600, list-size=20, service-interface-id=4547
    dds event deployment NavigationInfoDdsEventDeployment: event=NavigationInfo, frag-size=204800, list-size=20, topic-name=NavigationInfoDdsEvent, transport-protocols=TCP
  service interface NavigationInfoIntf
    namespaces:
      symbol props adsfi
    events:
      data NavigationInfo: type=NavigationInfo
