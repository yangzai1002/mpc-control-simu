AUTOSAR XML (schema 00048)
package /HuaweiMDC/FunctionalSoftware/TrajPredictMsgDataType
  8 x std cpp implementation data type:
    TrajPredictArray: category=STRUCTURE
      namespaces:
        symbol props adsfi
      7 x cpp implementation data type element, all with category=TYPE_REFERENCE:
        header: type-reference=CommonHeader
        object: type-reference=PredictObjectVector
        startTime: type-reference=CommonTime
        endTime: type-reference=CommonTime
        changeOriginFlag: type-reference=UInt8
        selfIntent: type-reference=UInt8
        scenario: type-reference=UInt16
    TrajInPrediction: category=STRUCTURE
      namespaces:
        symbol props adsfi
      cpp implementation data type element probability: type-reference=Double
      cpp implementation data type element trajectoryPoints: type-reference=TrajPointVector
    TrajPoint: category=STRUCTURE
      namespaces:
        symbol props adsfi
      5 x cpp implementation data type element, all with category=TYPE_REFERENCE:
        pathPoint: type-reference=PathPoint
        speed: type-reference=Double
        velocity: type-reference=Double
        acceleration: type-reference=Double
        relativeTime: type-reference=Double
    TrajPointVector: category=VECTOR, cpp-template-argument=TrajPoint
      namespaces:
        symbol props adsfi
    TrajInPredictionVector: category=VECTOR, cpp-template-argument=TrajInPrediction
      namespaces:
        symbol props adsfi
    PredictObject: category=STRUCTURE
      namespaces:
        symbol props adsfi
      24 x cpp implementation data type element, all with category=TYPE_REFERENCE:
        id: type-reference=UInt32
        position: type-reference=Point
        theta: type-reference=Double
        velocity: type-reference=Point
        hasVelocity: type-reference=Boolean
        size: type-reference=Point
        polygonPoint: type-reference=PointArray
        trackingTime: type-reference=Double
        cls: type-reference=UInt8
        confidence: type-reference=Double
        gpsTime: type-reference=CommonTime
        acceleration: type-reference=Point
        anchorPoint: type-reference=Point
        boundingBox: type-reference=PointArray
        heightAboveGround: type-reference=Double
        positionCovariance: type-reference=Matrix3d
        velocityCovariance: type-reference=Matrix3d
        accelerationCovariance: type-reference=Matrix3d
        lightStatus: type-reference=UInt8
        predictedPeriod: type-reference=Double
        trajectory: type-reference=TrajInPredictionVector
        intent: type-reference=UInt8
        priority: type-reference=UInt8
        isStatic: type-reference=Boolean
    PredictObjectVector: category=VECTOR, cpp-template-argument=PredictObject
      namespaces:
        symbol props adsfi
    PathPoint: category=STRUCTURE
      namespaces:
        symbol props adsfi
      7 x cpp implementation data type element, all with category=TYPE_REFERENCE:
        point: type-reference=Point
        s: type-reference=Double
        theta: type-reference=Double
        kappa: type-reference=Double
        dkappa: type-reference=Double
        heading: type-reference=Double
        ddkappa: type-reference=Double
package /HuaweiMDC/FunctionalSoftware/TrajPredictionServiceInterface
  service interface TrajPredictIntf
    namespaces:
      symbol props adsfi
    events:
      data TrajPredictArray: type=TrajPredictArray
  dds service interface deployment TrajPredictionDdsInterfaceDeployment: service-interface=TrajPredictIntf, frag-size=3200000, list-size=20, service-interface-id=4353
    dds event deployment TrajPredictionEventDeployment: event=TrajPredictArray, topic-name=TrajetoryPredictionDdsEvent, transport-protocols=UDP
