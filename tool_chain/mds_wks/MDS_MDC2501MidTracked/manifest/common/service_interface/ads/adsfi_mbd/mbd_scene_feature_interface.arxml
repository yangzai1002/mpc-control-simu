AUTOSAR XML (schema 00048)
package /HuaweiMDC/FunctionalSoftware/SceneFeatureMsgDataType
  std cpp implementation data type Feature: category=STRUCTURE
    namespaces:
      symbol props adsfi
    cpp implementation data type element id: type-reference=UInt32
    cpp implementation data type element name: type-reference=String
    cpp implementation data type element description: type-reference=String
  std cpp implementation data type FeatureVector: category=VECTOR, cpp-template-argument=Feature
    namespaces:
      symbol props adsfi
  std cpp implementation data type SceneFeature: category=STRUCTURE
    namespaces:
      symbol props adsfi
    cpp implementation data type element defaultFeatures: type-reference=FeatureVector
    cpp implementation data type element header: type-reference=CommonHeader
    cpp implementation data type element customFeatures: type-reference=FeatureVector
package /HuaweiMDC/FunctionalSoftware/SceneFeatureServiceInterface
  dds service interface deployment SceneFeatureDdsInterfaceDeployment: service-interface=SceneFeatureIntf, frag-size=409600, list-size=20, service-interface-id=6666
    dds event deployment SceneFeatureEventDeployment: event=SceneFeature, frag-size=204800, list-size=20, topic-name=SceneFeatureDdsEvent, transport-protocols=TCP
  service interface SceneFeatureIntf: is-service=true
    namespaces:
      symbol props adsfi
    events:
      data SceneFeature: type=SceneFeature
