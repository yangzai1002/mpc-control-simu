AUTOSAR XML (schema 00048)
package /HuaweiMDC/Sotif/CrossValidateArrayMsgDataType
  std cpp implementation data type CrossValidate: category=STRUCTURE
    namespaces:
      symbol props sotif
    8 x cpp implementation data type element:
      timeStampFirst: type-reference=CommonTime
      eventId: type-reference=UInt32
      sensorIdList: type-reference=StringVector
      eventLevel: type-reference=UInt8
      type: type-reference=UInt32
      actionName: type-reference=String
      para: type-reference=FloatArray
      timeStampLast: type-reference=CommonTime
  std cpp implementation data type CrossValidateArray: category=STRUCTURE
    namespaces:
      symbol props sotif
    cpp implementation data type element header: type-reference=CommonHeader
    cpp implementation data type element result: type-reference=CrossValidateVector
  std cpp implementation data type CrossValidateVector: category=VECTOR, cpp-template-argument=CrossValidate
    namespaces:
      symbol props sotif
package /HuaweiMDC/Sotif/CrossValidateArrayServiceInterface
  dds service interface deployment PerceptionSafetyArrayDdsInterfaceDeployment: service-interface=PerceptionSafetyArrayIntf, frag-size=409600, list-size=20, service-interface-id=3901
    dds event deployment PerceptionSafetyArrayEventDeployment: event=PerceptionSafetyArray, topic-name=PerceptionSafetyArrayDdsEvent, transport-protocols=UDP
  service interface CrossValidateArrayIntf
    namespaces:
      symbol props sotif
    events:
      data CrossValidateArray: type=CrossValidateArray
