AUTOSAR XML (schema 00048)
package /HuaweiMDC/Sotif/DecisionSafetyMsgDataType
  std cpp implementation data type DecisionSafety: category=STRUCTURE
    namespaces:
      symbol props sotif
    6 x cpp implementation data type element:
      header: type-reference=CommonHeader
      eventID: type-reference=UInt32
      eventLevel: type-reference=UInt8
      type: type-reference=UInt32
      actionName: type-reference=String
      para: type-reference=FloatArray
package /HuaweiMDC/Sotif/DecistionSafetyServiceInterface
  dds service interface deployment DecisionSafetyDdsInterfaceDeployment: service-interface=DecisionSafetyServiceInterface, frag-size=409600, list-size=20, service-interface-id=4482
    dds event deployment DecisionSafetyEventDeployment: event=DecisionSafetyEvent, frag-size=204800, list-size=20, topic-name=DecisionSafetyDdsEvent, transport-protocols=TCP
  service interface DecisionSafetyServiceInterface
    namespaces:
      symbol props sotif
    events:
      data DecisionSafetyEvent: type=DecisionSafety
