AUTOSAR XML (schema 00048)
package /HuaweiMDC/FunctionalSoftware/LaneLineArrayMsgDataType
  6 x std cpp implementation data type:
    LaneHeader: category=STRUCTURE
      namespaces:
        symbol props ara
        symbol props adsfi
      cpp implementation data type element seq: type-reference=UInt32
      cpp implementation data type element stamp: type-reference=LaneTime
      cpp implementation data type element frameId: type-reference=String
    LaneLine: category=STRUCTURE
      namespaces:
        symbol props ara
        symbol props adsfi
      9 x cpp implementation data type element, all with category=TYPE_REFERENCE:
        id: type-reference=Int32
        header: type-reference=LaneHeader
        classification: type-reference=UInt8
        classification_description: type-reference=String
        classification_confidence: type-reference=Float
        lane_image: type-reference=LaneLineFitParam
        start_point: type-reference=Pointxy
        end_point: type-reference=Pointxy
        point_list: type-reference=PointxyArray
    LaneLineArray: category=STRUCTURE
      namespaces:
        symbol props ara
        symbol props adsfi
      cpp implementation data type element header: type-reference=LaneHeader
      cpp implementation data type element package_type: type-reference=UInt8
      cpp implementation data type element lane_list: type-reference=LaneLineVector
    LaneLineFitParam: category=STRUCTURE
      namespaces:
        symbol props ara
        symbol props adsfi
      4 x cpp implementation data type element, all with category=TYPE_REFERENCE, type-reference=Double:
        a
        b
        c
        d
    LaneLineVector: category=VECTOR, cpp-template-argument=LaneLine
      namespaces:
        symbol props ara
        symbol props adsfi
    LaneTime: category=STRUCTURE
      namespaces:
        symbol props ara
        symbol props adsfi
      cpp implementation data type element sec: type-reference=UInt32
      cpp implementation data type element nsec: type-reference=UInt32
package /HuaweiMDC/FunctionalSoftware/LaneLineArrayServiceInterface
  dds service interface deployment LaneLineArrayDdsInterfaceDeployment: service-interface=LaneLineArrayInterface, frag-size=409600, list-size=20, service-interface-id=3968
    dds event deployment LaneLineArrayEventDeployment: event=LaneLineArrayEvent, frag-size=204800, list-size=20, topic-name=LaneLineArrayDdsEvent, transport-protocols=UDP
  service interface LaneLineArrayInterface
    namespaces:
      symbol props mdc
      symbol props adsfi
    events:
      data LaneLineArrayEvent: type=LaneLineArray
