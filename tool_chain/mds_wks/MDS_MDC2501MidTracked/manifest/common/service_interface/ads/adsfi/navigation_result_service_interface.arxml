AUTOSAR XML (schema 00048)
package /HuaweiMDC/FunctionalSoftware/NavigationResultMsgDataType
  std cpp implementation data type Header: category=STRUCTURE
    namespaces:
      symbol props ara
      symbol props navigation
    cpp implementation data type element seq: type-reference=UInt32
    cpp implementation data type element stamp: type-reference=Time
    cpp implementation data type element frameId: type-reference=String
  std cpp implementation data type NavigationResultStruct: category=STRUCTURE
    namespaces:
      symbol props ara
      symbol props navigation
    7 x cpp implementation data type element:
      header: type-reference=Header
      roadPieces: type-reference=RoadPieceVector
      selectPoints: type-reference=NaviRoadPointVector
      mapVersion: type-reference=String
      isNewRouting: type-reference=bool
      blacklistRoads: type-reference=StringVector
      blacklistLaneSegments: type-reference=LanePieceVector
  std cpp implementation data type Time: category=STRUCTURE
    namespaces:
      symbol props ara
      symbol props navigation
    cpp implementation data type element sec: type-reference=UInt32
    cpp implementation data type element nsec: type-reference=UInt32
package /HuaweiMDC/FunctionalSoftware/NavigationResultServiceInterface
  dds service interface deployment NavigationResultDdsServiceInterfaceDeployment: service-interface=NavigationResultServiceInterface, frag-size=409600, list-size=20, service-interface-id=4545
    dds event deployment NavigationResultDdsEventDeployment: event=NavigationResultEvent, frag-size=204800, list-size=20, topic-name=NavigationResultDdsEvent, transport-protocols=TCP
  service interface NavigationResultServiceInterface
    namespaces:
      symbol props ara: symbol=mdc
      symbol props navigation
    events:
      data NavigationResultEvent: type=NavigationResultStruct
