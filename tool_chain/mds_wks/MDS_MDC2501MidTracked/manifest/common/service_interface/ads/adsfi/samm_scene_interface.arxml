AUTOSAR XML (schema 00048)
package /HuaweiMDC/FunctionalSoftware/SammSceneMsgDataType
  6 x std cpp implementation data type:
    JobVector: category=VECTOR, cpp-template-argument=String
    Scene: category=STRUCTURE
      cpp implementation data type element id: type-reference=UInt32
      cpp implementation data type element sceneDag: type-reference=ScenenDag
    SammScene: category=STRUCTURE
      namespaces:
        symbol props ara
        symbol props samm
      cpp implementation data type element scene: type-reference=Scene
      cpp implementation data type element header: type-reference=Header
    ScenenDag: category=STRUCTURE
      cpp implementation data type element sceneId: type-reference=UInt32
      cpp implementation data type element tasks: type-reference=TaskVector
      cpp implementation data type element sceneName: type-reference=String
    TaskDescription: category=STRUCTURE
      cpp implementation data type element taskName: type-reference=String
      cpp implementation data type element jobList: type-reference=JobVector
    TaskVector: category=VECTOR, cpp-template-argument=TaskDescription
package /HuaweiMDC/FunctionalSoftware/SammSceneServiceInterface
  dds service interface deployment SammSceneDdsInterfaceDeployment: service-interface=SammSceneServiceInterface, frag-size=409600, list-size=20, service-interface-id=6665
    dds event deployment SammSceneEventDeployment: event=SammSceneEvent, frag-size=204800, list-size=20, topic-name=SammFeatureDdsEvent, transport-protocols=TCP
  service interface SammSceneServiceInterface: is-service=true
    namespaces:
      symbol props ara
      symbol props samm
    events:
      data SammSceneEvent: type=SammScene
