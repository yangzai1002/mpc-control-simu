AUTOSAR XML (schema 00048)
package /HuaweiMDC/CommonDataTypes
  std cpp implementation data type CommonHeader: category=STRUCTURE
    namespaces:
      symbol props ara
      symbol props common
    cpp implementation data type element seq: type-reference=UInt32
    cpp implementation data type element stamp: type-reference=CommonTime
    cpp implementation data type element frameId: type-reference=String
  std cpp implementation data type CommonTime: category=STRUCTURE
    namespaces:
      symbol props ara
      symbol props common
    cpp implementation data type element sec: type-reference=UInt32
    cpp implementation data type element nsec: type-reference=UInt32
  std cpp implementation data type IdpAppRemoteControlInAP: category=STRUCTURE
    namespaces:
      symbol props ara
      symbol props common
    11 x cpp implementation data type element, all with type-reference=Double:
      steering_wheel_ap: category=TYPE_REFERENCE
      gear_ap: category=TYPE_REFERENCE
      brake_ap: category=TYPE_REFERENCE
      accelerator_ap: category=TYPE_REFERENCE
      remotectrl_flag_ap: category=TYPE_REFERENCE
      estop_flag_ap: category=TYPE_REFERENCE
      steer_torque_ap
      eng_status_ap
      ctrl_level_ap
      in_place_ap
      tick_ap
