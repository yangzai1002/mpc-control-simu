AUTOSAR XML (schema 00048)
package /HuaweiMDC/ModeDeclaration
  4 x mode declaration group:
    Access: initial-mode=Access/Off
      mode Off
      mode Running
      mode transition OffToRunning: entered-mode=Access/Running, exited-mode=Access/Off
      mode transition RunningToOff: entered-mode=Access/Off, exited-mode=Access/Running
    MachineState: category=FunctionGroup, initial-mode=Startup
      9 x mode:
        Off
        Reset
        Restart: value=2
        Shutdown: value=1
        Standby
        Startup: value=0
        Update
        Verify
        Escape: value=0
      19 x mode transition:
        OffToStartup: entered-mode=Startup, exited-mode=MachineState/Off
        StandbyToShutdown: entered-mode=Shutdown, exited-mode=Standby
        StandbyToStartup: entered-mode=Startup, exited-mode=Standby
        StartupToReset: entered-mode=Reset, exited-mode=Startup
        StartupToRestart: entered-mode=Restart, exited-mode=Startup
        StartupToShutdown: entered-mode=Shutdown, exited-mode=Startup
        StartupToStandby: entered-mode=Standby, exited-mode=Startup
        StartupToUpdate: actions=Update, entered-mode=Update, exited-mode=Startup
        StartupToVerify: entered-mode=Verify, exited-mode=Startup
        UpdateToReset: entered-mode=Reset, exited-mode=Update
        UpdateToStartup: actions=Startup, entered-mode=Startup, exited-mode=Update
        VerifyToRestart: entered-mode=Restart, exited-mode=Verify
        VerifyToStartup: entered-mode=Startup, exited-mode=Verify
        OffToEscape: entered-mode=Escape, exited-mode=MachineState/Off
        EscapeToStartup: entered-mode=Startup, exited-mode=Escape
        StartupToEscape: entered-mode=Escape, exited-mode=Startup
        EscapeToUpdate: entered-mode=Update, exited-mode=Escape
        UpdateToEscape: entered-mode=Escape, exited-mode=Update
        EscapeToReset: entered-mode=Reset, exited-mode=Escape
    ProcessState: category=Process, initial-mode=Idle
      mode Idle
      mode Running
      mode Terminated
    BaseState: category=FunctionGroup, initial-mode=BaseState/Off
      mode Off
      mode Running
      mode transition OffToRunning: entered-mode=BaseState/Running, exited-mode=BaseState/Off
      mode transition RunningToOff: entered-mode=BaseState/Off, exited-mode=BaseState/Running
