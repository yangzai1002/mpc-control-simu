AUTOSAR XML (schema 00048)
package /HuaweiMDC/Ethernet
  ethernet cluster Host0DpEthernetCluster
    ethernet physical channel Host0DpEthernetCommConnector: comm-connectors=Host0DpEthernetCommConnector
      network endpoint Host0DpNetworkEndpoint
        network-endpoint-addresses:
          default-gateway=127.0.0.1, ipv-4-address=192.168.10.6, network-mask=255.255.255.0
          ipv-4-address=239.192.255.123
    ethernet physical channel SocInnerEthernetCommConnector: comm-connectors=SocInnerEthernetCommConnector
      network endpoint SocInnerNetworkEndpoint
        network-endpoint-addresses:
          default-gateway=127.0.0.1, ipv-4-address=127.0.0.1, network-mask=255.255.255.0
          ipv-4-address=239.192.255.123
package /HuaweiMDC/Machine
  machine Host0DpMachine: default-application-timeout={enter-timeout-value=8.0, exit-timeout-value=8.0}, machine-design=Host0DpMachineDesign, trusted-platform-executable-launch-behavior=MONITOR-MODE
    environment-variables:
      key=MACHINE_CONFIG_FILE, value=/opt/usr/app/1/gea/machine/machine_manifest.json
      key=IAM_AM_IDENTITY_CHECK_TYPE, value=aos_ap_access_manager_t
    function-groups:
      10 x mode declaration group prototype:
        Access: type=Access
        MachineState: type=MachineState
        BasicFG: type=BaseState
        LidarTerrainMapFG: type=BaseState
        AdjustFG: type=BaseState
        FollowFG: type=BaseState
        TrackFG: type=BaseState
        ArriveFG: type=BaseState
        ControlFG: type=BaseState
        StitchFG: type=BaseState
    module-instantiations:
      os module instantiation OS
        resource group ResourceLimit
      do ip instantiation IsoDoip: eid=2505430597752, entity-status-max-byte-field-use=true, gid=281474976710655, gid-invalidity-pattern=255, logical-address=4291, max-request-bytes=4194304, vin-invalidity-pattern=255
        do-ip-network-configuration eid-use-mac=true, is-activation-line-dependent=false, max-initial-vehicle-announcement-time=0.5, max-tester-connections=3, network-interface-id=0, tcp-alive-check-response-timeout=0.5, tcp-general-inactivity-time=300.0, tcp-initial-inactivity-time=2.0, vehicle-announcement-count=0, vehicle-announcement-interval=0.1, vehicle-identification-sync-status=false:
          network configuration IsoDoIpEth: communication-connector=Host0DpEthernetCommConnector, ipv-4-multicast-ip-address=239.2.0.1, tcp-port=13400, udp-port=13400
        request-configurations:
          end-address=32767, request-type=PHYSICAL, start-address=4096
          end-address=61439, request-type=FUNCTIONAL, start-address=58368
    processor Cpu
      processor core Processor0_Core0: core-id=0
      processor core Processor0_Core1: core-id=1
  machine design Host0DpMachineDesign
    ethernet communication connector Host0DpEthernetCommConnector: unicast-network-endpoint=Host0DpNetworkEndpoint
    ethernet communication connector SocInnerEthernetCommConnector: unicast-network-endpoint=SocInnerNetworkEndpoint
    service-discover-configs:
      multicast-sd-ip-address=Host0DpNetworkEndpoint, someip-service-discovery-port=30491
      multicast-sd-ip-address=SocInnerNetworkEndpoint, someip-service-discovery-port=30491
package /HuaweiMDC/SomeipSdConfig
  someip sd client event group timing config Host0DpSomeipSdClientEventGroupTimingConfig: request-response-delay={max-value=1.5, min-value=1.5}, time-to-live=10
  someip sd client service instance config Host0DpSomeipSdClientServiceInstanceConfig: initial-find-behavior={initial-delay-max-value=0.1, initial-delay-min-value=0.01, initial-repetitions-base-delay=0.2, initial-repetitions-max=3}, service-find-time-to-live=10
  someip sd server service instance config Host0DpSomeipSdServerServiceInstanceConfig: initial-offer-behavior={initial-delay-max-value=0.1, initial-delay-min-value=0.01, initial-repetitions-base-delay=0.2, initial-repetitions-max=3}, offer-cyclic-delay=2.0, request-response-delay={max-value=1.5, min-value=1.5}, service-offer-time-to-live=10
