AUTOSAR XML (schema 00048)
package /HuaweiMDC/exe_manifests/exes
  executable XFaultHandler: logging-behavior=USES-LOGGING, reporting-behavior=REPORTS-EXECUTION-STATE
    root sw component prototype xfault_handler_baseExecutable43Prototype: application-type=xfault_handler_baseCompositionSwComponentType43
package /HuaweiMDC/Common/Common
  composition sw component type xfault_handler_baseCompositionSwComponentType43
    component xfault_handler_basePrototype: type=xfault_handler_base
