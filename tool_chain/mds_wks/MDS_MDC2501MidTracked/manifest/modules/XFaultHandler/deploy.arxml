AUTOSAR XML (schema 00048)
package /HuaweiMDC/process_manifests/processDesigns
  process design xfault_handler_baseProcessDesign43: executable=XFaultHandler
package /HuaweiMDC/process_manifests/processes
  process xfault_handler_baseProcess43: design=xfault_handler_baseProcessDesign43, executable=XFaultHandler, log-trace-default-log-level=INFO, log-trace-log-modes=NETWORK
package /HuaweiMDC/process_manifests/processToMachineMappingSets
  process to machine mapping set ProcessToMachineMappingSet_xfault_handler_baseProcess43
    process to machine mapping processToMachineMapping42: machine=Host0DpMachine, process=xfault_handler_baseProcess43
package /HuaweiMDC/exe_manifests/InstanceToPortMappings
  service instance to port prototype mapping RPortPrototype2_DdsRequiredServiceInstance154_PortMapping: port-prototype=xfault_handler_baseExecutable43Prototype.tpappremotecmd, process=xfault_handler_baseProcessDesign43, service-instance=RPortPrototype2_DdsRequiredServiceInstance154
  service instance to port prototype mapping tpfault_data_DdsProvidedServiceInstance27_PortMapping: port-prototype=xfault_handler_baseExecutable43Prototype.tpfault_data, process=xfault_handler_baseProcessDesign43, service-instance=tpfault_data_DdsProvidedServiceInstance27
package /HuaweiMDC/instance_manifests/requiredInstances
  dds required service instance RPortPrototype2_DdsRequiredServiceInstance154: service-interface-deployment=RemoteControlServiceInterface_DdsDeployment, qos-profile=default_qos.xml, domain-id=30, transport-plugins=SHM, dds-event-qos-props=EventRCAppRemoteCtlDdsDeployment, required-service-instance-id=20213
package /HuaweiMDC/instance_manifests/instanceToMachineMappings
  dds service instance to machine mapping RPortPrototype2_DdsRequiredServiceInstance154_ToDdsMachineMapping: communication-connector=Host0DpEthernetCommConnector, service-instance=RPortPrototype2_DdsRequiredServiceInstance154
  dds service instance to machine mapping tpfault_data_DdsProvidedServiceInstance27_ToDdsMachineMapping: communication-connector=Host0DpEthernetCommConnector, service-instance=tpfault_data_DdsProvidedServiceInstance27
package /HuaweiMDC/instance_manifests/providedInstances
  dds provided service instance tpfault_data_DdsProvidedServiceInstance27: service-interface-deployment=FaultDataServiceInterface_DdsDeployment, qos-profile=default_qos.xml, domain-id=30, transport-plugins=SHM, dds-event-qos-props=EventFaultDataDdsDeployment, service-instance-id=20220
