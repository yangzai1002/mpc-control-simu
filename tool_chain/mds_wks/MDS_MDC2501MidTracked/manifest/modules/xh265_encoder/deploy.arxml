AUTOSAR XML (schema 00048)
package /HuaweiMDC/process_manifests/processDesigns
  process design Libxh265_encoderProcessDesign19: executable=xh265_encoder
package /HuaweiMDC/process_manifests/processes
  process Libxh265_encoderProcess19: design=Libxh265_encoderProcessDesign19, executable=xh265_encoder, log-trace-default-log-level=INFO, log-trace-log-modes=NETWORK
package /HuaweiMDC/process_manifests/processToMachineMappingSets
  process to machine mapping set LibProcessToMachineMappingSet_xh265_encoderProcess19
    process to machine mapping LibprocessToMachineMapping18: machine=Host0DpMachine, process=Libxh265_encoderProcess19
package /HuaweiMDC/exe_manifests/InstanceToPortMappings
  service instance to port prototype mapping Libvideo_encoded_frame_DdsProvidedServiceInstance49_PortMapping: port-prototype=xh265_encoder_rootswc.video_encoded_frame, process=Libxh265_encoderProcessDesign19, service-instance=Libvideo_encoded_frame_DdsProvidedServiceInstance49
package /HuaweiMDC/instance_manifests/providedInstances
  dds provided service instance Libvideo_encoded_frame_DdsProvidedServiceInstance49: service-interface-deployment=SensorImageServiceInterface_DdsDeployment, qos-profile=default_qos.xml, domain-id=30, transport-plugins=SHM, dds-event-qos-props=EventSensorImageDdsDeployment, service-instance-id=5016
package /HuaweiMDC/instance_manifests/instanceToMachineMappings
  dds service instance to machine mapping Libvideo_encoded_frame_DdsProvidedServiceInstance49_ToDdsMachineMapping: communication-connector=Host0DpEthernetCommConnector, service-instance=Libvideo_encoded_frame_DdsProvidedServiceInstance49
