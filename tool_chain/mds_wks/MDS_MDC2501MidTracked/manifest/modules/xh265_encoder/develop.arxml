AUTOSAR XML (schema 00048)
package /HuaweiMDC/exe_manifests/swcs
  executable xh265_encoder
    root sw component prototype xh265_encoder_rootswc: application-type=xh265_encoder
