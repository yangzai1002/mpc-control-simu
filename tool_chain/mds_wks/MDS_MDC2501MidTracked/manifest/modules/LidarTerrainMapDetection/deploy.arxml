AUTOSAR XML (schema 00048)
package /HuaweiMDC/process_manifests/processDesigns
  process design lidar_terrain_map_detectionProcessDesign29: executable=LidarTerrainMapDetection
package /HuaweiMDC/process_manifests/processes
  process lidar_terrain_map_detectionProcess29: design=lidar_terrain_map_detectionProcessDesign29, executable=LidarTerrainMapDetection, log-trace-default-log-level=INFO, log-trace-log-modes=NETWORK
package /HuaweiMDC/process_manifests/processToMachineMappingSets
  process to machine mapping set ProcessToMachineMappingSet_lidar_terrain_map_detectionProcess29
    process to machine mapping processToMachineMapping28: machine=Host0DpMachine, process=lidar_terrain_map_detectionProcess29
package /HuaweiMDC/exe_manifests/InstanceToPortMappings
  6 x service instance to port prototype mapping, all with process=lidar_terrain_map_detectionProcessDesign29:
    lidarpointsright_DdsRequiredServiceInstance189_PortMapping: port-prototype=lidar_terrain_map_detectionExecutable29Prototype.tpfront_right_lidar_points, service-instance=lidarpointsright_DdsRequiredServiceInstance189
    tpterrainmap_DdsProvidedServiceInstance31_PortMapping: port-prototype=lidar_terrain_map_detectionExecutable29Prototype.tpterrainmap, service-instance=tpterrainmap_DdsProvidedServiceInstance31
    RPortPrototype5_DdsRequiredServiceInstance115_PortMapping: port-prototype=lidar_terrain_map_detectionExecutable29Prototype.tplocalization, service-instance=RPortPrototype5_DdsRequiredServiceInstance115
    RPortPrototype3_DdsRequiredServiceInstance113_PortMapping: port-prototype=lidar_terrain_map_detectionExecutable29Prototype.tpfront_right_lidar_points, service-instance=RPortPrototype3_DdsRequiredServiceInstance113
    RPortPrototype1_DdsRequiredServiceInstance111_PortMapping: port-prototype=lidar_terrain_map_detectionExecutable29Prototype.tpfront_left_lidar_points, service-instance=RPortPrototype1_DdsRequiredServiceInstance111
    RPortPrototype1_DdsRequiredServiceInstance110_PortMapping: port-prototype=lidar_terrain_map_detectionExecutable29Prototype.tpfront_middle_lidar_points, service-instance=RPortPrototype1_DdsRequiredServiceInstance110
package /HuaweiMDC/instance_manifests/requiredInstances
  5 x dds required service instance, all with qos-profile=default_qos.xml, domain-id=30, transport-plugins=SHM:
    lidarpointsright_DdsRequiredServiceInstance189: service-interface-deployment=SensorLidarPointCloudServiceInterface_DdsDeployment, dds-event-qos-props=EventPointCloud2DdsDeployment, required-service-instance-id=20203
    RPortPrototype5_DdsRequiredServiceInstance115: service-interface-deployment=LocationInfoDdsInterfaceDeployment, dds-event-qos-props=LocationInfoEventDeployment, required-service-instance-id=20218
    RPortPrototype3_DdsRequiredServiceInstance113: service-interface-deployment=SensorLidarPointCloudServiceInterface_DdsDeployment, dds-event-qos-props=EventPointCloud2DdsDeployment, required-service-instance-id=20203
    RPortPrototype1_DdsRequiredServiceInstance111: service-interface-deployment=SensorLidarPointCloudServiceInterface_DdsDeployment, dds-event-qos-props=EventPointCloud2DdsDeployment, required-service-instance-id=20202
    RPortPrototype1_DdsRequiredServiceInstance110: service-interface-deployment=SensorLidarPointCloudServiceInterface_DdsDeployment, dds-event-qos-props=EventPointCloud2DdsDeployment, required-service-instance-id=20201
package /HuaweiMDC/instance_manifests/instanceToMachineMappings
  6 x dds service instance to machine mapping, all with communication-connector=Host0DpEthernetCommConnector:
    lidarpointsright_DdsRequiredServiceInstance189_ToDdsMachineMapping: service-instance=lidarpointsright_DdsRequiredServiceInstance189
    tpterrainmap_DdsProvidedServiceInstance31_ToDdsMachineMapping: service-instance=tpterrainmap_DdsProvidedServiceInstance31
    RPortPrototype5_DdsRequiredServiceInstance115_ToDdsMachineMapping: service-instance=RPortPrototype5_DdsRequiredServiceInstance115
    RPortPrototype3_DdsRequiredServiceInstance113_ToDdsMachineMapping: service-instance=RPortPrototype3_DdsRequiredServiceInstance113
    RPortPrototype1_DdsRequiredServiceInstance111_ToDdsMachineMapping: service-instance=RPortPrototype1_DdsRequiredServiceInstance111
    RPortPrototype1_DdsRequiredServiceInstance110_ToDdsMachineMapping: service-instance=RPortPrototype1_DdsRequiredServiceInstance110
package /HuaweiMDC/instance_manifests/providedInstances
  dds provided service instance tpterrainmap_DdsProvidedServiceInstance31: service-interface-deployment=PerceptionStaticEnvServiceInterface_DdsDeployment, qos-profile=default_qos.xml, domain-id=30, transport-plugins=SHM, dds-event-qos-props=EventPerceptionStaticEnvDdsDeployment, service-instance-id=20208
