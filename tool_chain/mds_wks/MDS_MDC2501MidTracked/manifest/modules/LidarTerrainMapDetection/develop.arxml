AUTOSAR XML (schema 00048)
package /HuaweiMDC/exe_manifests/exes
  executable LidarTerrainMapDetection: logging-behavior=USES-LOGGING, reporting-behavior=REPORTS-EXECUTION-STATE
    root sw component prototype lidar_terrain_map_detectionExecutable29Prototype: application-type=lidar_terrain_map_detectionCompositionSwComponentType29
package /HuaweiMDC/Common/Common
  composition sw component type lidar_terrain_map_detectionCompositionSwComponentType29
    component lidar_terrain_map_detectionPrototype: type=lidar_terrain_map_detection
