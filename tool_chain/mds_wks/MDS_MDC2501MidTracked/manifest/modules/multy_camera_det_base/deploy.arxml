AUTOSAR XML (schema 00048)
package /HuaweiMDC/process_manifests/processDesigns
  process design Libmulty_camera_det_baseProcessDesign34: executable=multy_camera_det_base
package /HuaweiMDC/process_manifests/processes
  process Libmulty_camera_det_baseProcess34: design=Libmulty_camera_det_baseProcessDesign34, executable=multy_camera_det_base, log-trace-default-log-level=INFO, log-trace-log-modes=NETWORK
package /HuaweiMDC/process_manifests/processToMachineMappingSets
  process to machine mapping set LibProcessToMachineMappingSet_multy_camera_det_baseProcess34
    process to machine mapping LibprocessToMachineMapping33: machine=Host0DpMachine, process=Libmulty_camera_det_baseProcess34
package /HuaweiMDC/exe_manifests/InstanceToPortMappings
  service instance to port prototype mapping LibRPortPrototype2_DdsRequiredServiceInstance124_PortMapping: port-prototype=multy_camera_det_base_rootswc.tpimage_list, process=Libmulty_camera_det_baseProcessDesign34, service-instance=LibRPortPrototype2_DdsRequiredServiceInstance124
  service instance to port prototype mapping Libtpperception_vp_result_DdsProvidedServiceInstance38_PortMapping: port-prototype=multy_camera_det_base_rootswc.tpperception_vp_result, process=Libmulty_camera_det_baseProcessDesign34, service-instance=Libtpperception_vp_result_DdsProvidedServiceInstance38
package /HuaweiMDC/instance_manifests/requiredInstances
  dds required service instance LibRPortPrototype2_DdsRequiredServiceInstance124: service-interface-deployment=SensorImageListServiceInterface_DdsDeployment, qos-profile=default_qos.xml, domain-id=30, transport-plugins=SHM, dds-event-qos-props=EventImageListDdsDeployment, required-service-instance-id=5123
package /HuaweiMDC/instance_manifests/instanceToMachineMappings
  dds service instance to machine mapping LibRPortPrototype2_DdsRequiredServiceInstance124_ToDdsMachineMapping: communication-connector=Host0DpEthernetCommConnector, service-instance=LibRPortPrototype2_DdsRequiredServiceInstance124
  dds service instance to machine mapping Libtpperception_vp_result_DdsProvidedServiceInstance38_ToDdsMachineMapping: communication-connector=Host0DpEthernetCommConnector, service-instance=Libtpperception_vp_result_DdsProvidedServiceInstance38
package /HuaweiMDC/instance_manifests/providedInstances
  dds provided service instance Libtpperception_vp_result_DdsProvidedServiceInstance38: service-interface-deployment=VisionSegmentServiceInterface_DdsDeployment, qos-profile=default_qos.xml, domain-id=30, transport-plugins=SHM, dds-event-qos-props=EventVisionSegmentDdsDeployment, service-instance-id=5124
