AUTOSAR XML (schema 00048)
package /HuaweiMDC/exe_manifests/swcs
  executable multy_camera_det_base
    root sw component prototype multy_camera_det_base_rootswc: application-type=multy_camera_det_base
