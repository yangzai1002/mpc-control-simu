AUTOSAR XML (schema 00048)
package /HuaweiMDC/exe_manifests/swcs
  executable xvehicle_status_recorder_base
    root sw component prototype xvehicle_status_recorder_base_rootswc: application-type=xvehicle_status_recorder_base
