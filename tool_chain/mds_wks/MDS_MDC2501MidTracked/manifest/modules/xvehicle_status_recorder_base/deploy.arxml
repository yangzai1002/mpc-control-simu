AUTOSAR XML (schema 00048)
package /HuaweiMDC/process_manifests/processDesigns
  process design Libxvehicle_status_recorder_baseProcessDesign47: executable=xvehicle_status_recorder_base
package /HuaweiMDC/process_manifests/processes
  process Libxvehicle_status_recorder_baseProcess47: design=Libxvehicle_status_recorder_baseProcessDesign47, executable=xvehicle_status_recorder_base, log-trace-default-log-level=INFO, log-trace-log-modes=NETWORK
package /HuaweiMDC/process_manifests/processToMachineMappingSets
  process to machine mapping set LibProcessToMachineMappingSet_xvehicle_status_recorder_baseProcess47
    process to machine mapping LibprocessToMachineMapping46: machine=Host0DpMachine, process=Libxvehicle_status_recorder_baseProcess47
package /HuaweiMDC/exe_manifests/InstanceToPortMappings
  7 x service instance to port prototype mapping, all with process=Libxvehicle_status_recorder_baseProcessDesign47:
    LibRPortPrototype8_DdsRequiredServiceInstance162_PortMapping: port-prototype=xvehicle_status_recorder_base_rootswc.ivsensorgps, service-instance=LibRPortPrototype8_DdsRequiredServiceInstance162
    LibRPortPrototype5_DdsRequiredServiceInstance160_PortMapping: port-prototype=xvehicle_status_recorder_base_rootswc.tpvehicle_to_can_pre_aeb, service-instance=LibRPortPrototype5_DdsRequiredServiceInstance160
    LibRPortPrototype6_DdsRequiredServiceInstance161_PortMapping: port-prototype=xvehicle_status_recorder_base_rootswc.tpfusionloc, service-instance=LibRPortPrototype6_DdsRequiredServiceInstance161
    LibRPortPrototype9_DdsRequiredServiceInstance163_PortMapping: port-prototype=xvehicle_status_recorder_base_rootswc.tpvehiclestate, service-instance=LibRPortPrototype9_DdsRequiredServiceInstance163
    LibRPortPrototype11_DdsRequiredServiceInstance171_PortMapping: port-prototype=xvehicle_status_recorder_base_rootswc.image_list, service-instance=LibRPortPrototype11_DdsRequiredServiceInstance171
    LibRPortPrototype10_DdsRequiredServiceInstance164_PortMapping: port-prototype=xvehicle_status_recorder_base_rootswc.tpfault_data, service-instance=LibRPortPrototype10_DdsRequiredServiceInstance164
    LibRPortPrototype1_DdsRequiredServiceInstance156_PortMapping: port-prototype=xvehicle_status_recorder_base_rootswc.tpappremotecmd, service-instance=LibRPortPrototype1_DdsRequiredServiceInstance156
package /HuaweiMDC/instance_manifests/requiredInstances
  7 x dds required service instance, all with qos-profile=default_qos.xml, domain-id=30, transport-plugins=SHM:
    LibRPortPrototype8_DdsRequiredServiceInstance162: service-interface-deployment=SensorGpsServiceInterface_DdsDeployment, dds-event-qos-props=EventGpsDdsDeployment, required-service-instance-id=5099
    LibRPortPrototype5_DdsRequiredServiceInstance160: service-interface-deployment=BodyCommandServiceInterface_DdsDeployment, dds-event-qos-props=EventVehicleActControlDdsDeployment, required-service-instance-id=5100
    LibRPortPrototype6_DdsRequiredServiceInstance161: service-interface-deployment=LocationInfoDdsInterfaceDeployment, dds-event-qos-props=LocationInfoEventDeployment, required-service-instance-id=5101
    LibRPortPrototype9_DdsRequiredServiceInstance163: service-interface-deployment=VehicleInfomationServiceInterface_DdsDeployment, dds-event-qos-props=EventVehicleInfoDdsDeployment, required-service-instance-id=5102
    LibRPortPrototype11_DdsRequiredServiceInstance171: service-interface-deployment=SensorImageListServiceInterface_DdsDeployment, dds-event-qos-props=EventImageListDdsDeployment, required-service-instance-id=5103
    LibRPortPrototype10_DdsRequiredServiceInstance164: service-interface-deployment=FaultDataServiceInterface_DdsDeployment, dds-event-qos-props=EventFaultDataDdsDeployment, required-service-instance-id=5104
    LibRPortPrototype1_DdsRequiredServiceInstance156: service-interface-deployment=RemoteControlServiceInterface_DdsDeployment, dds-event-qos-props=EventRCAppRemoteCtlDdsDeployment, required-service-instance-id=5105
package /HuaweiMDC/instance_manifests/instanceToMachineMappings
  7 x dds service instance to machine mapping, all with communication-connector=Host0DpEthernetCommConnector:
    LibRPortPrototype8_DdsRequiredServiceInstance162_ToDdsMachineMapping: service-instance=LibRPortPrototype8_DdsRequiredServiceInstance162
    LibRPortPrototype5_DdsRequiredServiceInstance160_ToDdsMachineMapping: service-instance=LibRPortPrototype5_DdsRequiredServiceInstance160
    LibRPortPrototype6_DdsRequiredServiceInstance161_ToDdsMachineMapping: service-instance=LibRPortPrototype6_DdsRequiredServiceInstance161
    LibRPortPrototype9_DdsRequiredServiceInstance163_ToDdsMachineMapping: service-instance=LibRPortPrototype9_DdsRequiredServiceInstance163
    LibRPortPrototype11_DdsRequiredServiceInstance171_ToDdsMachineMapping: service-instance=LibRPortPrototype11_DdsRequiredServiceInstance171
    LibRPortPrototype10_DdsRequiredServiceInstance164_ToDdsMachineMapping: service-instance=LibRPortPrototype10_DdsRequiredServiceInstance164
    LibRPortPrototype1_DdsRequiredServiceInstance156_ToDdsMachineMapping: service-instance=LibRPortPrototype1_DdsRequiredServiceInstance156
