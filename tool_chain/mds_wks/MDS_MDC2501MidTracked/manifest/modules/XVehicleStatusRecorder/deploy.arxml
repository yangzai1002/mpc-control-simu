AUTOSAR XML (schema 00048)
package /HuaweiMDC/process_manifests/processDesigns
  process design xvehicle_status_recorder_baseProcessDesign47: executable=XVehicleStatusRecorder
package /HuaweiMDC/process_manifests/processes
  process xvehicle_status_recorder_baseProcess47: design=xvehicle_status_recorder_baseProcessDesign47, executable=XVehicleStatusRecorder, log-trace-default-log-level=INFO, log-trace-log-modes=NETWORK
package /HuaweiMDC/process_manifests/processToMachineMappingSets
  process to machine mapping set ProcessToMachineMappingSet_xvehicle_status_recorder_baseProcess47
    process to machine mapping processToMachineMapping46: machine=Host0DpMachine, process=xvehicle_status_recorder_baseProcess47
package /HuaweiMDC/exe_manifests/InstanceToPortMappings
  7 x service instance to port prototype mapping, all with process=xvehicle_status_recorder_baseProcessDesign47:
    RPortPrototype8_DdsRequiredServiceInstance162_PortMapping: port-prototype=xvehicle_status_recorder_baseExecutable47Prototype.ivsensorgps, service-instance=RPortPrototype8_DdsRequiredServiceInstance162
    RPortPrototype5_DdsRequiredServiceInstance160_PortMapping: port-prototype=xvehicle_status_recorder_baseExecutable47Prototype.tpvehicle_to_can_pre_aeb, service-instance=RPortPrototype5_DdsRequiredServiceInstance160
    RPortPrototype6_DdsRequiredServiceInstance161_PortMapping: port-prototype=xvehicle_status_recorder_baseExecutable47Prototype.tpfusionloc, service-instance=RPortPrototype6_DdsRequiredServiceInstance161
    RPortPrototype9_DdsRequiredServiceInstance163_PortMapping: port-prototype=xvehicle_status_recorder_baseExecutable47Prototype.tpvehiclestate, service-instance=RPortPrototype9_DdsRequiredServiceInstance163
    RPortPrototype11_DdsRequiredServiceInstance171_PortMapping: port-prototype=xvehicle_status_recorder_baseExecutable47Prototype.image_list, service-instance=RPortPrototype11_DdsRequiredServiceInstance171
    RPortPrototype10_DdsRequiredServiceInstance164_PortMapping: port-prototype=xvehicle_status_recorder_baseExecutable47Prototype.tpfault_data, service-instance=RPortPrototype10_DdsRequiredServiceInstance164
    RPortPrototype1_DdsRequiredServiceInstance156_PortMapping: port-prototype=xvehicle_status_recorder_baseExecutable47Prototype.tpappremotecmd, service-instance=RPortPrototype1_DdsRequiredServiceInstance156
package /HuaweiMDC/instance_manifests/requiredInstances
  7 x dds required service instance, all with qos-profile=default_qos.xml, domain-id=30, transport-plugins=SHM:
    RPortPrototype8_DdsRequiredServiceInstance162: service-interface-deployment=SensorGpsServiceInterface_DdsDeployment, dds-event-qos-props=EventGpsDdsDeployment, required-service-instance-id=20244
    RPortPrototype5_DdsRequiredServiceInstance160: service-interface-deployment=BodyCommandServiceInterface_DdsDeployment, dds-event-qos-props=EventVehicleActControlDdsDeployment, required-service-instance-id=20211
    RPortPrototype6_DdsRequiredServiceInstance161: service-interface-deployment=LocationInfoDdsInterfaceDeployment, dds-event-qos-props=LocationInfoEventDeployment, required-service-instance-id=20218
    RPortPrototype9_DdsRequiredServiceInstance163: service-interface-deployment=VehicleInfomationServiceInterface_DdsDeployment, dds-event-qos-props=EventVehicleInfoDdsDeployment, required-service-instance-id=20205
    RPortPrototype11_DdsRequiredServiceInstance171: service-interface-deployment=SensorImageListServiceInterface_DdsDeployment, dds-event-qos-props=EventImageListDdsDeployment, required-service-instance-id=20200
    RPortPrototype10_DdsRequiredServiceInstance164: service-interface-deployment=FaultDataServiceInterface_DdsDeployment, dds-event-qos-props=EventFaultDataDdsDeployment, required-service-instance-id=20220
    RPortPrototype1_DdsRequiredServiceInstance156: service-interface-deployment=RemoteControlServiceInterface_DdsDeployment, dds-event-qos-props=EventRCAppRemoteCtlDdsDeployment, required-service-instance-id=20213
package /HuaweiMDC/instance_manifests/instanceToMachineMappings
  7 x dds service instance to machine mapping, all with communication-connector=Host0DpEthernetCommConnector:
    RPortPrototype8_DdsRequiredServiceInstance162_ToDdsMachineMapping: service-instance=RPortPrototype8_DdsRequiredServiceInstance162
    RPortPrototype5_DdsRequiredServiceInstance160_ToDdsMachineMapping: service-instance=RPortPrototype5_DdsRequiredServiceInstance160
    RPortPrototype6_DdsRequiredServiceInstance161_ToDdsMachineMapping: service-instance=RPortPrototype6_DdsRequiredServiceInstance161
    RPortPrototype9_DdsRequiredServiceInstance163_ToDdsMachineMapping: service-instance=RPortPrototype9_DdsRequiredServiceInstance163
    RPortPrototype11_DdsRequiredServiceInstance171_ToDdsMachineMapping: service-instance=RPortPrototype11_DdsRequiredServiceInstance171
    RPortPrototype10_DdsRequiredServiceInstance164_ToDdsMachineMapping: service-instance=RPortPrototype10_DdsRequiredServiceInstance164
    RPortPrototype1_DdsRequiredServiceInstance156_ToDdsMachineMapping: service-instance=RPortPrototype1_DdsRequiredServiceInstance156
