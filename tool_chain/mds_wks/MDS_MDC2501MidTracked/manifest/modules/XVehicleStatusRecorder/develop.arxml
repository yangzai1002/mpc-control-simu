AUTOSAR XML (schema 00048)
package /HuaweiMDC/exe_manifests/exes
  executable XVehicleStatusRecorder: logging-behavior=USES-LOGGING, reporting-behavior=REPORTS-EXECUTION-STATE
    root sw component prototype xvehicle_status_recorder_baseExecutable47Prototype: application-type=xvehicle_status_recorder_baseCompositionSwComponentType47
package /HuaweiMDC/Common/Common
  composition sw component type xvehicle_status_recorder_baseCompositionSwComponentType47
    component xvehicle_status_recorder_basePrototype: type=xvehicle_status_recorder_base
