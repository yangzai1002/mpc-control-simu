AUTOSAR XML (schema 00048)
package /HuaweiMDC/process_manifests/processDesigns
  process design Libxfault_handler_baseProcessDesign43: executable=xfault_handler_base
package /HuaweiMDC/process_manifests/processes
  process Libxfault_handler_baseProcess43: design=Libxfault_handler_baseProcessDesign43, executable=xfault_handler_base, log-trace-default-log-level=INFO, log-trace-log-modes=NETWORK
package /HuaweiMDC/process_manifests/processToMachineMappingSets
  process to machine mapping set LibProcessToMachineMappingSet_xfault_handler_baseProcess43
    process to machine mapping LibprocessToMachineMapping42: machine=Host0DpMachine, process=Libxfault_handler_baseProcess43
package /HuaweiMDC/exe_manifests/InstanceToPortMappings
  service instance to port prototype mapping LibRPortPrototype2_DdsRequiredServiceInstance154_PortMapping: port-prototype=xfault_handler_base_rootswc.tpappremotecmd, process=Libxfault_handler_baseProcessDesign43, service-instance=LibRPortPrototype2_DdsRequiredServiceInstance154
  service instance to port prototype mapping Libtpfault_data_DdsProvidedServiceInstance27_PortMapping: port-prototype=xfault_handler_base_rootswc.tpfault_data, process=Libxfault_handler_baseProcessDesign43, service-instance=Libtpfault_data_DdsProvidedServiceInstance27
package /HuaweiMDC/instance_manifests/requiredInstances
  dds required service instance LibRPortPrototype2_DdsRequiredServiceInstance154: service-interface-deployment=RemoteControlServiceInterface_DdsDeployment, qos-profile=default_qos.xml, domain-id=30, transport-plugins=SHM, dds-event-qos-props=EventRCAppRemoteCtlDdsDeployment, required-service-instance-id=5019
package /HuaweiMDC/instance_manifests/instanceToMachineMappings
  dds service instance to machine mapping LibRPortPrototype2_DdsRequiredServiceInstance154_ToDdsMachineMapping: communication-connector=Host0DpEthernetCommConnector, service-instance=LibRPortPrototype2_DdsRequiredServiceInstance154
  dds service instance to machine mapping Libtpfault_data_DdsProvidedServiceInstance27_ToDdsMachineMapping: communication-connector=Host0DpEthernetCommConnector, service-instance=Libtpfault_data_DdsProvidedServiceInstance27
package /HuaweiMDC/instance_manifests/providedInstances
  dds provided service instance Libtpfault_data_DdsProvidedServiceInstance27: service-interface-deployment=FaultDataServiceInterface_DdsDeployment, qos-profile=default_qos.xml, domain-id=30, transport-plugins=SHM, dds-event-qos-props=EventFaultDataDdsDeployment, service-instance-id=5020
