AUTOSAR XML (schema 00048)
package /HuaweiMDC/exe_manifests/swcs
  executable xfault_handler_base
    root sw component prototype xfault_handler_base_rootswc: application-type=xfault_handler_base
