AUTOSAR XML (schema 00048)
package /HuaweiMDC/process_manifests/processDesigns
  process design bd21_imuProcessDesign6: executable=BD21Imu
package /HuaweiMDC/process_manifests/processes
  process bd21_imuProcess6: design=bd21_imuProcessDesign6, executable=BD21Imu, log-trace-default-log-level=INFO, log-trace-log-modes=NETWORK
package /HuaweiMDC/process_manifests/processToMachineMappingSets
  process to machine mapping set ProcessToMachineMappingSet_bd21_imuProcess6
    process to machine mapping processToMachineMapping5: machine=Host0DpMachine, process=bd21_imuProcess6
package /HuaweiMDC/exe_manifests/InstanceToPortMappings
  4 x service instance to port prototype mapping, all with process=bd21_imuProcessDesign6:
    ivsensorgps_DdsProvidedServiceInstance45_PortMapping: port-prototype=bd21_imuExecutable6Prototype.ivsensorgps, service-instance=ivsensorgps_DdsProvidedServiceInstance45
    ImuPPortPrototype_DdsProvidedServiceInstance25_PortMapping: port-prototype=bd21_imuExecutable6Prototype.ivsensorimu, service-instance=ImuPPortPrototype_DdsProvidedServiceInstance25
    WheelSpeedPPortPrototype_DdsProvidedServiceInstance23_PortMapping: port-prototype=bd21_imuExecutable6Prototype.ivwheelspeed, service-instance=WheelSpeedPPortPrototype_DdsProvidedServiceInstance23
    tpimu_DdsProvidedServiceInstance30_PortMapping: port-prototype=bd21_imuExecutable6Prototype.tpimu, service-instance=tpimu_DdsProvidedServiceInstance30
package /HuaweiMDC/instance_manifests/providedInstances
  4 x dds provided service instance, all with qos-profile=default_qos.xml, domain-id=30, transport-plugins=SHM:
    ivsensorgps_DdsProvidedServiceInstance45: service-interface-deployment=SensorGpsServiceInterface_DdsDeployment, dds-event-qos-props=EventGpsDdsDeployment, service-instance-id=20244
    ImuPPortPrototype_DdsProvidedServiceInstance25: service-interface-deployment=SensorImuServiceInterface_DdsDeployment, dds-event-qos-props=EventSensorImuDdsDeployment, service-instance-id=20223
    WheelSpeedPPortPrototype_DdsProvidedServiceInstance23: service-interface-deployment=SensorWheelSpeedServiceInterface_DdsDeployment, dds-event-qos-props=EventWheelSpeedDdsDeployment, service-instance-id=20204
    tpimu_DdsProvidedServiceInstance30: service-interface-deployment=LocationDdsInterfaceDeployment, dds-event-qos-props=LocationEventDeployment, service-instance-id=20229
package /HuaweiMDC/instance_manifests/instanceToMachineMappings
  4 x dds service instance to machine mapping, all with communication-connector=Host0DpEthernetCommConnector:
    ivsensorgps_DdsProvidedServiceInstance45_ToDdsMachineMapping: service-instance=ivsensorgps_DdsProvidedServiceInstance45
    ImuPPortPrototype_DdsProvidedServiceInstance25_ToDdsMachineMapping: service-instance=ImuPPortPrototype_DdsProvidedServiceInstance25
    WheelSpeedPPortPrototype_DdsProvidedServiceInstance23_ToDdsMachineMapping: service-instance=WheelSpeedPPortPrototype_DdsProvidedServiceInstance23
    tpimu_DdsProvidedServiceInstance30_ToDdsMachineMapping: service-instance=tpimu_DdsProvidedServiceInstance30
