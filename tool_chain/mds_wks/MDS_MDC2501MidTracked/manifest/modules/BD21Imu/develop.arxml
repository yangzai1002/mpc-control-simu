AUTOSAR XML (schema 00048)
package /HuaweiMDC/exe_manifests/exes
  executable BD21Imu: logging-behavior=USES-LOGGING, reporting-behavior=REPORTS-EXECUTION-STATE
    root sw component prototype bd21_imuExecutable6Prototype: application-type=bd21_imuCompositionSwComponentType6
package /HuaweiMDC/Common/Common
  composition sw component type bd21_imuCompositionSwComponentType6
    component bd21_imuPrototype: type=bd21_imu
