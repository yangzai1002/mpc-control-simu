AUTOSAR XML (schema 00048)
package /HuaweiMDC/process_manifests/processDesigns
  process design hw_fr671_radarProcessDesign21: executable=HwFr671RadarLeft
package /HuaweiMDC/process_manifests/processes
  process hw_fr671_radarProcess21: design=hw_fr671_radarProcessDesign21, executable=HwFr671RadarLeft, log-trace-default-log-level=INFO, log-trace-log-modes=NETWORK
package /HuaweiMDC/process_manifests/processToMachineMappingSets
  process to machine mapping set ProcessToMachineMappingSet_hw_fr671_radarProcess21
    process to machine mapping processToMachineMapping20: machine=Host0DpMachine, process=hw_fr671_radarProcess21
package /HuaweiMDC/exe_manifests/InstanceToPortMappings
  4 x service instance to port prototype mapping, all with process=hw_fr671_radarProcessDesign21:
    RPortPrototype3_DdsRequiredServiceInstance202_PortMapping: port-prototype=hw_fr671_radarExecutable21Prototype.tpvehiclestate3, service-instance=RPortPrototype3_DdsRequiredServiceInstance202
    radarpackets_DdsProvidedServiceInstance43_PortMapping: port-prototype=hw_fr671_radarExecutable21Prototype.radarpackets, service-instance=radarpackets_DdsProvidedServiceInstance43
    RPortPrototype6_DdsRequiredServiceInstance109_PortMapping: port-prototype=hw_fr671_radarExecutable21Prototype.tpimu3, service-instance=RPortPrototype6_DdsRequiredServiceInstance109
    RadarPointCloudPPortPrototype_DdsProvidedServiceInstance42_PortMapping: port-prototype=hw_fr671_radarExecutable21Prototype.radarpoints, service-instance=RadarPointCloudPPortPrototype_DdsProvidedServiceInstance42
package /HuaweiMDC/instance_manifests/requiredInstances
  dds required service instance RPortPrototype3_DdsRequiredServiceInstance202: service-interface-deployment=VehicleInfomationServiceInterface_DdsDeployment, qos-profile=default_qos.xml, domain-id=30, transport-plugins=SHM, dds-event-qos-props=EventVehicleInfoDdsDeployment, required-service-instance-id=20205
  dds required service instance RPortPrototype6_DdsRequiredServiceInstance109: service-interface-deployment=LocationDdsInterfaceDeployment, qos-profile=default_qos.xml, domain-id=30, transport-plugins=SHM, dds-event-qos-props=LocationEventDeployment, required-service-instance-id=20229
package /HuaweiMDC/instance_manifests/instanceToMachineMappings
  4 x dds service instance to machine mapping, all with communication-connector=Host0DpEthernetCommConnector:
    RPortPrototype3_DdsRequiredServiceInstance202_ToDdsMachineMapping: service-instance=RPortPrototype3_DdsRequiredServiceInstance202
    radarpackets_DdsProvidedServiceInstance43_ToDdsMachineMapping: service-instance=radarpackets_DdsProvidedServiceInstance43
    RPortPrototype6_DdsRequiredServiceInstance109_ToDdsMachineMapping: service-instance=RPortPrototype6_DdsRequiredServiceInstance109
    RadarPointCloudPPortPrototype_DdsProvidedServiceInstance42_ToDdsMachineMapping: service-instance=RadarPointCloudPPortPrototype_DdsProvidedServiceInstance42
package /HuaweiMDC/instance_manifests/providedInstances
  dds provided service instance radarpackets_DdsProvidedServiceInstance43: service-interface-deployment=SensorRadarPacketServiceInterface_DdsDeployment, qos-profile=default_qos.xml, domain-id=30, transport-plugins=SHM, dds-event-qos-props=EventSensorRadarPacketDdsDeployment, service-instance-id=20227
  dds provided service instance RadarPointCloudPPortPrototype_DdsProvidedServiceInstance42: service-interface-deployment=RadarPointCloudServiceInterface_DdsDeployment, qos-profile=default_qos.xml, domain-id=30, transport-plugins=SHM, dds-event-qos-props=EventRadarPointCloudDdsDeployment, service-instance-id=20226
