AUTOSAR XML (schema 00048)
package /HuaweiMDC/process_manifests/processDesigns
  process design hw_l106_lidarProcessDesign3: executable=HwL106LidarFront
package /HuaweiMDC/process_manifests/processes
  process hw_l106_lidarProcess3: design=hw_l106_lidarProcessDesign3, executable=HwL106LidarFront, log-trace-default-log-level=INFO, log-trace-log-modes=NETWORK
package /HuaweiMDC/process_manifests/processToMachineMappingSets
  process to machine mapping set ProcessToMachineMappingSet_hw_l106_lidarProcess3
    process to machine mapping processToMachineMapping2: machine=Host0DpMachine, process=hw_l106_lidarProcess3
package /HuaweiMDC/exe_manifests/InstanceToPortMappings
  service instance to port prototype mapping lidarpackets_DdsProvidedServiceInstance47_PortMapping: port-prototype=hw_l106_lidarExecutable3Prototype.lidarpackets, process=hw_l106_lidarProcessDesign3, service-instance=lidarpackets_DdsProvidedServiceInstance47
  service instance to port prototype mapping PointCloudPPortPrototype_DdsProvidedServiceInstance2_PortMapping: port-prototype=hw_l106_lidarExecutable3Prototype.lidarpoints, process=hw_l106_lidarProcessDesign3, service-instance=PointCloudPPortPrototype_DdsProvidedServiceInstance2
package /HuaweiMDC/instance_manifests/providedInstances
  dds provided service instance lidarpackets_DdsProvidedServiceInstance47: service-interface-deployment=SensorLidarPacketServiceInterface_DdsDeployment, qos-profile=default_qos.xml, domain-id=30, transport-plugins=SHM, dds-event-qos-props=EventLidarPacketDdsDeployment, service-instance-id=20234
  dds provided service instance PointCloudPPortPrototype_DdsProvidedServiceInstance2: service-interface-deployment=SensorLidarPointCloudServiceInterface_DdsDeployment, qos-profile=default_qos.xml, domain-id=30, transport-plugins=SHM, dds-event-qos-props=EventPointCloud2DdsDeployment, service-instance-id=20201
package /HuaweiMDC/instance_manifests/instanceToMachineMappings
  dds service instance to machine mapping lidarpackets_DdsProvidedServiceInstance47_ToDdsMachineMapping: communication-connector=Host0DpEthernetCommConnector, service-instance=lidarpackets_DdsProvidedServiceInstance47
  dds service instance to machine mapping PointCloudPPortPrototype_DdsProvidedServiceInstance2_ToDdsMachineMapping: communication-connector=Host0DpEthernetCommConnector, service-instance=PointCloudPPortPrototype_DdsProvidedServiceInstance2
