AUTOSAR XML (schema 00048)
package /HuaweiMDC/exe_manifests/exes
  executable HwL106LidarFront: logging-behavior=USES-LOGGING, reporting-behavior=REPORTS-EXECUTION-STATE
    root sw component prototype hw_l106_lidarExecutable3Prototype: application-type=hw_l106_lidarCompositionSwComponentType3
package /HuaweiMDC/Common/Common
  composition sw component type hw_l106_lidarCompositionSwComponentType3
    component hw_l106_lidarPrototype: type=hw_l106_lidar
