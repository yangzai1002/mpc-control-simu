AUTOSAR XML (schema 00048)
package /HuaweiMDC/process_manifests/processDesigns
  process design LidarDetectionProcessDesign28: executable=LidarDetection
package /HuaweiMDC/process_manifests/processes
  process LidarDetectionProcess28: design=LidarDetectionProcessDesign28, executable=LidarDetection, log-trace-default-log-level=INFO, log-trace-log-modes=NETWORK
package /HuaweiMDC/process_manifests/processToMachineMappingSets
  process to machine mapping set ProcessToMachineMappingSet_LidarDetectionProcess28
    process to machine mapping processToMachineMapping27: machine=Host0DpMachine, process=LidarDetectionProcess28
package /HuaweiMDC/exe_manifests/InstanceToPortMappings
  service instance to port prototype mapping tplidarobjects_DdsProvidedServiceInstance39_PortMapping: port-prototype=LidarDetectionExecutable28Prototype.tplidarobjects, process=LidarDetectionProcessDesign28, service-instance=tplidarobjects_DdsProvidedServiceInstance39
  service instance to port prototype mapping RPortPrototype1_DdsRequiredServiceInstance53_PortMapping: port-prototype=LidarDetectionExecutable28Prototype.tpfront_middle_lidar_points, process=LidarDetectionProcessDesign28, service-instance=RPortPrototype1_DdsRequiredServiceInstance53
package /HuaweiMDC/instance_manifests/providedInstances
  dds provided service instance tplidarobjects_DdsProvidedServiceInstance39: service-interface-deployment=Object3dArrayDdsInterfaceDeployment, qos-profile=default_qos.xml, domain-id=30, transport-plugins=SHM, dds-event-qos-props=Object3dArrayEventDeployment, service-instance-id=20222
package /HuaweiMDC/instance_manifests/instanceToMachineMappings
  dds service instance to machine mapping tplidarobjects_DdsProvidedServiceInstance39_ToDdsMachineMapping: communication-connector=Host0DpEthernetCommConnector, service-instance=tplidarobjects_DdsProvidedServiceInstance39
  dds service instance to machine mapping RPortPrototype1_DdsRequiredServiceInstance53_ToDdsMachineMapping: communication-connector=Host0DpEthernetCommConnector, service-instance=RPortPrototype1_DdsRequiredServiceInstance53
package /HuaweiMDC/instance_manifests/requiredInstances
  dds required service instance RPortPrototype1_DdsRequiredServiceInstance53: service-interface-deployment=SensorLidarPointCloudServiceInterface_DdsDeployment, qos-profile=default_qos.xml, domain-id=30, transport-plugins=SHM, dds-event-qos-props=EventPointCloud2DdsDeployment, required-service-instance-id=20201
