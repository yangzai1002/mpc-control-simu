AUTOSAR XML (schema 00048)
package /HuaweiMDC/exe_manifests/exes
  executable LidarDetection: logging-behavior=USES-LOGGING, reporting-behavior=REPORTS-EXECUTION-STATE
    root sw component prototype LidarDetectionExecutable28Prototype: application-type=LidarDetectionCompositionSwComponentType28
package /HuaweiMDC/Common/Common
  composition sw component type LidarDetectionCompositionSwComponentType28
    component LidarDetectionPrototype: type=lidar_det_base
