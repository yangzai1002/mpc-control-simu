AUTOSAR XML (schema 00048)
package /HuaweiMDC/process_manifests/processDesigns
  process design Libfusion_follow_baseProcessDesign30: executable=fusion_follow_base
package /HuaweiMDC/process_manifests/processes
  process Libfusion_follow_baseProcess30: design=Libfusion_follow_baseProcessDesign30, executable=fusion_follow_base, log-trace-default-log-level=INFO, log-trace-log-modes=NETWORK
package /HuaweiMDC/process_manifests/processToMachineMappingSets
  process to machine mapping set LibProcessToMachineMappingSet_fusion_follow_baseProcess30
    process to machine mapping LibprocessToMachineMapping29: machine=Host0DpMachine, process=Libfusion_follow_baseProcess30
package /HuaweiMDC/exe_manifests/InstanceToPortMappings
  25 x service instance to port prototype mapping, all with process=Libfusion_follow_baseProcessDesign30:
    Libradarpointsfront_DdsRequiredServiceInstance195_PortMapping: port-prototype=fusion_follow_base_rootswc.tpfront_middle_radar_points, service-instance=Libradarpointsfront_DdsRequiredServiceInstance195
    LibRPortPrototype1_DdsRequiredServiceInstance125_PortMapping: port-prototype=fusion_follow_base_rootswc.tpperception_vp_result, service-instance=LibRPortPrototype1_DdsRequiredServiceInstance125
    LibRPortPrototype6_DdsRequiredServiceInstance118_flidarPortMapping: port-prototype=fusion_follow_base_rootswc.tpfront_right_lidar_points, service-instance=LibRPortPrototype6_DdsRequiredServiceInstance118_flidar
    LibRPortPrototype9_DdsRequiredServiceInstance121_PortMapping: port-prototype=fusion_follow_base_rootswc.tpfront_right_radar_points, service-instance=LibRPortPrototype9_DdsRequiredServiceInstance121
    Libradarpointsleft_DdsRequiredServiceInstance182_PortMapping: port-prototype=fusion_follow_base_rootswc.tpfront_left_radar_points, service-instance=Libradarpointsleft_DdsRequiredServiceInstance182
    Libtptarget_obj_DdsProvidedServiceInstance38_PortMapping: port-prototype=fusion_follow_base_rootswc.tptarget_obj, service-instance=Libtptarget_obj_DdsProvidedServiceInstance38
    Libradarpointsfront_DdsRequiredServiceInstance191_PortMapping: port-prototype=fusion_follow_base_rootswc.tpfront_middle_radar_points, service-instance=Libradarpointsfront_DdsRequiredServiceInstance191
    Libradarpointsright_DdsRequiredServiceInstance194_PortMapping: port-prototype=fusion_follow_base_rootswc.tpfront_right_radar_points, service-instance=Libradarpointsright_DdsRequiredServiceInstance194
    Libradarpointsleft_DdsRequiredServiceInstance196_PortMapping: port-prototype=fusion_follow_base_rootswc.tpfront_left_radar_points, service-instance=Libradarpointsleft_DdsRequiredServiceInstance196
    Liblidarpointsright_DdsRequiredServiceInstance180_PortMapping: port-prototype=fusion_follow_base_rootswc.tpfront_right_lidar_points, service-instance=Liblidarpointsright_DdsRequiredServiceInstance180
    Liblidarpointsleft_DdsRequiredServiceInstance179_PortMapping: port-prototype=fusion_follow_base_rootswc.tpfront_left_lidar_points, service-instance=Liblidarpointsleft_DdsRequiredServiceInstance179
    Liblidarpointsfront_DdsRequiredServiceInstance178_PortMapping: port-prototype=fusion_follow_base_rootswc.tpfront_middle_lidar_points, service-instance=Liblidarpointsfront_DdsRequiredServiceInstance178
    LibRPortPrototype4_DdsRequiredServiceInstance175_PortMapping: port-prototype=fusion_follow_base_rootswc.tpfront_middle_lidar_points, service-instance=LibRPortPrototype4_DdsRequiredServiceInstance175
    Libradarpointsfront_DdsRequiredServiceInstance181_PortMapping: port-prototype=fusion_follow_base_rootswc.tpfront_middle_radar_points, service-instance=Libradarpointsfront_DdsRequiredServiceInstance181
    Libradarpointsright_DdsRequiredServiceInstance183_PortMapping: port-prototype=fusion_follow_base_rootswc.tpfront_right_radar_points, service-instance=Libradarpointsright_DdsRequiredServiceInstance183
    LibRPortPrototype6_DdsRequiredServiceInstance177_PortMapping: port-prototype=fusion_follow_base_rootswc.tpfront_right_lidar_points, service-instance=LibRPortPrototype6_DdsRequiredServiceInstance177
    LibRPortPrototype1_DdsRequiredServiceInstance211_PortMapping: port-prototype=fusion_follow_base_rootswc.tplidarobjects, service-instance=LibRPortPrototype1_DdsRequiredServiceInstance211
    LibRPortPrototype4_DdsRequiredServiceInstance116_flidar_PortMapping: port-prototype=fusion_follow_base_rootswc.tpfront_middle_lidar_points, service-instance=LibRPortPrototype4_DdsRequiredServiceInstance116_flidar
    Libradarpointsfront_DdsRequiredServiceInstance190_PortMapping: port-prototype=fusion_follow_base_rootswc.tpfront_middle_radar_points, service-instance=Libradarpointsfront_DdsRequiredServiceInstance190
    Libradarpointsright_DdsRequiredServiceInstance192_PortMapping: port-prototype=fusion_follow_base_rootswc.tpfront_right_radar_points, service-instance=Libradarpointsright_DdsRequiredServiceInstance192
    LibRPortPrototype7_DdsRequiredServiceInstance119_fradar_PortMapping: port-prototype=fusion_follow_base_rootswc.tpfront_middle_radar_points, service-instance=LibRPortPrototype7_DdsRequiredServiceInstance119_fradar
    LibRPortPrototype10_DdsRequiredServiceInstance122_PortMapping: port-prototype=fusion_follow_base_rootswc.tplocalization, service-instance=LibRPortPrototype10_DdsRequiredServiceInstance122
    LibRPortPrototype5_DdsRequiredServiceInstance176_PortMapping: port-prototype=fusion_follow_base_rootswc.tpfront_left_lidar_points, service-instance=LibRPortPrototype5_DdsRequiredServiceInstance176
    LibRPortPrototype8_DdsRequiredServiceInstance120_lradarPortMapping: port-prototype=fusion_follow_base_rootswc.tpfront_left_radar_points, service-instance=LibRPortPrototype8_DdsRequiredServiceInstance120_lradar
    Libradarpointsleft_DdsRequiredServiceInstance193_PortMapping: port-prototype=fusion_follow_base_rootswc.tpfront_left_radar_points, service-instance=Libradarpointsleft_DdsRequiredServiceInstance193
package /HuaweiMDC/instance_manifests/requiredInstances
  24 x dds required service instance, all with qos-profile=default_qos.xml, domain-id=30, transport-plugins=SHM:
    Libradarpointsfront_DdsRequiredServiceInstance195: service-interface-deployment=RadarPointCloudServiceInterface_DdsDeployment, dds-event-qos-props=EventRadarPointCloudDdsDeployment, required-service-instance-id=5021
    LibRPortPrototype1_DdsRequiredServiceInstance125: service-interface-deployment=VisionSegmentServiceInterface_DdsDeployment, dds-event-qos-props=EventVisionSegmentDdsDeployment, required-service-instance-id=5022
    LibRPortPrototype6_DdsRequiredServiceInstance118_flidar: service-interface-deployment=SensorLidarPointCloudServiceInterface_DdsDeployment, dds-event-qos-props=EventPointCloud2DdsDeployment, required-service-instance-id=5023
    LibRPortPrototype9_DdsRequiredServiceInstance121: service-interface-deployment=RadarPointCloudServiceInterface_DdsDeployment, dds-event-qos-props=EventRadarPointCloudDdsDeployment, required-service-instance-id=5024
    Libradarpointsleft_DdsRequiredServiceInstance182: service-interface-deployment=RadarPointCloudServiceInterface_DdsDeployment, dds-event-qos-props=EventRadarPointCloudDdsDeployment, required-service-instance-id=5025
    Libradarpointsfront_DdsRequiredServiceInstance191: service-interface-deployment=RadarPointCloudServiceInterface_DdsDeployment, dds-event-qos-props=EventRadarPointCloudDdsDeployment, required-service-instance-id=5027
    Libradarpointsright_DdsRequiredServiceInstance194: service-interface-deployment=RadarPointCloudServiceInterface_DdsDeployment, dds-event-qos-props=EventRadarPointCloudDdsDeployment, required-service-instance-id=5028
    Libradarpointsleft_DdsRequiredServiceInstance196: service-interface-deployment=RadarPointCloudServiceInterface_DdsDeployment, dds-event-qos-props=EventRadarPointCloudDdsDeployment, required-service-instance-id=5029
    Liblidarpointsright_DdsRequiredServiceInstance180: service-interface-deployment=SensorLidarPointCloudServiceInterface_DdsDeployment, dds-event-qos-props=EventPointCloud2DdsDeployment, required-service-instance-id=5030
    Liblidarpointsleft_DdsRequiredServiceInstance179: service-interface-deployment=SensorLidarPointCloudServiceInterface_DdsDeployment, dds-event-qos-props=EventPointCloud2DdsDeployment, required-service-instance-id=5031
    Liblidarpointsfront_DdsRequiredServiceInstance178: service-interface-deployment=SensorLidarPointCloudServiceInterface_DdsDeployment, dds-event-qos-props=EventPointCloud2DdsDeployment, required-service-instance-id=5032
    LibRPortPrototype4_DdsRequiredServiceInstance175: service-interface-deployment=SensorLidarPointCloudServiceInterface_DdsDeployment, dds-event-qos-props=EventPointCloud2DdsDeployment, required-service-instance-id=5033
    Libradarpointsfront_DdsRequiredServiceInstance181: service-interface-deployment=RadarPointCloudServiceInterface_DdsDeployment, dds-event-qos-props=EventRadarPointCloudDdsDeployment, required-service-instance-id=5034
    Libradarpointsright_DdsRequiredServiceInstance183: service-interface-deployment=RadarPointCloudServiceInterface_DdsDeployment, dds-event-qos-props=EventRadarPointCloudDdsDeployment, required-service-instance-id=5035
    LibRPortPrototype6_DdsRequiredServiceInstance177: service-interface-deployment=SensorLidarPointCloudServiceInterface_DdsDeployment, dds-event-qos-props=EventPointCloud2DdsDeployment, required-service-instance-id=5036
    LibRPortPrototype1_DdsRequiredServiceInstance211: service-interface-deployment=Object3dArrayDdsInterfaceDeployment, dds-event-qos-props=Object3dArrayEventDeployment, required-service-instance-id=5037
    LibRPortPrototype4_DdsRequiredServiceInstance116_flidar: service-interface-deployment=SensorLidarPointCloudServiceInterface_DdsDeployment, dds-event-qos-props=EventPointCloud2DdsDeployment, required-service-instance-id=5038
    Libradarpointsfront_DdsRequiredServiceInstance190: service-interface-deployment=RadarPointCloudServiceInterface_DdsDeployment, dds-event-qos-props=EventRadarPointCloudDdsDeployment, required-service-instance-id=5039
    Libradarpointsright_DdsRequiredServiceInstance192: service-interface-deployment=RadarPointCloudServiceInterface_DdsDeployment, dds-event-qos-props=EventRadarPointCloudDdsDeployment, required-service-instance-id=5040
    LibRPortPrototype7_DdsRequiredServiceInstance119_fradar: service-interface-deployment=RadarPointCloudServiceInterface_DdsDeployment, dds-event-qos-props=EventRadarPointCloudDdsDeployment, required-service-instance-id=5041
    LibRPortPrototype10_DdsRequiredServiceInstance122: service-interface-deployment=LocationInfoDdsInterfaceDeployment, dds-event-qos-props=LocationInfoEventDeployment, required-service-instance-id=5042
    LibRPortPrototype5_DdsRequiredServiceInstance176: service-interface-deployment=SensorLidarPointCloudServiceInterface_DdsDeployment, dds-event-qos-props=EventPointCloud2DdsDeployment, required-service-instance-id=5043
    LibRPortPrototype8_DdsRequiredServiceInstance120_lradar: service-interface-deployment=RadarPointCloudServiceInterface_DdsDeployment, dds-event-qos-props=EventRadarPointCloudDdsDeployment, required-service-instance-id=5044
    Libradarpointsleft_DdsRequiredServiceInstance193: service-interface-deployment=RadarPointCloudServiceInterface_DdsDeployment, dds-event-qos-props=EventRadarPointCloudDdsDeployment, required-service-instance-id=5045
package /HuaweiMDC/instance_manifests/instanceToMachineMappings
  25 x dds service instance to machine mapping, all with communication-connector=Host0DpEthernetCommConnector:
    Libradarpointsfront_DdsRequiredServiceInstance195_ToDdsMachineMapping: service-instance=Libradarpointsfront_DdsRequiredServiceInstance195
    LibRPortPrototype1_DdsRequiredServiceInstance125_ToDdsMachineMapping: service-instance=LibRPortPrototype1_DdsRequiredServiceInstance125
    LibRPortPrototype6_DdsRequiredServiceInstance118_flidarToDdsMachineMapping: service-instance=LibRPortPrototype6_DdsRequiredServiceInstance118_flidar
    LibRPortPrototype9_DdsRequiredServiceInstance121_ToDdsMachineMapping: service-instance=LibRPortPrototype9_DdsRequiredServiceInstance121
    Libradarpointsleft_DdsRequiredServiceInstance182_ToDdsMachineMapping: service-instance=Libradarpointsleft_DdsRequiredServiceInstance182
    Libtptarget_obj_DdsProvidedServiceInstance38_ToDdsMachineMapping: service-instance=Libtptarget_obj_DdsProvidedServiceInstance38
    Libradarpointsfront_DdsRequiredServiceInstance191_ToDdsMachineMapping: service-instance=Libradarpointsfront_DdsRequiredServiceInstance191
    Libradarpointsright_DdsRequiredServiceInstance194_ToDdsMachineMapping: service-instance=Libradarpointsright_DdsRequiredServiceInstance194
    Libradarpointsleft_DdsRequiredServiceInstance196_ToDdsMachineMapping: service-instance=Libradarpointsleft_DdsRequiredServiceInstance196
    Liblidarpointsright_DdsRequiredServiceInstance180_ToDdsMachineMapping: service-instance=Liblidarpointsright_DdsRequiredServiceInstance180
    Liblidarpointsleft_DdsRequiredServiceInstance179_ToDdsMachineMapping: service-instance=Liblidarpointsleft_DdsRequiredServiceInstance179
    Liblidarpointsfront_DdsRequiredServiceInstance178_ToDdsMachineMapping: service-instance=Liblidarpointsfront_DdsRequiredServiceInstance178
    LibRPortPrototype4_DdsRequiredServiceInstance175_ToDdsMachineMapping: service-instance=LibRPortPrototype4_DdsRequiredServiceInstance175
    Libradarpointsfront_DdsRequiredServiceInstance181_ToDdsMachineMapping: service-instance=Libradarpointsfront_DdsRequiredServiceInstance181
    Libradarpointsright_DdsRequiredServiceInstance183_ToDdsMachineMapping: service-instance=Libradarpointsright_DdsRequiredServiceInstance183
    LibRPortPrototype6_DdsRequiredServiceInstance177_ToDdsMachineMapping: service-instance=LibRPortPrototype6_DdsRequiredServiceInstance177
    LibRPortPrototype1_DdsRequiredServiceInstance211_ToDdsMachineMapping: service-instance=LibRPortPrototype1_DdsRequiredServiceInstance211
    LibRPortPrototype4_DdsRequiredServiceInstance116_flidar_ToDdsMachineMapping: service-instance=LibRPortPrototype4_DdsRequiredServiceInstance116_flidar
    Libradarpointsfront_DdsRequiredServiceInstance190_ToDdsMachineMapping: service-instance=Libradarpointsfront_DdsRequiredServiceInstance190
    Libradarpointsright_DdsRequiredServiceInstance192_ToDdsMachineMapping: service-instance=Libradarpointsright_DdsRequiredServiceInstance192
    LibRPortPrototype7_DdsRequiredServiceInstance119_fradar_ToDdsMachineMapping: service-instance=LibRPortPrototype7_DdsRequiredServiceInstance119_fradar
    LibRPortPrototype10_DdsRequiredServiceInstance122_ToDdsMachineMapping: service-instance=LibRPortPrototype10_DdsRequiredServiceInstance122
    LibRPortPrototype5_DdsRequiredServiceInstance176_ToDdsMachineMapping: service-instance=LibRPortPrototype5_DdsRequiredServiceInstance176
    LibRPortPrototype8_DdsRequiredServiceInstance120_lradarToDdsMachineMapping: service-instance=LibRPortPrototype8_DdsRequiredServiceInstance120_lradar
    Libradarpointsleft_DdsRequiredServiceInstance193_ToDdsMachineMapping: service-instance=Libradarpointsleft_DdsRequiredServiceInstance193
package /HuaweiMDC/instance_manifests/providedInstances
  dds provided service instance Libtptarget_obj_DdsProvidedServiceInstance38: service-interface-deployment=FusionObjectArrayDdsInterfaceDeployment, qos-profile=default_qos.xml, domain-id=30, transport-plugins=SHM, dds-event-qos-props=FusionObjectArrayEventDeployment, service-instance-id=5026
