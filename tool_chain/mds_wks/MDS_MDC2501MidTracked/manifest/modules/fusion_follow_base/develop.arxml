AUTOSAR XML (schema 00048)
package /HuaweiMDC/exe_manifests/swcs
  executable fusion_follow_base
    root sw component prototype fusion_follow_base_rootswc: application-type=fusion_follow_base
