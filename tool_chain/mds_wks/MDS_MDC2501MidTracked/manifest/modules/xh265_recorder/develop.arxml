AUTOSAR XML (schema 00048)
package /HuaweiMDC/exe_manifests/swcs
  executable xh265_recorder
    root sw component prototype xh265_recorder_rootswc: application-type=xh265_recorder
