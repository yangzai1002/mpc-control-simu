AUTOSAR XML (schema 00048)
package /HuaweiMDC/process_manifests/processDesigns
  process design Libxh265_recorderProcessDesign42: executable=xh265_recorder
package /HuaweiMDC/process_manifests/processes
  process Libxh265_recorderProcess42: design=Libxh265_recorderProcessDesign42, executable=xh265_recorder, log-trace-default-log-level=INFO, log-trace-log-modes=NETWORK
package /HuaweiMDC/process_manifests/processToMachineMappingSets
  process to machine mapping set LibProcessToMachineMappingSet_xh265_recorderProcess42
    process to machine mapping LibprocessToMachineMapping41: machine=Host0DpMachine, process=Libxh265_recorderProcess42
package /HuaweiMDC/exe_manifests/InstanceToPortMappings
  service instance to port prototype mapping LibRPortPrototype1_DdsRequiredServiceInstance159_PortMapping: port-prototype=xh265_recorder_rootswc.video_encoded_frame, process=Libxh265_recorderProcessDesign42, service-instance=LibRPortPrototype1_DdsRequiredServiceInstance159
package /HuaweiMDC/instance_manifests/requiredInstances
  dds required service instance LibRPortPrototype1_DdsRequiredServiceInstance159: service-interface-deployment=SensorImageServiceInterface_DdsDeployment, qos-profile=default_qos.xml, domain-id=30, transport-plugins=SHM, dds-event-qos-props=EventSensorImageDdsDeployment, required-service-instance-id=5122
package /HuaweiMDC/instance_manifests/instanceToMachineMappings
  dds service instance to machine mapping LibRPortPrototype1_DdsRequiredServiceInstance159_ToDdsMachineMapping: communication-connector=Host0DpEthernetCommConnector, service-instance=LibRPortPrototype1_DdsRequiredServiceInstance159
