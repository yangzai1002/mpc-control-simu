AUTOSAR XML (schema 00048)
package /HuaweiMDC/exe_manifests/exes
  executable FusionFollow: logging-behavior=USES-LOGGING, reporting-behavior=REPORTS-EXECUTION-STATE
    root sw component prototype fusion_follow_baseExecutable30Prototype: application-type=fusion_follow_baseCompositionSwComponentType30
package /HuaweiMDC/Common/Common
  composition sw component type fusion_follow_baseCompositionSwComponentType30
    component fusion_follow_basePrototype: type=fusion_follow_base
