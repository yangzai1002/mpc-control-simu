AUTOSAR XML (schema 00048)
package /HuaweiMDC/process_manifests/processDesigns
  process design fusion_follow_baseProcessDesign30: executable=FusionFollow
package /HuaweiMDC/process_manifests/processes
  process fusion_follow_baseProcess30: design=fusion_follow_baseProcessDesign30, executable=FusionFollow, log-trace-default-log-level=INFO, log-trace-log-modes=NETWORK
package /HuaweiMDC/process_manifests/processToMachineMappingSets
  process to machine mapping set ProcessToMachineMappingSet_fusion_follow_baseProcess30
    process to machine mapping processToMachineMapping29: machine=Host0DpMachine, process=fusion_follow_baseProcess30
package /HuaweiMDC/exe_manifests/InstanceToPortMappings
  25 x service instance to port prototype mapping, all with process=fusion_follow_baseProcessDesign30:
    radarpointsfront_DdsRequiredServiceInstance195_PortMapping: port-prototype=fusion_follow_baseExecutable30Prototype.tpfront_middle_radar_points, service-instance=radarpointsfront_DdsRequiredServiceInstance195
    RPortPrototype1_DdsRequiredServiceInstance125_PortMapping: port-prototype=fusion_follow_baseExecutable30Prototype.tpperception_vp_result, service-instance=RPortPrototype1_DdsRequiredServiceInstance125
    RPortPrototype6_DdsRequiredServiceInstance118_flidarPortMapping: port-prototype=fusion_follow_baseExecutable30Prototype.tpfront_right_lidar_points, service-instance=RPortPrototype6_DdsRequiredServiceInstance118_flidar
    RPortPrototype9_DdsRequiredServiceInstance121_PortMapping: port-prototype=fusion_follow_baseExecutable30Prototype.tpfront_right_radar_points, service-instance=RPortPrototype9_DdsRequiredServiceInstance121
    radarpointsleft_DdsRequiredServiceInstance182_PortMapping: port-prototype=fusion_follow_baseExecutable30Prototype.tpfront_left_radar_points, service-instance=radarpointsleft_DdsRequiredServiceInstance182
    tptarget_obj_DdsProvidedServiceInstance38_PortMapping: port-prototype=fusion_follow_baseExecutable30Prototype.tptarget_obj, service-instance=tptarget_obj_DdsProvidedServiceInstance38
    radarpointsfront_DdsRequiredServiceInstance191_PortMapping: port-prototype=fusion_follow_baseExecutable30Prototype.tpfront_middle_radar_points, service-instance=radarpointsfront_DdsRequiredServiceInstance191
    radarpointsright_DdsRequiredServiceInstance194_PortMapping: port-prototype=fusion_follow_baseExecutable30Prototype.tpfront_right_radar_points, service-instance=radarpointsright_DdsRequiredServiceInstance194
    radarpointsleft_DdsRequiredServiceInstance196_PortMapping: port-prototype=fusion_follow_baseExecutable30Prototype.tpfront_left_radar_points, service-instance=radarpointsleft_DdsRequiredServiceInstance196
    lidarpointsright_DdsRequiredServiceInstance180_PortMapping: port-prototype=fusion_follow_baseExecutable30Prototype.tpfront_right_lidar_points, service-instance=lidarpointsright_DdsRequiredServiceInstance180
    lidarpointsleft_DdsRequiredServiceInstance179_PortMapping: port-prototype=fusion_follow_baseExecutable30Prototype.tpfront_left_lidar_points, service-instance=lidarpointsleft_DdsRequiredServiceInstance179
    lidarpointsfront_DdsRequiredServiceInstance178_PortMapping: port-prototype=fusion_follow_baseExecutable30Prototype.tpfront_middle_lidar_points, service-instance=lidarpointsfront_DdsRequiredServiceInstance178
    RPortPrototype4_DdsRequiredServiceInstance175_PortMapping: port-prototype=fusion_follow_baseExecutable30Prototype.tpfront_middle_lidar_points, service-instance=RPortPrototype4_DdsRequiredServiceInstance175
    radarpointsfront_DdsRequiredServiceInstance181_PortMapping: port-prototype=fusion_follow_baseExecutable30Prototype.tpfront_middle_radar_points, service-instance=radarpointsfront_DdsRequiredServiceInstance181
    radarpointsright_DdsRequiredServiceInstance183_PortMapping: port-prototype=fusion_follow_baseExecutable30Prototype.tpfront_right_radar_points, service-instance=radarpointsright_DdsRequiredServiceInstance183
    RPortPrototype6_DdsRequiredServiceInstance177_PortMapping: port-prototype=fusion_follow_baseExecutable30Prototype.tpfront_right_lidar_points, service-instance=RPortPrototype6_DdsRequiredServiceInstance177
    RPortPrototype1_DdsRequiredServiceInstance211_PortMapping: port-prototype=fusion_follow_baseExecutable30Prototype.tplidarobjects, service-instance=RPortPrototype1_DdsRequiredServiceInstance211
    RPortPrototype4_DdsRequiredServiceInstance116_flidar_PortMapping: port-prototype=fusion_follow_baseExecutable30Prototype.tpfront_middle_lidar_points, service-instance=RPortPrototype4_DdsRequiredServiceInstance116_flidar
    radarpointsfront_DdsRequiredServiceInstance190_PortMapping: port-prototype=fusion_follow_baseExecutable30Prototype.tpfront_middle_radar_points, service-instance=radarpointsfront_DdsRequiredServiceInstance190
    radarpointsright_DdsRequiredServiceInstance192_PortMapping: port-prototype=fusion_follow_baseExecutable30Prototype.tpfront_right_radar_points, service-instance=radarpointsright_DdsRequiredServiceInstance192
    RPortPrototype7_DdsRequiredServiceInstance119_fradar_PortMapping: port-prototype=fusion_follow_baseExecutable30Prototype.tpfront_middle_radar_points, service-instance=RPortPrototype7_DdsRequiredServiceInstance119_fradar
    RPortPrototype10_DdsRequiredServiceInstance122_PortMapping: port-prototype=fusion_follow_baseExecutable30Prototype.tplocalization, service-instance=RPortPrototype10_DdsRequiredServiceInstance122
    RPortPrototype5_DdsRequiredServiceInstance176_PortMapping: port-prototype=fusion_follow_baseExecutable30Prototype.tpfront_left_lidar_points, service-instance=RPortPrototype5_DdsRequiredServiceInstance176
    RPortPrototype8_DdsRequiredServiceInstance120_lradarPortMapping: port-prototype=fusion_follow_baseExecutable30Prototype.tpfront_left_radar_points, service-instance=RPortPrototype8_DdsRequiredServiceInstance120_lradar
    radarpointsleft_DdsRequiredServiceInstance193_PortMapping: port-prototype=fusion_follow_baseExecutable30Prototype.tpfront_left_radar_points, service-instance=radarpointsleft_DdsRequiredServiceInstance193
package /HuaweiMDC/instance_manifests/requiredInstances
  24 x dds required service instance, all with qos-profile=default_qos.xml, domain-id=30, transport-plugins=SHM:
    radarpointsfront_DdsRequiredServiceInstance195: service-interface-deployment=RadarPointCloudServiceInterface_DdsDeployment, dds-event-qos-props=EventRadarPointCloudDdsDeployment, required-service-instance-id=20225
    RPortPrototype1_DdsRequiredServiceInstance125: service-interface-deployment=VisionSegmentServiceInterface_DdsDeployment, dds-event-qos-props=EventVisionSegmentDdsDeployment, required-service-instance-id=20207
    RPortPrototype6_DdsRequiredServiceInstance118_flidar: service-interface-deployment=SensorLidarPointCloudServiceInterface_DdsDeployment, dds-event-qos-props=EventPointCloud2DdsDeployment, required-service-instance-id=20203
    RPortPrototype9_DdsRequiredServiceInstance121: service-interface-deployment=RadarPointCloudServiceInterface_DdsDeployment, dds-event-qos-props=EventRadarPointCloudDdsDeployment, required-service-instance-id=20226
    radarpointsleft_DdsRequiredServiceInstance182: service-interface-deployment=RadarPointCloudServiceInterface_DdsDeployment, dds-event-qos-props=EventRadarPointCloudDdsDeployment, required-service-instance-id=20226
    radarpointsfront_DdsRequiredServiceInstance191: service-interface-deployment=RadarPointCloudServiceInterface_DdsDeployment, dds-event-qos-props=EventRadarPointCloudDdsDeployment, required-service-instance-id=20225
    radarpointsright_DdsRequiredServiceInstance194: service-interface-deployment=RadarPointCloudServiceInterface_DdsDeployment, dds-event-qos-props=EventRadarPointCloudDdsDeployment, required-service-instance-id=20224
    radarpointsleft_DdsRequiredServiceInstance196: service-interface-deployment=RadarPointCloudServiceInterface_DdsDeployment, dds-event-qos-props=EventRadarPointCloudDdsDeployment, required-service-instance-id=20226
    lidarpointsright_DdsRequiredServiceInstance180: service-interface-deployment=SensorLidarPointCloudServiceInterface_DdsDeployment, dds-event-qos-props=EventPointCloud2DdsDeployment, required-service-instance-id=20203
    lidarpointsleft_DdsRequiredServiceInstance179: service-interface-deployment=SensorLidarPointCloudServiceInterface_DdsDeployment, dds-event-qos-props=EventPointCloud2DdsDeployment, required-service-instance-id=20202
    lidarpointsfront_DdsRequiredServiceInstance178: service-interface-deployment=SensorLidarPointCloudServiceInterface_DdsDeployment, dds-event-qos-props=EventPointCloud2DdsDeployment, required-service-instance-id=20201
    RPortPrototype4_DdsRequiredServiceInstance175: service-interface-deployment=SensorLidarPointCloudServiceInterface_DdsDeployment, dds-event-qos-props=EventPointCloud2DdsDeployment, required-service-instance-id=20201
    radarpointsfront_DdsRequiredServiceInstance181: service-interface-deployment=RadarPointCloudServiceInterface_DdsDeployment, dds-event-qos-props=EventRadarPointCloudDdsDeployment, required-service-instance-id=20225
    radarpointsright_DdsRequiredServiceInstance183: service-interface-deployment=RadarPointCloudServiceInterface_DdsDeployment, dds-event-qos-props=EventRadarPointCloudDdsDeployment, required-service-instance-id=20224
    RPortPrototype6_DdsRequiredServiceInstance177: service-interface-deployment=SensorLidarPointCloudServiceInterface_DdsDeployment, dds-event-qos-props=EventPointCloud2DdsDeployment, required-service-instance-id=20203
    RPortPrototype1_DdsRequiredServiceInstance211: service-interface-deployment=Object3dArrayDdsInterfaceDeployment, dds-event-qos-props=Object3dArrayEventDeployment, required-service-instance-id=20222
    RPortPrototype4_DdsRequiredServiceInstance116_flidar: service-interface-deployment=SensorLidarPointCloudServiceInterface_DdsDeployment, dds-event-qos-props=EventPointCloud2DdsDeployment, required-service-instance-id=20201
    radarpointsfront_DdsRequiredServiceInstance190: service-interface-deployment=RadarPointCloudServiceInterface_DdsDeployment, dds-event-qos-props=EventRadarPointCloudDdsDeployment, required-service-instance-id=20224
    radarpointsright_DdsRequiredServiceInstance192: service-interface-deployment=RadarPointCloudServiceInterface_DdsDeployment, dds-event-qos-props=EventRadarPointCloudDdsDeployment, required-service-instance-id=20224
    RPortPrototype7_DdsRequiredServiceInstance119_fradar: service-interface-deployment=RadarPointCloudServiceInterface_DdsDeployment, dds-event-qos-props=EventRadarPointCloudDdsDeployment, required-service-instance-id=20224
    RPortPrototype10_DdsRequiredServiceInstance122: service-interface-deployment=LocationInfoDdsInterfaceDeployment, dds-event-qos-props=LocationInfoEventDeployment, required-service-instance-id=20218
    RPortPrototype5_DdsRequiredServiceInstance176: service-interface-deployment=SensorLidarPointCloudServiceInterface_DdsDeployment, dds-event-qos-props=EventPointCloud2DdsDeployment, required-service-instance-id=20202
    RPortPrototype8_DdsRequiredServiceInstance120_lradar: service-interface-deployment=RadarPointCloudServiceInterface_DdsDeployment, dds-event-qos-props=EventRadarPointCloudDdsDeployment, required-service-instance-id=20225
    radarpointsleft_DdsRequiredServiceInstance193: service-interface-deployment=RadarPointCloudServiceInterface_DdsDeployment, dds-event-qos-props=EventRadarPointCloudDdsDeployment, required-service-instance-id=20226
package /HuaweiMDC/instance_manifests/instanceToMachineMappings
  25 x dds service instance to machine mapping, all with communication-connector=Host0DpEthernetCommConnector:
    radarpointsfront_DdsRequiredServiceInstance195_ToDdsMachineMapping: service-instance=radarpointsfront_DdsRequiredServiceInstance195
    RPortPrototype1_DdsRequiredServiceInstance125_ToDdsMachineMapping: service-instance=RPortPrototype1_DdsRequiredServiceInstance125
    RPortPrototype6_DdsRequiredServiceInstance118_flidarToDdsMachineMapping: service-instance=RPortPrototype6_DdsRequiredServiceInstance118_flidar
    RPortPrototype9_DdsRequiredServiceInstance121_ToDdsMachineMapping: service-instance=RPortPrototype9_DdsRequiredServiceInstance121
    radarpointsleft_DdsRequiredServiceInstance182_ToDdsMachineMapping: service-instance=radarpointsleft_DdsRequiredServiceInstance182
    tptarget_obj_DdsProvidedServiceInstance38_ToDdsMachineMapping: service-instance=tptarget_obj_DdsProvidedServiceInstance38
    radarpointsfront_DdsRequiredServiceInstance191_ToDdsMachineMapping: service-instance=radarpointsfront_DdsRequiredServiceInstance191
    radarpointsright_DdsRequiredServiceInstance194_ToDdsMachineMapping: service-instance=radarpointsright_DdsRequiredServiceInstance194
    radarpointsleft_DdsRequiredServiceInstance196_ToDdsMachineMapping: service-instance=radarpointsleft_DdsRequiredServiceInstance196
    lidarpointsright_DdsRequiredServiceInstance180_ToDdsMachineMapping: service-instance=lidarpointsright_DdsRequiredServiceInstance180
    lidarpointsleft_DdsRequiredServiceInstance179_ToDdsMachineMapping: service-instance=lidarpointsleft_DdsRequiredServiceInstance179
    lidarpointsfront_DdsRequiredServiceInstance178_ToDdsMachineMapping: service-instance=lidarpointsfront_DdsRequiredServiceInstance178
    RPortPrototype4_DdsRequiredServiceInstance175_ToDdsMachineMapping: service-instance=RPortPrototype4_DdsRequiredServiceInstance175
    radarpointsfront_DdsRequiredServiceInstance181_ToDdsMachineMapping: service-instance=radarpointsfront_DdsRequiredServiceInstance181
    radarpointsright_DdsRequiredServiceInstance183_ToDdsMachineMapping: service-instance=radarpointsright_DdsRequiredServiceInstance183
    RPortPrototype6_DdsRequiredServiceInstance177_ToDdsMachineMapping: service-instance=RPortPrototype6_DdsRequiredServiceInstance177
    RPortPrototype1_DdsRequiredServiceInstance211_ToDdsMachineMapping: service-instance=RPortPrototype1_DdsRequiredServiceInstance211
    RPortPrototype4_DdsRequiredServiceInstance116_flidar_ToDdsMachineMapping: service-instance=RPortPrototype4_DdsRequiredServiceInstance116_flidar
    radarpointsfront_DdsRequiredServiceInstance190_ToDdsMachineMapping: service-instance=radarpointsfront_DdsRequiredServiceInstance190
    radarpointsright_DdsRequiredServiceInstance192_ToDdsMachineMapping: service-instance=radarpointsright_DdsRequiredServiceInstance192
    RPortPrototype7_DdsRequiredServiceInstance119_fradar_ToDdsMachineMapping: service-instance=RPortPrototype7_DdsRequiredServiceInstance119_fradar
    RPortPrototype10_DdsRequiredServiceInstance122_ToDdsMachineMapping: service-instance=RPortPrototype10_DdsRequiredServiceInstance122
    RPortPrototype5_DdsRequiredServiceInstance176_ToDdsMachineMapping: service-instance=RPortPrototype5_DdsRequiredServiceInstance176
    RPortPrototype8_DdsRequiredServiceInstance120_lradarToDdsMachineMapping: service-instance=RPortPrototype8_DdsRequiredServiceInstance120_lradar
    radarpointsleft_DdsRequiredServiceInstance193_ToDdsMachineMapping: service-instance=radarpointsleft_DdsRequiredServiceInstance193
package /HuaweiMDC/instance_manifests/providedInstances
  dds provided service instance tptarget_obj_DdsProvidedServiceInstance38: service-interface-deployment=FusionObjectArrayDdsInterfaceDeployment, qos-profile=default_qos.xml, domain-id=30, transport-plugins=SHM, dds-event-qos-props=FusionObjectArrayEventDeployment, service-instance-id=20228
