AUTOSAR XML (schema 00048)
package /HuaweiMDC/exe_manifests/exes
  executable VehicleChassisRecv: logging-behavior=USES-LOGGING, reporting-behavior=REPORTS-EXECUTION-STATE
    root sw component prototype mid_track_chassis_recvExecutable7Prototype: application-type=mid_track_chassis_recvCompositionSwComponentType7
package /HuaweiMDC/Common/Common
  composition sw component type mid_track_chassis_recvCompositionSwComponentType7
    component mid_track_chassis_recvPrototype: type=mid_track_chassis_recv
