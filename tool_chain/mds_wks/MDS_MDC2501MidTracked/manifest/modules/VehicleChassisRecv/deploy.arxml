AUTOSAR XML (schema 00048)
package /HuaweiMDC/process_manifests/processDesigns
  process design mid_track_chassis_recvProcessDesign7: executable=VehicleChassisRecv
package /HuaweiMDC/process_manifests/processes
  process mid_track_chassis_recvProcess7: design=mid_track_chassis_recvProcessDesign7, executable=VehicleChassisRecv, log-trace-default-log-level=INFO, log-trace-log-modes=NETWORK
package /HuaweiMDC/process_manifests/processToMachineMappingSets
  process to machine mapping set ProcessToMachineMappingSet_mid_track_chassis_recvProcess7
    process to machine mapping processToMachineMapping6: machine=Host0DpMachine, process=mid_track_chassis_recvProcess7
package /HuaweiMDC/exe_manifests/InstanceToPortMappings
  service instance to port prototype mapping VehicleInfoPPortPrototype_DdsProvidedServiceInstance6_PortMapping: port-prototype=mid_track_chassis_recvExecutable7Prototype.tpvehiclestate, process=mid_track_chassis_recvProcessDesign7, service-instance=VehicleInfoPPortPrototype_DdsProvidedServiceInstance6
package /HuaweiMDC/instance_manifests/providedInstances
  dds provided service instance VehicleInfoPPortPrototype_DdsProvidedServiceInstance6: service-interface-deployment=VehicleInfomationServiceInterface_DdsDeployment, qos-profile=default_qos.xml, domain-id=30, transport-plugins=SHM, dds-event-qos-props=EventVehicleInfoDdsDeployment, service-instance-id=20205
package /HuaweiMDC/instance_manifests/instanceToMachineMappings
  dds service instance to machine mapping VehicleInfoPPortPrototype_DdsProvidedServiceInstance6_ToDdsMachineMapping: communication-connector=Host0DpEthernetCommConnector, service-instance=VehicleInfoPPortPrototype_DdsProvidedServiceInstance6
