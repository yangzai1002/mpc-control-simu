AUTOSAR XML (schema 00048)
package /HuaweiMDC/process_manifests/processDesigns
  process design xh265_recorderProcessDesign42: executable=XH265Recorder
package /HuaweiMDC/process_manifests/processes
  process xh265_recorderProcess42: design=xh265_recorderProcessDesign42, executable=XH265Recorder, log-trace-default-log-level=INFO, log-trace-log-modes=NETWORK
package /HuaweiMDC/process_manifests/processToMachineMappingSets
  process to machine mapping set ProcessToMachineMappingSet_xh265_recorderProcess42
    process to machine mapping processToMachineMapping41: machine=Host0DpMachine, process=xh265_recorderProcess42
package /HuaweiMDC/exe_manifests/InstanceToPortMappings
  service instance to port prototype mapping RPortPrototype1_DdsRequiredServiceInstance159_PortMapping: port-prototype=xh265_recorderExecutable42Prototype.video_encoded_frame, process=xh265_recorderProcessDesign42, service-instance=RPortPrototype1_DdsRequiredServiceInstance159
package /HuaweiMDC/instance_manifests/requiredInstances
  dds required service instance RPortPrototype1_DdsRequiredServiceInstance159: service-interface-deployment=SensorImageServiceInterface_DdsDeployment, qos-profile=default_qos.xml, domain-id=30, transport-plugins=SHM, dds-event-qos-props=EventSensorImageDdsDeployment, required-service-instance-id=20247
package /HuaweiMDC/instance_manifests/instanceToMachineMappings
  dds service instance to machine mapping RPortPrototype1_DdsRequiredServiceInstance159_ToDdsMachineMapping: communication-connector=Host0DpEthernetCommConnector, service-instance=RPortPrototype1_DdsRequiredServiceInstance159
