AUTOSAR XML (schema 00048)
package /HuaweiMDC/exe_manifests/exes
  executable XH265Recorder: logging-behavior=USES-LOGGING, reporting-behavior=REPORTS-EXECUTION-STATE
    root sw component prototype xh265_recorderExecutable42Prototype: application-type=xh265_recorderCompositionSwComponentType42
package /HuaweiMDC/Common/Common
  composition sw component type xh265_recorderCompositionSwComponentType42
    component xh265_recorderPrototype: type=xh265_recorder
