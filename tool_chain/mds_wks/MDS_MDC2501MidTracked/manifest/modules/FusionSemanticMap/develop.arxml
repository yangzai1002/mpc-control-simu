AUTOSAR XML (schema 00048)
package /HuaweiMDC/exe_manifests/exes
  executable FusionSemanticMap: logging-behavior=USES-LOGGING, reporting-behavior=REPORTS-EXECUTION-STATE
    root sw component prototype fusion_semantic_map_baseExecutable11Prototype: application-type=fusion_semantic_map_baseCompositionSwComponentType11
package /HuaweiMDC/Common/Common
  composition sw component type fusion_semantic_map_baseCompositionSwComponentType11
    component fusion_semantic_map_basePrototype: type=fusion_semantic_map_base
