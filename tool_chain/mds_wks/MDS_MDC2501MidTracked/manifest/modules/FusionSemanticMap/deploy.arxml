AUTOSAR XML (schema 00048)
package /HuaweiMDC/process_manifests/processDesigns
  process design fusion_semantic_map_baseProcessDesign11: executable=FusionSemanticMap
package /HuaweiMDC/process_manifests/processes
  process fusion_semantic_map_baseProcess11: design=fusion_semantic_map_baseProcessDesign11, executable=FusionSemanticMap, log-trace-default-log-level=INFO, log-trace-log-modes=NETWORK
package /HuaweiMDC/process_manifests/processToMachineMappingSets
  process to machine mapping set ProcessToMachineMappingSet_fusion_semantic_map_baseProcess11
    process to machine mapping processToMachineMapping10: machine=Host0DpMachine, process=fusion_semantic_map_baseProcess11
package /HuaweiMDC/exe_manifests/InstanceToPortMappings
  10 x service instance to port prototype mapping, all with process=fusion_semantic_map_baseProcessDesign11:
    lidarpointsleft_DdsRequiredServiceInstance198_PortMapping: port-prototype=fusion_semantic_map_baseExecutable11Prototype.tpfront_left_lidar_points, service-instance=lidarpointsleft_DdsRequiredServiceInstance198
    RPortPrototype13_DdsRequiredServiceInstance174_PortMapping: port-prototype=fusion_semantic_map_baseExecutable11Prototype.tpfront_right_lidar_points, service-instance=RPortPrototype13_DdsRequiredServiceInstance174
    RPortPrototype14_DdsRequiredServiceInstance122_PortMapping: port-prototype=fusion_semantic_map_baseExecutable11Prototype.tplocalization, service-instance=RPortPrototype14_DdsRequiredServiceInstance122
    RPortPrototype12_DdsRequiredServiceInstance120_PortMapping: port-prototype=fusion_semantic_map_baseExecutable11Prototype.tpfront_left_lidar_points, service-instance=RPortPrototype12_DdsRequiredServiceInstance120
    RPortPrototype10_DdsRequiredServiceInstance172_PortMapping: port-prototype=fusion_semantic_map_baseExecutable11Prototype.tpfront_middle_lidar_points, service-instance=RPortPrototype10_DdsRequiredServiceInstance172
    RPortPrototype13_DdsRequiredServiceInstance121_PortMapping: port-prototype=fusion_semantic_map_baseExecutable11Prototype.tpfront_right_lidar_points, service-instance=RPortPrototype13_DdsRequiredServiceInstance121
    lidarpointsfront_DdsRequiredServiceInstance197_PortMapping: port-prototype=fusion_semantic_map_baseExecutable11Prototype.tpfront_middle_lidar_points, service-instance=lidarpointsfront_DdsRequiredServiceInstance197
    RPortPrototype10_DdsRequiredServiceInstance119_PortMapping: port-prototype=fusion_semantic_map_baseExecutable11Prototype.tpfront_middle_lidar_points, service-instance=RPortPrototype10_DdsRequiredServiceInstance119
    lidarpointsright_DdsRequiredServiceInstance199_PortMapping: port-prototype=fusion_semantic_map_baseExecutable11Prototype.tpfront_right_lidar_points, service-instance=lidarpointsright_DdsRequiredServiceInstance199
    RPortPrototype12_DdsRequiredServiceInstance173_PortMapping: port-prototype=fusion_semantic_map_baseExecutable11Prototype.tpfront_left_lidar_points, service-instance=RPortPrototype12_DdsRequiredServiceInstance173
package /HuaweiMDC/instance_manifests/requiredInstances
  10 x dds required service instance, all with qos-profile=default_qos.xml, domain-id=30, transport-plugins=SHM:
    lidarpointsleft_DdsRequiredServiceInstance198: service-interface-deployment=SensorLidarPointCloudServiceInterface_DdsDeployment, dds-event-qos-props=EventPointCloud2DdsDeployment, required-service-instance-id=20202
    RPortPrototype13_DdsRequiredServiceInstance174: service-interface-deployment=SensorLidarPointCloudServiceInterface_DdsDeployment, dds-event-qos-props=EventPointCloud2DdsDeployment, required-service-instance-id=20203
    RPortPrototype14_DdsRequiredServiceInstance122: service-interface-deployment=LocationInfoDdsInterfaceDeployment, dds-event-qos-props=LocationInfoEventDeployment, required-service-instance-id=20218
    RPortPrototype12_DdsRequiredServiceInstance120: service-interface-deployment=SensorLidarPointCloudServiceInterface_DdsDeployment, dds-event-qos-props=EventPointCloud2DdsDeployment, required-service-instance-id=20202
    RPortPrototype10_DdsRequiredServiceInstance172: service-interface-deployment=SensorLidarPointCloudServiceInterface_DdsDeployment, dds-event-qos-props=EventPointCloud2DdsDeployment, required-service-instance-id=20201
    RPortPrototype13_DdsRequiredServiceInstance121: service-interface-deployment=SensorLidarPointCloudServiceInterface_DdsDeployment, dds-event-qos-props=EventPointCloud2DdsDeployment, required-service-instance-id=20203
    lidarpointsfront_DdsRequiredServiceInstance197: service-interface-deployment=SensorLidarPointCloudServiceInterface_DdsDeployment, dds-event-qos-props=EventPointCloud2DdsDeployment, required-service-instance-id=20201
    RPortPrototype10_DdsRequiredServiceInstance119: service-interface-deployment=SensorLidarPointCloudServiceInterface_DdsDeployment, dds-event-qos-props=EventPointCloud2DdsDeployment, required-service-instance-id=20201
    lidarpointsright_DdsRequiredServiceInstance199: service-interface-deployment=SensorLidarPointCloudServiceInterface_DdsDeployment, dds-event-qos-props=EventPointCloud2DdsDeployment, required-service-instance-id=20203
    RPortPrototype12_DdsRequiredServiceInstance173: service-interface-deployment=SensorLidarPointCloudServiceInterface_DdsDeployment, dds-event-qos-props=EventPointCloud2DdsDeployment, required-service-instance-id=20202
package /HuaweiMDC/instance_manifests/instanceToMachineMappings
  10 x dds service instance to machine mapping, all with communication-connector=Host0DpEthernetCommConnector:
    lidarpointsleft_DdsRequiredServiceInstance198_ToDdsMachineMapping: service-instance=lidarpointsleft_DdsRequiredServiceInstance198
    RPortPrototype13_DdsRequiredServiceInstance174_ToDdsMachineMapping: service-instance=RPortPrototype13_DdsRequiredServiceInstance174
    RPortPrototype14_DdsRequiredServiceInstance122_ToDdsMachineMapping: service-instance=RPortPrototype14_DdsRequiredServiceInstance122
    RPortPrototype12_DdsRequiredServiceInstance120_ToDdsMachineMapping: service-instance=RPortPrototype12_DdsRequiredServiceInstance120
    RPortPrototype10_DdsRequiredServiceInstance172_ToDdsMachineMapping: service-instance=RPortPrototype10_DdsRequiredServiceInstance172
    RPortPrototype13_DdsRequiredServiceInstance121_ToDdsMachineMapping: service-instance=RPortPrototype13_DdsRequiredServiceInstance121
    lidarpointsfront_DdsRequiredServiceInstance197_ToDdsMachineMapping: service-instance=lidarpointsfront_DdsRequiredServiceInstance197
    RPortPrototype10_DdsRequiredServiceInstance119_ToDdsMachineMapping: service-instance=RPortPrototype10_DdsRequiredServiceInstance119
    lidarpointsright_DdsRequiredServiceInstance199_ToDdsMachineMapping: service-instance=lidarpointsright_DdsRequiredServiceInstance199
    RPortPrototype12_DdsRequiredServiceInstance173_ToDdsMachineMapping: service-instance=RPortPrototype12_DdsRequiredServiceInstance173
