AUTOSAR XML (schema 00048)
package /HuaweiMDC/exe_manifests/swcs
  executable hw_fr671_radar
    root sw component prototype hw_fr671_radar_rootswc: application-type=hw_fr671_radar
