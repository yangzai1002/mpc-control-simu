AUTOSAR XML (schema 00048)
package /HuaweiMDC/process_manifests/processDesigns
  process design Libhw_fr671_radarProcessDesign20: executable=hw_fr671_radar
package /HuaweiMDC/process_manifests/processes
  process Libhw_fr671_radarProcess20: design=Libhw_fr671_radarProcessDesign20, executable=hw_fr671_radar, log-trace-default-log-level=INFO, log-trace-log-modes=NETWORK
package /HuaweiMDC/process_manifests/processToMachineMappingSets
  process to machine mapping set LibProcessToMachineMappingSet_hw_fr671_radarProcess20
    process to machine mapping LibprocessToMachineMapping19: machine=Host0DpMachine, process=Libhw_fr671_radarProcess20
package /HuaweiMDC/exe_manifests/InstanceToPortMappings
  12 x service instance to port prototype mapping, all with process=Libhw_fr671_radarProcessDesign20:
    Libradarpackets_DdsProvidedServiceInstance42_PortMapping: port-prototype=hw_fr671_radar_rootswc.radarpackets, service-instance=Libradarpackets_DdsProvidedServiceInstance42
    LibRPortPrototype2_DdsRequiredServiceInstance105_PortMapping: port-prototype=hw_fr671_radar_rootswc.tpimu1, service-instance=LibRPortPrototype2_DdsRequiredServiceInstance105
    LibRadarPointCloudPPortPrototype_DdsProvidedServiceInstance41_PortMapping: port-prototype=hw_fr671_radar_rootswc.radarpoints, service-instance=LibRadarPointCloudPPortPrototype_DdsProvidedServiceInstance41
    LibRPortPrototype4_DdsRequiredServiceInstance107_PortMapping: port-prototype=hw_fr671_radar_rootswc.tpimu2, service-instance=LibRPortPrototype4_DdsRequiredServiceInstance107
    Libradarpackets_DdsProvidedServiceInstance44_PortMapping: port-prototype=hw_fr671_radar_rootswc.radarpackets, service-instance=Libradarpackets_DdsProvidedServiceInstance44
    LibRPortPrototype2_DdsRequiredServiceInstance201_PortMapping: port-prototype=hw_fr671_radar_rootswc.tpvehiclestate2, service-instance=LibRPortPrototype2_DdsRequiredServiceInstance201
    LibRPortPrototype3_DdsRequiredServiceInstance202_PortMapping: port-prototype=hw_fr671_radar_rootswc.tpvehiclestate3, service-instance=LibRPortPrototype3_DdsRequiredServiceInstance202
    Libradarpackets_DdsProvidedServiceInstance43_PortMapping: port-prototype=hw_fr671_radar_rootswc.radarpackets, service-instance=Libradarpackets_DdsProvidedServiceInstance43
    LibRadarPointCloudPPortPrototype_DdsProvidedServiceInstance40_PortMapping: port-prototype=hw_fr671_radar_rootswc.radarpoints, service-instance=LibRadarPointCloudPPortPrototype_DdsProvidedServiceInstance40
    LibRPortPrototype6_DdsRequiredServiceInstance109_PortMapping: port-prototype=hw_fr671_radar_rootswc.tpimu3, service-instance=LibRPortPrototype6_DdsRequiredServiceInstance109
    LibRPortPrototype1_DdsRequiredServiceInstance200_PortMapping: port-prototype=hw_fr671_radar_rootswc.tpvehiclestate1, service-instance=LibRPortPrototype1_DdsRequiredServiceInstance200
    LibRadarPointCloudPPortPrototype_DdsProvidedServiceInstance42_PortMapping: port-prototype=hw_fr671_radar_rootswc.radarpoints, service-instance=LibRadarPointCloudPPortPrototype_DdsProvidedServiceInstance42
package /HuaweiMDC/instance_manifests/providedInstances
  6 x dds provided service instance, all with qos-profile=default_qos.xml, domain-id=30, transport-plugins=SHM:
    Libradarpackets_DdsProvidedServiceInstance42: service-interface-deployment=SensorRadarPacketServiceInterface_DdsDeployment, dds-event-qos-props=EventSensorRadarPacketDdsDeployment, service-instance-id=5054
    LibRadarPointCloudPPortPrototype_DdsProvidedServiceInstance41: service-interface-deployment=RadarPointCloudServiceInterface_DdsDeployment, dds-event-qos-props=EventRadarPointCloudDdsDeployment, service-instance-id=5056
    Libradarpackets_DdsProvidedServiceInstance44: service-interface-deployment=SensorRadarPacketServiceInterface_DdsDeployment, dds-event-qos-props=EventSensorRadarPacketDdsDeployment, service-instance-id=5058
    Libradarpackets_DdsProvidedServiceInstance43: service-interface-deployment=SensorRadarPacketServiceInterface_DdsDeployment, dds-event-qos-props=EventSensorRadarPacketDdsDeployment, service-instance-id=5061
    LibRadarPointCloudPPortPrototype_DdsProvidedServiceInstance40: service-interface-deployment=RadarPointCloudServiceInterface_DdsDeployment, dds-event-qos-props=EventRadarPointCloudDdsDeployment, service-instance-id=5062
    LibRadarPointCloudPPortPrototype_DdsProvidedServiceInstance42: service-interface-deployment=RadarPointCloudServiceInterface_DdsDeployment, dds-event-qos-props=EventRadarPointCloudDdsDeployment, service-instance-id=5065
package /HuaweiMDC/instance_manifests/instanceToMachineMappings
  12 x dds service instance to machine mapping, all with communication-connector=Host0DpEthernetCommConnector:
    Libradarpackets_DdsProvidedServiceInstance42_ToDdsMachineMapping: service-instance=Libradarpackets_DdsProvidedServiceInstance42
    LibRPortPrototype2_DdsRequiredServiceInstance105_ToDdsMachineMapping: service-instance=LibRPortPrototype2_DdsRequiredServiceInstance105
    LibRadarPointCloudPPortPrototype_DdsProvidedServiceInstance41_ToDdsMachineMapping: service-instance=LibRadarPointCloudPPortPrototype_DdsProvidedServiceInstance41
    LibRPortPrototype4_DdsRequiredServiceInstance107_ToDdsMachineMapping: service-instance=LibRPortPrototype4_DdsRequiredServiceInstance107
    Libradarpackets_DdsProvidedServiceInstance44_ToDdsMachineMapping: service-instance=Libradarpackets_DdsProvidedServiceInstance44
    LibRPortPrototype2_DdsRequiredServiceInstance201_ToDdsMachineMapping: service-instance=LibRPortPrototype2_DdsRequiredServiceInstance201
    LibRPortPrototype3_DdsRequiredServiceInstance202_ToDdsMachineMapping: service-instance=LibRPortPrototype3_DdsRequiredServiceInstance202
    Libradarpackets_DdsProvidedServiceInstance43_ToDdsMachineMapping: service-instance=Libradarpackets_DdsProvidedServiceInstance43
    LibRadarPointCloudPPortPrototype_DdsProvidedServiceInstance40_ToDdsMachineMapping: service-instance=LibRadarPointCloudPPortPrototype_DdsProvidedServiceInstance40
    LibRPortPrototype6_DdsRequiredServiceInstance109_ToDdsMachineMapping: service-instance=LibRPortPrototype6_DdsRequiredServiceInstance109
    LibRPortPrototype1_DdsRequiredServiceInstance200_ToDdsMachineMapping: service-instance=LibRPortPrototype1_DdsRequiredServiceInstance200
    LibRadarPointCloudPPortPrototype_DdsProvidedServiceInstance42_ToDdsMachineMapping: service-instance=LibRadarPointCloudPPortPrototype_DdsProvidedServiceInstance42
package /HuaweiMDC/instance_manifests/requiredInstances
  6 x dds required service instance, all with qos-profile=default_qos.xml, domain-id=30, transport-plugins=SHM:
    LibRPortPrototype2_DdsRequiredServiceInstance105: service-interface-deployment=LocationDdsInterfaceDeployment, dds-event-qos-props=LocationEventDeployment, required-service-instance-id=5055
    LibRPortPrototype4_DdsRequiredServiceInstance107: service-interface-deployment=LocationDdsInterfaceDeployment, dds-event-qos-props=LocationEventDeployment, required-service-instance-id=5057
    LibRPortPrototype2_DdsRequiredServiceInstance201: service-interface-deployment=VehicleInfomationServiceInterface_DdsDeployment, dds-event-qos-props=EventVehicleInfoDdsDeployment, required-service-instance-id=5059
    LibRPortPrototype3_DdsRequiredServiceInstance202: service-interface-deployment=VehicleInfomationServiceInterface_DdsDeployment, dds-event-qos-props=EventVehicleInfoDdsDeployment, required-service-instance-id=5060
    LibRPortPrototype6_DdsRequiredServiceInstance109: service-interface-deployment=LocationDdsInterfaceDeployment, dds-event-qos-props=LocationEventDeployment, required-service-instance-id=5063
    LibRPortPrototype1_DdsRequiredServiceInstance200: service-interface-deployment=VehicleInfomationServiceInterface_DdsDeployment, dds-event-qos-props=EventVehicleInfoDdsDeployment, required-service-instance-id=5064
