AUTOSAR XML (schema 00048)
package /HuaweiMDC/exe_manifests/exes
  executable VehicleChassisSend: logging-behavior=USES-LOGGING, reporting-behavior=REPORTS-EXECUTION-STATE
    root sw component prototype mid_track_chassis_sendExecutable19Prototype: application-type=mid_track_chassis_sendCompositionSwComponentType19
package /HuaweiMDC/Common/Common
  composition sw component type mid_track_chassis_sendCompositionSwComponentType19
    component mid_track_chassis_sendPrototype: type=mid_track_chassis_send
