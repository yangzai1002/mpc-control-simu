AUTOSAR XML (schema 00048)
package /HuaweiMDC/process_manifests/processDesigns
  process design mid_track_chassis_sendProcessDesign19: executable=VehicleChassisSend
package /HuaweiMDC/process_manifests/processes
  process mid_track_chassis_sendProcess19: design=mid_track_chassis_sendProcessDesign19, executable=VehicleChassisSend, log-trace-default-log-level=INFO, log-trace-log-modes=NETWORK
package /HuaweiMDC/process_manifests/processToMachineMappingSets
  process to machine mapping set ProcessToMachineMappingSet_mid_track_chassis_sendProcess19
    process to machine mapping processToMachineMapping18: machine=Host0DpMachine, process=mid_track_chassis_sendProcess19
package /HuaweiMDC/exe_manifests/InstanceToPortMappings
  service instance to port prototype mapping RPortPrototype4_DdsRequiredServiceInstance139_PortMapping: port-prototype=mid_track_chassis_sendExecutable19Prototype.tpfault_data, process=mid_track_chassis_sendProcessDesign19, service-instance=RPortPrototype4_DdsRequiredServiceInstance139
package /HuaweiMDC/instance_manifests/requiredInstances
  dds required service instance RPortPrototype4_DdsRequiredServiceInstance139: service-interface-deployment=FaultDataServiceInterface_DdsDeployment, qos-profile=default_qos.xml, domain-id=30, transport-plugins=SHM, dds-event-qos-props=EventFaultDataDdsDeployment, required-service-instance-id=20220
package /HuaweiMDC/instance_manifests/instanceToMachineMappings
  dds service instance to machine mapping RPortPrototype4_DdsRequiredServiceInstance139_ToDdsMachineMapping: communication-connector=Host0DpEthernetCommConnector, service-instance=RPortPrototype4_DdsRequiredServiceInstance139
