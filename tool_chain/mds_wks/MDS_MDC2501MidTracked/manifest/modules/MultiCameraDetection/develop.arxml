AUTOSAR XML (schema 00048)
package /HuaweiMDC/exe_manifests/exes
  executable MultiCameraDetection: logging-behavior=USES-LOGGING, reporting-behavior=REPORTS-EXECUTION-STATE
    root sw component prototype multy_camera_det_baseExecutable34Prototype: application-type=multy_camera_det_baseCompositionSwComponentType34
package /HuaweiMDC/Common/Common
  composition sw component type multy_camera_det_baseCompositionSwComponentType34
    component multy_camera_det_basePrototype: type=multy_camera_det_base
