AUTOSAR XML (schema 00048)
package /HuaweiMDC/process_manifests/processDesigns
  process design multy_camera_det_baseProcessDesign34: executable=MultiCameraDetection
package /HuaweiMDC/process_manifests/processes
  process multy_camera_det_baseProcess34: design=multy_camera_det_baseProcessDesign34, executable=MultiCameraDetection, log-trace-default-log-level=INFO, log-trace-log-modes=NETWORK
package /HuaweiMDC/process_manifests/processToMachineMappingSets
  process to machine mapping set ProcessToMachineMappingSet_multy_camera_det_baseProcess34
    process to machine mapping processToMachineMapping33: machine=Host0DpMachine, process=multy_camera_det_baseProcess34
package /HuaweiMDC/exe_manifests/InstanceToPortMappings
  service instance to port prototype mapping RPortPrototype2_DdsRequiredServiceInstance124_PortMapping: port-prototype=multy_camera_det_baseExecutable34Prototype.tpimage_list, process=multy_camera_det_baseProcessDesign34, service-instance=RPortPrototype2_DdsRequiredServiceInstance124
  service instance to port prototype mapping tpperception_vp_result_DdsProvidedServiceInstance38_PortMapping: port-prototype=multy_camera_det_baseExecutable34Prototype.tpperception_vp_result, process=multy_camera_det_baseProcessDesign34, service-instance=tpperception_vp_result_DdsProvidedServiceInstance38
package /HuaweiMDC/instance_manifests/requiredInstances
  dds required service instance RPortPrototype2_DdsRequiredServiceInstance124: service-interface-deployment=SensorImageListServiceInterface_DdsDeployment, qos-profile=default_qos.xml, domain-id=30, transport-plugins=SHM, dds-event-qos-props=EventImageListDdsDeployment, required-service-instance-id=20200
package /HuaweiMDC/instance_manifests/instanceToMachineMappings
  dds service instance to machine mapping RPortPrototype2_DdsRequiredServiceInstance124_ToDdsMachineMapping: communication-connector=Host0DpEthernetCommConnector, service-instance=RPortPrototype2_DdsRequiredServiceInstance124
  dds service instance to machine mapping tpperception_vp_result_DdsProvidedServiceInstance38_ToDdsMachineMapping: communication-connector=Host0DpEthernetCommConnector, service-instance=tpperception_vp_result_DdsProvidedServiceInstance38
package /HuaweiMDC/instance_manifests/providedInstances
  dds provided service instance tpperception_vp_result_DdsProvidedServiceInstance38: service-interface-deployment=VisionSegmentServiceInterface_DdsDeployment, qos-profile=default_qos.xml, domain-id=30, transport-plugins=SHM, dds-event-qos-props=EventVisionSegmentDdsDeployment, service-instance-id=20207
