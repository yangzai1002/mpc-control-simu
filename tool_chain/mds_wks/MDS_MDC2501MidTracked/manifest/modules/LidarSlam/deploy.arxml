AUTOSAR XML (schema 00048)
package /HuaweiMDC/process_manifests/processDesigns
  process design LidarSlamProcessDesign25: executable=LidarSlam
package /HuaweiMDC/process_manifests/processes
  process LidarSlamProcess25: design=LidarSlamProcessDesign25, executable=LidarSlam, log-trace-default-log-level=INFO, log-trace-log-modes=NETWORK
package /HuaweiMDC/process_manifests/processToMachineMappingSets
  process to machine mapping set ProcessToMachineMappingSet_LidarSlamProcess25
    process to machine mapping processToMachineMapping24: machine=Host0DpMachine, process=LidarSlamProcess25
package /HuaweiMDC/exe_manifests/InstanceToPortMappings
  9 x service instance to port prototype mapping, all with process=LidarSlamProcessDesign25:
    RPortPrototype3_DdsRequiredServiceInstance109_PortMapping: port-prototype=LidarSlamExecutable25Prototype.tpfront_right_lidar_points, service-instance=RPortPrototype3_DdsRequiredServiceInstance109
    tpliodr_DdsProvidedServiceInstance36_PortMapping: port-prototype=LidarSlamExecutable25Prototype.tpliodr, service-instance=tpliodr_DdsProvidedServiceInstance36
    lidarpointsleft_DdsRequiredServiceInstance201_PortMapping: port-prototype=LidarSlamExecutable25Prototype.tpfront_left_lidar_points, service-instance=lidarpointsleft_DdsRequiredServiceInstance201
    lidarpointsfront_DdsRequiredServiceInstance200_PortMapping: port-prototype=LidarSlamExecutable25Prototype.tpfront_middle_lidar_points, service-instance=lidarpointsfront_DdsRequiredServiceInstance200
    RPortPrototype4_DdsRequiredServiceInstance110_PortMapping: port-prototype=LidarSlamExecutable25Prototype.tpsensorimu, service-instance=RPortPrototype4_DdsRequiredServiceInstance110
    lidarpointsright_DdsRequiredServiceInstance202_PortMapping: port-prototype=LidarSlamExecutable25Prototype.tpfront_right_lidar_points, service-instance=lidarpointsright_DdsRequiredServiceInstance202
    RPortPrototype1_DdsRequiredServiceInstance107_PortMapping: port-prototype=LidarSlamExecutable25Prototype.tpfront_middle_lidar_points, service-instance=RPortPrototype1_DdsRequiredServiceInstance107
    tpfront_middle_lidar_points_DdsRequiredServiceInstance109_PortMapping: port-prototype=LidarSlamExecutable25Prototype.tpfront_middle_lidar_points, service-instance=tpfront_middle_lidar_points_DdsRequiredServiceInstance109
    RPortPrototype5_DdsRequiredServiceInstance111_wspeedPortMapping: port-prototype=LidarSlamExecutable25Prototype.tpwheelspeed, service-instance=RPortPrototype5_DdsRequiredServiceInstance111_wspeed
package /HuaweiMDC/instance_manifests/requiredInstances
  8 x dds required service instance, all with qos-profile=default_qos.xml, domain-id=30, transport-plugins=SHM:
    RPortPrototype3_DdsRequiredServiceInstance109: service-interface-deployment=SensorLidarPointCloudServiceInterface_DdsDeployment, dds-event-qos-props=EventPointCloud2DdsDeployment, required-service-instance-id=20203
    lidarpointsleft_DdsRequiredServiceInstance201: service-interface-deployment=SensorLidarPointCloudServiceInterface_DdsDeployment, dds-event-qos-props=EventPointCloud2DdsDeployment, required-service-instance-id=20202
    lidarpointsfront_DdsRequiredServiceInstance200: service-interface-deployment=SensorLidarPointCloudServiceInterface_DdsDeployment, dds-event-qos-props=EventPointCloud2DdsDeployment, required-service-instance-id=20201
    RPortPrototype4_DdsRequiredServiceInstance110: service-interface-deployment=SensorImuServiceInterface_DdsDeployment, dds-event-qos-props=EventSensorImuDdsDeployment, required-service-instance-id=20223
    lidarpointsright_DdsRequiredServiceInstance202: service-interface-deployment=SensorLidarPointCloudServiceInterface_DdsDeployment, dds-event-qos-props=EventPointCloud2DdsDeployment, required-service-instance-id=20203
    RPortPrototype1_DdsRequiredServiceInstance107: service-interface-deployment=SensorLidarPointCloudServiceInterface_DdsDeployment, dds-event-qos-props=EventPointCloud2DdsDeployment, required-service-instance-id=20201
    tpfront_middle_lidar_points_DdsRequiredServiceInstance109: service-interface-deployment=SensorLidarPointCloudServiceInterface_DdsDeployment, dds-event-qos-props=EventPointCloud2DdsDeployment, required-service-instance-id=20201
    RPortPrototype5_DdsRequiredServiceInstance111_wspeed: service-interface-deployment=SensorWheelSpeedServiceInterface_DdsDeployment, dds-event-qos-props=EventWheelSpeedDdsDeployment, required-service-instance-id=20204
package /HuaweiMDC/instance_manifests/instanceToMachineMappings
  12 x dds service instance to machine mapping, all with communication-connector=Host0DpEthernetCommConnector:
    RPortPrototype3_DdsRequiredServiceInstance109_ToDdsMachineMapping: service-instance=RPortPrototype3_DdsRequiredServiceInstance109
    RPortPrototype3_DdsRequiredServiceInstance109_ToDdsMachineMapping: service-instance=RPortPrototype3_DdsRequiredServiceInstance109
    tpliodr_DdsProvidedServiceInstance36_ToDdsMachineMapping: service-instance=tpliodr_DdsProvidedServiceInstance36
    lidarpointsleft_DdsRequiredServiceInstance201_ToDdsMachineMapping: service-instance=lidarpointsleft_DdsRequiredServiceInstance201
    lidarpointsfront_DdsRequiredServiceInstance200_ToDdsMachineMapping: service-instance=lidarpointsfront_DdsRequiredServiceInstance200
    RPortPrototype4_DdsRequiredServiceInstance110_ToDdsMachineMapping: service-instance=RPortPrototype4_DdsRequiredServiceInstance110
    RPortPrototype4_DdsRequiredServiceInstance110_ToDdsMachineMapping: service-instance=RPortPrototype4_DdsRequiredServiceInstance110
    lidarpointsright_DdsRequiredServiceInstance202_ToDdsMachineMapping: service-instance=lidarpointsright_DdsRequiredServiceInstance202
    RPortPrototype1_DdsRequiredServiceInstance107_ToDdsMachineMapping: service-instance=RPortPrototype1_DdsRequiredServiceInstance107
    RPortPrototype1_DdsRequiredServiceInstance107_ToDdsMachineMapping: service-instance=RPortPrototype1_DdsRequiredServiceInstance107
    tpfront_middle_lidar_points_DdsRequiredServiceInstance109_ToDdsMachineMapping: service-instance=tpfront_middle_lidar_points_DdsRequiredServiceInstance109
    RPortPrototype5_DdsRequiredServiceInstance111_wspeedToDdsMachineMapping: service-instance=RPortPrototype5_DdsRequiredServiceInstance111_wspeed
package /HuaweiMDC/instance_manifests/providedInstances
  dds provided service instance tpliodr_DdsProvidedServiceInstance36: service-interface-deployment=LocationInfoDdsInterfaceDeployment, qos-profile=default_qos.xml, domain-id=30, transport-plugins=SHM, dds-event-qos-props=LocationInfoEventDeployment, service-instance-id=20206
