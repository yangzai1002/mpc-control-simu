AUTOSAR XML (schema 00048)
package /HuaweiMDC/exe_manifests/exes
  executable LidarSlam: logging-behavior=USES-LOGGING, reporting-behavior=REPORTS-EXECUTION-STATE
    root sw component prototype LidarSlamExecutable25Prototype: application-type=LidarSlamCompositionSwComponentType25
package /HuaweiMDC/Common/Common
  composition sw component type LidarSlamCompositionSwComponentType25
    component LidarSlamPrototype: type=lidar_slam_base
