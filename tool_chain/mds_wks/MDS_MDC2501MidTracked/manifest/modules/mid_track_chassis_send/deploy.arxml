AUTOSAR XML (schema 00048)
package /HuaweiMDC/process_manifests/processDesigns
  process design Libmid_track_chassis_sendProcessDesign19: executable=mid_track_chassis_send
package /HuaweiMDC/process_manifests/processes
  process Libmid_track_chassis_sendProcess19: design=Libmid_track_chassis_sendProcessDesign19, executable=mid_track_chassis_send, log-trace-default-log-level=INFO, log-trace-log-modes=NETWORK
package /HuaweiMDC/process_manifests/processToMachineMappingSets
  process to machine mapping set LibProcessToMachineMappingSet_mid_track_chassis_sendProcess19
    process to machine mapping LibprocessToMachineMapping18: machine=Host0DpMachine, process=Libmid_track_chassis_sendProcess19
package /HuaweiMDC/exe_manifests/InstanceToPortMappings
  service instance to port prototype mapping LibRPortPrototype4_DdsRequiredServiceInstance139_PortMapping: port-prototype=mid_track_chassis_send_rootswc.tpfault_data, process=Libmid_track_chassis_sendProcessDesign19, service-instance=LibRPortPrototype4_DdsRequiredServiceInstance139
package /HuaweiMDC/instance_manifests/requiredInstances
  dds required service instance LibRPortPrototype4_DdsRequiredServiceInstance139: service-interface-deployment=FaultDataServiceInterface_DdsDeployment, qos-profile=default_qos.xml, domain-id=30, transport-plugins=SHM, dds-event-qos-props=EventFaultDataDdsDeployment, required-service-instance-id=5053
package /HuaweiMDC/instance_manifests/instanceToMachineMappings
  dds service instance to machine mapping LibRPortPrototype4_DdsRequiredServiceInstance139_ToDdsMachineMapping: communication-connector=Host0DpEthernetCommConnector, service-instance=LibRPortPrototype4_DdsRequiredServiceInstance139
