AUTOSAR XML (schema 00048)
package /HuaweiMDC/exe_manifests/swcs
  executable mid_track_chassis_send
    root sw component prototype mid_track_chassis_send_rootswc: application-type=mid_track_chassis_send
