AUTOSAR XML (schema 00048)
package /HuaweiMDC/exe_manifests/swcs
  executable xh265_rtp_pusher
    root sw component prototype xh265_rtp_pusher_rootswc: application-type=xh265_rtp_pusher
