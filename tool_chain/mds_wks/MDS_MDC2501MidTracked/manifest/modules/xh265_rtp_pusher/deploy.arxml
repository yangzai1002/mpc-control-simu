AUTOSAR XML (schema 00048)
package /HuaweiMDC/process_manifests/processDesigns
  process design Libxh265_rtp_pusherProcessDesign14: executable=xh265_rtp_pusher
package /HuaweiMDC/process_manifests/processes
  process Libxh265_rtp_pusherProcess14: design=Libxh265_rtp_pusherProcessDesign14, executable=xh265_rtp_pusher, log-trace-default-log-level=INFO, log-trace-log-modes=NETWORK
package /HuaweiMDC/process_manifests/processToMachineMappingSets
  process to machine mapping set LibProcessToMachineMappingSet_xh265_rtp_pusherProcess14
    process to machine mapping LibprocessToMachineMapping13: machine=Host0DpMachine, process=Libxh265_rtp_pusherProcess14
package /HuaweiMDC/exe_manifests/InstanceToPortMappings
  service instance to port prototype mapping LibRPortPrototype6_DdsRequiredServiceInstance160_PortMapping: port-prototype=xh265_rtp_pusher_rootswc.video_encoded_frame, process=Libxh265_rtp_pusherProcessDesign14, service-instance=LibRPortPrototype6_DdsRequiredServiceInstance160
package /HuaweiMDC/instance_manifests/requiredInstances
  dds required service instance LibRPortPrototype6_DdsRequiredServiceInstance160: service-interface-deployment=SensorImageServiceInterface_DdsDeployment, qos-profile=default_qos.xml, domain-id=30, transport-plugins=SHM, dds-event-qos-props=EventSensorImageDdsDeployment, required-service-instance-id=5046
package /HuaweiMDC/instance_manifests/instanceToMachineMappings
  dds service instance to machine mapping LibRPortPrototype6_DdsRequiredServiceInstance160_ToDdsMachineMapping: communication-connector=Host0DpEthernetCommConnector, service-instance=LibRPortPrototype6_DdsRequiredServiceInstance160
