AUTOSAR XML (schema 00048)
package /HuaweiMDC/process_manifests/processDesigns
  process design OdometryProcessDesign26: executable=Odometry
package /HuaweiMDC/process_manifests/processes
  process OdometryProcess26: design=OdometryProcessDesign26, executable=Odometry, log-trace-default-log-level=INFO, log-trace-log-modes=NETWORK
package /HuaweiMDC/process_manifests/processToMachineMappingSets
  process to machine mapping set ProcessToMachineMappingSet_OdometryProcess26
    process to machine mapping processToMachineMapping25: machine=Host0DpMachine, process=OdometryProcess26
package /HuaweiMDC/exe_manifests/InstanceToPortMappings
  5 x service instance to port prototype mapping, all with process=OdometryProcessDesign26:
    RPortPrototype4_DdsRequiredServiceInstance111_PortMapping: port-prototype=OdometryExecutable26Prototype.tpsensorgps, service-instance=RPortPrototype4_DdsRequiredServiceInstance111
    RPortPrototype1_DdsRequiredServiceInstance40_PortMapping: port-prototype=OdometryExecutable26Prototype.tpwheelspeed, service-instance=RPortPrototype1_DdsRequiredServiceInstance40
    RPortPrototype3_DdsRequiredServiceInstance110_PortMapping: port-prototype=OdometryExecutable26Prototype.tpimu, service-instance=RPortPrototype3_DdsRequiredServiceInstance110
    tpododr_DdsProvidedServiceInstance37_PortMapping: port-prototype=OdometryExecutable26Prototype.tpododr, service-instance=tpododr_DdsProvidedServiceInstance37
    RPortPrototype2_DdsRequiredServiceInstance41_PortMapping: port-prototype=OdometryExecutable26Prototype.tpsensorimu, service-instance=RPortPrototype2_DdsRequiredServiceInstance41
package /HuaweiMDC/instance_manifests/requiredInstances
  4 x dds required service instance, all with qos-profile=default_qos.xml, domain-id=30, transport-plugins=SHM:
    RPortPrototype4_DdsRequiredServiceInstance111: service-interface-deployment=SensorGpsServiceInterface_DdsDeployment, dds-event-qos-props=EventGpsDdsDeployment, required-service-instance-id=20244
    RPortPrototype1_DdsRequiredServiceInstance40: service-interface-deployment=SensorWheelSpeedServiceInterface_DdsDeployment, dds-event-qos-props=EventWheelSpeedDdsDeployment, required-service-instance-id=20204
    RPortPrototype3_DdsRequiredServiceInstance110: service-interface-deployment=LocationDdsInterfaceDeployment, dds-event-qos-props=LocationEventDeployment, required-service-instance-id=20229
    RPortPrototype2_DdsRequiredServiceInstance41: service-interface-deployment=SensorImuServiceInterface_DdsDeployment, dds-event-qos-props=EventSensorImuDdsDeployment, required-service-instance-id=20223
package /HuaweiMDC/instance_manifests/instanceToMachineMappings
  5 x dds service instance to machine mapping, all with communication-connector=Host0DpEthernetCommConnector:
    RPortPrototype4_DdsRequiredServiceInstance111_ToDdsMachineMapping: service-instance=RPortPrototype4_DdsRequiredServiceInstance111
    RPortPrototype1_DdsRequiredServiceInstance40_ToDdsMachineMapping: service-instance=RPortPrototype1_DdsRequiredServiceInstance40
    RPortPrototype3_DdsRequiredServiceInstance110_ToDdsMachineMapping: service-instance=RPortPrototype3_DdsRequiredServiceInstance110
    tpododr_DdsProvidedServiceInstance37_ToDdsMachineMapping: service-instance=tpododr_DdsProvidedServiceInstance37
    RPortPrototype2_DdsRequiredServiceInstance41_ToDdsMachineMapping: service-instance=RPortPrototype2_DdsRequiredServiceInstance41
package /HuaweiMDC/instance_manifests/providedInstances
  dds provided service instance tpododr_DdsProvidedServiceInstance37: service-interface-deployment=LocationInfoDdsInterfaceDeployment, qos-profile=default_qos.xml, domain-id=30, transport-plugins=SHM, dds-event-qos-props=LocationInfoEventDeployment, service-instance-id=20209
