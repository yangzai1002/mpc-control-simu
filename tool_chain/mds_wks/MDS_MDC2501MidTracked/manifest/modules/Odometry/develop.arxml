AUTOSAR XML (schema 00048)
package /HuaweiMDC/exe_manifests/exes
  executable Odometry: logging-behavior=USES-LOGGING, reporting-behavior=REPORTS-EXECUTION-STATE
    root sw component prototype OdometryExecutable26Prototype: application-type=OdometryCompositionSwComponentType26
package /HuaweiMDC/Common/Common
  composition sw component type OdometryCompositionSwComponentType26
    component OdometryPrototype: type=odometry_base
