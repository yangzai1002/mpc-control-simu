AUTOSAR XML (schema 00048)
package /HuaweiMDC/exe_manifests/swcs
  executable driver_dev_null
    root sw component prototype driver_dev_null_rootswc: application-type=driver_dev_null
