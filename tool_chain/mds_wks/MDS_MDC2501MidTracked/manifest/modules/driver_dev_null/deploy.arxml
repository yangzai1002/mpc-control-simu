AUTOSAR XML (schema 00048)
package /HuaweiMDC/process_manifests/processDesigns
  process design Libdriver_dev_nullProcessDesign37: executable=driver_dev_null
package /HuaweiMDC/process_manifests/processes
  process Libdriver_dev_nullProcess37: design=Libdriver_dev_nullProcessDesign37, executable=driver_dev_null, log-trace-default-log-level=INFO, log-trace-log-modes=NETWORK
package /HuaweiMDC/process_manifests/processToMachineMappingSets
  process to machine mapping set LibProcessToMachineMappingSet_driver_dev_nullProcess37
    process to machine mapping LibprocessToMachineMapping36: machine=Host0DpMachine, process=Libdriver_dev_nullProcess37
package /HuaweiMDC/exe_manifests/InstanceToPortMappings
  5 x service instance to port prototype mapping, all with process=Libdriver_dev_nullProcessDesign37:
    LibRPortPrototype6_DdsRequiredServiceInstance159_PortMapping: port-prototype=driver_dev_null_rootswc.RPortPrototype6, service-instance=LibRPortPrototype6_DdsRequiredServiceInstance159
    LibRPortPrototype5_DdsRequiredServiceInstance158_PortMapping: port-prototype=driver_dev_null_rootswc.RPortPrototype5, service-instance=LibRPortPrototype5_DdsRequiredServiceInstance158
    LibRPortPrototype1_DdsRequiredServiceInstance154_PortMapping: port-prototype=driver_dev_null_rootswc.RPortPrototype1, service-instance=LibRPortPrototype1_DdsRequiredServiceInstance154
    LibRPortPrototype7_DdsRequiredServiceInstance160_PortMapping: port-prototype=driver_dev_null_rootswc.RPortPrototype7, service-instance=LibRPortPrototype7_DdsRequiredServiceInstance160
    LibRPortPrototype2_DdsRequiredServiceInstance155_PortMapping: port-prototype=driver_dev_null_rootswc.RPortPrototype2, service-instance=LibRPortPrototype2_DdsRequiredServiceInstance155
package /HuaweiMDC/instance_manifests/requiredInstances
  5 x dds required service instance, all with qos-profile=default_qos.xml, domain-id=30, transport-plugins=SHM:
    LibRPortPrototype6_DdsRequiredServiceInstance159: service-interface-deployment=SensorLidarPacketServiceInterface_DdsDeployment, dds-event-qos-props=EventLidarPacketDdsDeployment, required-service-instance-id=5126
    LibRPortPrototype5_DdsRequiredServiceInstance158: service-interface-deployment=SensorLidarPacketServiceInterface_DdsDeployment, dds-event-qos-props=EventLidarPacketDdsDeployment, required-service-instance-id=5127
    LibRPortPrototype1_DdsRequiredServiceInstance154: service-interface-deployment=SensorCompressedImageListServiceInterface_DdsDeployment, dds-event-qos-props=EventCompressedImageListDdsDeployment, required-service-instance-id=5128
    LibRPortPrototype7_DdsRequiredServiceInstance160: service-interface-deployment=SensorLidarPacketServiceInterface_DdsDeployment, dds-event-qos-props=EventLidarPacketDdsDeployment, required-service-instance-id=5129
    LibRPortPrototype2_DdsRequiredServiceInstance155: service-interface-deployment=SensorRadarPacketServiceInterface_DdsDeployment, dds-event-qos-props=EventSensorRadarPacketDdsDeployment, required-service-instance-id=5130
package /HuaweiMDC/instance_manifests/instanceToMachineMappings
  5 x dds service instance to machine mapping, all with communication-connector=Host0DpEthernetCommConnector:
    LibRPortPrototype6_DdsRequiredServiceInstance159_ToDdsMachineMapping: service-instance=LibRPortPrototype6_DdsRequiredServiceInstance159
    LibRPortPrototype5_DdsRequiredServiceInstance158_ToDdsMachineMapping: service-instance=LibRPortPrototype5_DdsRequiredServiceInstance158
    LibRPortPrototype1_DdsRequiredServiceInstance154_ToDdsMachineMapping: service-instance=LibRPortPrototype1_DdsRequiredServiceInstance154
    LibRPortPrototype7_DdsRequiredServiceInstance160_ToDdsMachineMapping: service-instance=LibRPortPrototype7_DdsRequiredServiceInstance160
    LibRPortPrototype2_DdsRequiredServiceInstance155_ToDdsMachineMapping: service-instance=LibRPortPrototype2_DdsRequiredServiceInstance155
