AUTOSAR XML (schema 00048)
package /HuaweiMDC/exe_manifests/swcs
  executable hw_l106_lidar
    root sw component prototype hw_l106_lidar_rootswc: application-type=hw_l106_lidar
