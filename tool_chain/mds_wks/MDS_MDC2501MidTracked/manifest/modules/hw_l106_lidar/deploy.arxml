AUTOSAR XML (schema 00048)
package /HuaweiMDC/process_manifests/processDesigns
  process design Libhw_l106_lidarProcessDesign5: executable=hw_l106_lidar
package /HuaweiMDC/process_manifests/processes
  process Libhw_l106_lidarProcess5: design=Libhw_l106_lidarProcessDesign5, executable=hw_l106_lidar, log-trace-default-log-level=INFO, log-trace-log-modes=NETWORK
package /HuaweiMDC/process_manifests/processToMachineMappingSets
  process to machine mapping set LibProcessToMachineMappingSet_hw_l106_lidarProcess5
    process to machine mapping LibprocessToMachineMapping4: machine=Host0DpMachine, process=Libhw_l106_lidarProcess5
package /HuaweiMDC/exe_manifests/InstanceToPortMappings
  6 x service instance to port prototype mapping, all with process=Libhw_l106_lidarProcessDesign5:
    Liblidarpackets_DdsProvidedServiceInstance47_PortMapping: port-prototype=hw_l106_lidar_rootswc.lidarpackets, service-instance=Liblidarpackets_DdsProvidedServiceInstance47
    LibPointCloudPPortPrototype_DdsProvidedServiceInstance2_PortMapping: port-prototype=hw_l106_lidar_rootswc.lidarpoints, service-instance=LibPointCloudPPortPrototype_DdsProvidedServiceInstance2
    Liblidarpackets_DdsProvidedServiceInstance46_PortMapping: port-prototype=hw_l106_lidar_rootswc.lidarpackets, service-instance=Liblidarpackets_DdsProvidedServiceInstance46
    LibPointCloudPPortPrototype_DdsProvidedServiceInstance4_PortMapping: port-prototype=hw_l106_lidar_rootswc.lidarpoints, service-instance=LibPointCloudPPortPrototype_DdsProvidedServiceInstance4
    LibPointCloudPPortPrototype_DdsProvidedServiceInstance3_PortMapping: port-prototype=hw_l106_lidar_rootswc.lidarpoints, service-instance=LibPointCloudPPortPrototype_DdsProvidedServiceInstance3
    Liblidarpackets_DdsProvidedServiceInstance45_PortMapping: port-prototype=hw_l106_lidar_rootswc.lidarpackets, service-instance=Liblidarpackets_DdsProvidedServiceInstance45
package /HuaweiMDC/instance_manifests/providedInstances
  6 x dds provided service instance, all with qos-profile=default_qos.xml, domain-id=30, transport-plugins=SHM:
    Liblidarpackets_DdsProvidedServiceInstance47: service-interface-deployment=SensorLidarPacketServiceInterface_DdsDeployment, dds-event-qos-props=EventLidarPacketDdsDeployment, service-instance-id=5078
    LibPointCloudPPortPrototype_DdsProvidedServiceInstance2: service-interface-deployment=SensorLidarPointCloudServiceInterface_DdsDeployment, dds-event-qos-props=EventPointCloud2DdsDeployment, service-instance-id=5079
    Liblidarpackets_DdsProvidedServiceInstance46: service-interface-deployment=SensorLidarPacketServiceInterface_DdsDeployment, dds-event-qos-props=EventLidarPacketDdsDeployment, service-instance-id=5080
    LibPointCloudPPortPrototype_DdsProvidedServiceInstance4: service-interface-deployment=SensorLidarPointCloudServiceInterface_DdsDeployment, dds-event-qos-props=EventPointCloud2DdsDeployment, service-instance-id=5081
    LibPointCloudPPortPrototype_DdsProvidedServiceInstance3: service-interface-deployment=SensorLidarPointCloudServiceInterface_DdsDeployment, dds-event-qos-props=EventPointCloud2DdsDeployment, service-instance-id=5082
    Liblidarpackets_DdsProvidedServiceInstance45: service-interface-deployment=SensorLidarPacketServiceInterface_DdsDeployment, dds-event-qos-props=EventLidarPacketDdsDeployment, service-instance-id=5083
package /HuaweiMDC/instance_manifests/instanceToMachineMappings
  6 x dds service instance to machine mapping, all with communication-connector=Host0DpEthernetCommConnector:
    Liblidarpackets_DdsProvidedServiceInstance47_ToDdsMachineMapping: service-instance=Liblidarpackets_DdsProvidedServiceInstance47
    LibPointCloudPPortPrototype_DdsProvidedServiceInstance2_ToDdsMachineMapping: service-instance=LibPointCloudPPortPrototype_DdsProvidedServiceInstance2
    Liblidarpackets_DdsProvidedServiceInstance46_ToDdsMachineMapping: service-instance=Liblidarpackets_DdsProvidedServiceInstance46
    LibPointCloudPPortPrototype_DdsProvidedServiceInstance4_ToDdsMachineMapping: service-instance=LibPointCloudPPortPrototype_DdsProvidedServiceInstance4
    LibPointCloudPPortPrototype_DdsProvidedServiceInstance3_ToDdsMachineMapping: service-instance=LibPointCloudPPortPrototype_DdsProvidedServiceInstance3
    Liblidarpackets_DdsProvidedServiceInstance45_ToDdsMachineMapping: service-instance=Liblidarpackets_DdsProvidedServiceInstance45
