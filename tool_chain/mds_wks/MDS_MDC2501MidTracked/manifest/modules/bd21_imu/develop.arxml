AUTOSAR XML (schema 00048)
package /HuaweiMDC/exe_manifests/swcs
  executable bd21_imu
    root sw component prototype bd21_imu_rootswc: application-type=bd21_imu
