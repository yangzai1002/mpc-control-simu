AUTOSAR XML (schema 00048)
package /HuaweiMDC/process_manifests/processDesigns
  process design Libbd21_imuProcessDesign6: executable=bd21_imu
package /HuaweiMDC/process_manifests/processes
  process Libbd21_imuProcess6: design=Libbd21_imuProcessDesign6, executable=bd21_imu, log-trace-default-log-level=INFO, log-trace-log-modes=NETWORK
package /HuaweiMDC/process_manifests/processToMachineMappingSets
  process to machine mapping set LibProcessToMachineMappingSet_bd21_imuProcess6
    process to machine mapping LibprocessToMachineMapping5: machine=Host0DpMachine, process=Libbd21_imuProcess6
package /HuaweiMDC/exe_manifests/InstanceToPortMappings
  4 x service instance to port prototype mapping, all with process=Libbd21_imuProcessDesign6:
    Libivsensorgps_DdsProvidedServiceInstance45_PortMapping: port-prototype=bd21_imu_rootswc.ivsensorgps, service-instance=Libivsensorgps_DdsProvidedServiceInstance45
    LibImuPPortPrototype_DdsProvidedServiceInstance25_PortMapping: port-prototype=bd21_imu_rootswc.ivsensorimu, service-instance=LibImuPPortPrototype_DdsProvidedServiceInstance25
    LibWheelSpeedPPortPrototype_DdsProvidedServiceInstance23_PortMapping: port-prototype=bd21_imu_rootswc.ivwheelspeed, service-instance=LibWheelSpeedPPortPrototype_DdsProvidedServiceInstance23
    Libtpimu_DdsProvidedServiceInstance30_PortMapping: port-prototype=bd21_imu_rootswc.tpimu, service-instance=Libtpimu_DdsProvidedServiceInstance30
package /HuaweiMDC/instance_manifests/providedInstances
  4 x dds provided service instance, all with qos-profile=default_qos.xml, domain-id=30, transport-plugins=SHM:
    Libivsensorgps_DdsProvidedServiceInstance45: service-interface-deployment=SensorGpsServiceInterface_DdsDeployment, dds-event-qos-props=EventGpsDdsDeployment, service-instance-id=5111
    LibImuPPortPrototype_DdsProvidedServiceInstance25: service-interface-deployment=SensorImuServiceInterface_DdsDeployment, dds-event-qos-props=EventSensorImuDdsDeployment, service-instance-id=5112
    LibWheelSpeedPPortPrototype_DdsProvidedServiceInstance23: service-interface-deployment=SensorWheelSpeedServiceInterface_DdsDeployment, dds-event-qos-props=EventWheelSpeedDdsDeployment, service-instance-id=5113
    Libtpimu_DdsProvidedServiceInstance30: service-interface-deployment=LocationDdsInterfaceDeployment, dds-event-qos-props=LocationEventDeployment, service-instance-id=5114
package /HuaweiMDC/instance_manifests/instanceToMachineMappings
  4 x dds service instance to machine mapping, all with communication-connector=Host0DpEthernetCommConnector:
    Libivsensorgps_DdsProvidedServiceInstance45_ToDdsMachineMapping: service-instance=Libivsensorgps_DdsProvidedServiceInstance45
    LibImuPPortPrototype_DdsProvidedServiceInstance25_ToDdsMachineMapping: service-instance=LibImuPPortPrototype_DdsProvidedServiceInstance25
    LibWheelSpeedPPortPrototype_DdsProvidedServiceInstance23_ToDdsMachineMapping: service-instance=LibWheelSpeedPPortPrototype_DdsProvidedServiceInstance23
    Libtpimu_DdsProvidedServiceInstance30_ToDdsMachineMapping: service-instance=Libtpimu_DdsProvidedServiceInstance30
