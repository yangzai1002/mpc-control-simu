AUTOSAR XML (schema 00048)
package /HuaweiMDC/process_manifests/processDesigns
  process design LocationProcessDesign27: executable=Location
package /HuaweiMDC/process_manifests/processes
  process LocationProcess27: design=LocationProcessDesign27, executable=Location, log-trace-default-log-level=INFO, log-trace-log-modes=NETWORK
package /HuaweiMDC/process_manifests/processToMachineMappingSets
  process to machine mapping set ProcessToMachineMappingSet_LocationProcess27
    process to machine mapping processToMachineMapping26: machine=Host0DpMachine, process=LocationProcess27
package /HuaweiMDC/exe_manifests/InstanceToPortMappings
  11 x service instance to port prototype mapping, all with process=LocationProcessDesign27:
    RPortPrototype5_DdsRequiredServiceInstance111_PortMapping: port-prototype=LocationExecutable27Prototype.tpimu, service-instance=RPortPrototype5_DdsRequiredServiceInstance111
    tpimu_DdsRequiredServiceInstance185_PortMapping: port-prototype=LocationExecutable27Prototype.tpimu, service-instance=tpimu_DdsRequiredServiceInstance185
    RPortPrototype6_DdsRequiredServiceInstance112_PortMapping: port-prototype=LocationExecutable27Prototype.tpwheelspeed, service-instance=RPortPrototype6_DdsRequiredServiceInstance112
    ivwheelspeed_DdsRequiredServiceInstance184_PortMapping: port-prototype=LocationExecutable27Prototype.tpwheelspeed, service-instance=ivwheelspeed_DdsRequiredServiceInstance184
    RPortPrototype8_DdsRequiredServiceInstance114_PortMapping: port-prototype=LocationExecutable27Prototype.tpododr, service-instance=RPortPrototype8_DdsRequiredServiceInstance114
    RPortPrototype1_DdsRequiredServiceInstance107_PortMapping: port-prototype=LocationExecutable27Prototype.tpfront_middle_lidar_points, service-instance=RPortPrototype1_DdsRequiredServiceInstance107
    RPortPrototype3_DdsRequiredServiceInstance109_PortMapping: port-prototype=LocationExecutable27Prototype.tpfront_right_lidar_points, service-instance=RPortPrototype3_DdsRequiredServiceInstance109
    RPortPrototype7_DdsRequiredServiceInstance113_PortMapping: port-prototype=LocationExecutable27Prototype.tpliodr, service-instance=RPortPrototype7_DdsRequiredServiceInstance113
    tpfusionloc_DdsProvidedServiceInstance38_PortMapping: port-prototype=LocationExecutable27Prototype.tpfusionloc, service-instance=tpfusionloc_DdsProvidedServiceInstance38
    RPortPrototype4_DdsRequiredServiceInstance110_PortMapping: port-prototype=LocationExecutable27Prototype.tpsensorimu, service-instance=RPortPrototype4_DdsRequiredServiceInstance110
    ivwheelspeed_DdsRequiredServiceInstance186_PortMapping: port-prototype=LocationExecutable27Prototype.tpwheelspeed, service-instance=ivwheelspeed_DdsRequiredServiceInstance186
package /HuaweiMDC/instance_manifests/requiredInstances
  10 x dds required service instance, all with qos-profile=default_qos.xml, domain-id=30, transport-plugins=SHM:
    RPortPrototype5_DdsRequiredServiceInstance111: service-interface-deployment=LocationDdsInterfaceDeployment, dds-event-qos-props=LocationEventDeployment, required-service-instance-id=20229
    tpimu_DdsRequiredServiceInstance185: service-interface-deployment=LocationDdsInterfaceDeployment, dds-event-qos-props=LocationEventDeployment, required-service-instance-id=20229
    RPortPrototype6_DdsRequiredServiceInstance112: service-interface-deployment=SensorWheelSpeedServiceInterface_DdsDeployment, dds-event-qos-props=EventWheelSpeedDdsDeployment, required-service-instance-id=20204
    ivwheelspeed_DdsRequiredServiceInstance184: service-interface-deployment=SensorWheelSpeedServiceInterface_DdsDeployment, dds-event-qos-props=EventWheelSpeedDdsDeployment, required-service-instance-id=20204
    RPortPrototype8_DdsRequiredServiceInstance114: service-interface-deployment=LocationInfoDdsInterfaceDeployment, dds-event-qos-props=LocationInfoEventDeployment, required-service-instance-id=20209
    RPortPrototype1_DdsRequiredServiceInstance107: service-interface-deployment=SensorLidarPointCloudServiceInterface_DdsDeployment, dds-event-qos-props=EventPointCloud2DdsDeployment, required-service-instance-id=20201
    RPortPrototype3_DdsRequiredServiceInstance109: service-interface-deployment=SensorLidarPointCloudServiceInterface_DdsDeployment, dds-event-qos-props=EventPointCloud2DdsDeployment, required-service-instance-id=20203
    RPortPrototype7_DdsRequiredServiceInstance113: service-interface-deployment=LocationInfoDdsInterfaceDeployment, dds-event-qos-props=LocationInfoEventDeployment, required-service-instance-id=20206
    RPortPrototype4_DdsRequiredServiceInstance110: service-interface-deployment=SensorImuServiceInterface_DdsDeployment, dds-event-qos-props=EventSensorImuDdsDeployment, required-service-instance-id=20223
    ivwheelspeed_DdsRequiredServiceInstance186: service-interface-deployment=SensorWheelSpeedServiceInterface_DdsDeployment, dds-event-qos-props=EventWheelSpeedDdsDeployment, required-service-instance-id=20204
package /HuaweiMDC/instance_manifests/instanceToMachineMappings
  14 x dds service instance to machine mapping, all with communication-connector=Host0DpEthernetCommConnector:
    RPortPrototype5_DdsRequiredServiceInstance111_ToDdsMachineMapping: service-instance=RPortPrototype5_DdsRequiredServiceInstance111
    tpimu_DdsRequiredServiceInstance185_ToDdsMachineMapping: service-instance=tpimu_DdsRequiredServiceInstance185
    RPortPrototype6_DdsRequiredServiceInstance112_ToDdsMachineMapping: service-instance=RPortPrototype6_DdsRequiredServiceInstance112
    ivwheelspeed_DdsRequiredServiceInstance184_ToDdsMachineMapping: service-instance=ivwheelspeed_DdsRequiredServiceInstance184
    RPortPrototype8_DdsRequiredServiceInstance114_ToDdsMachineMapping: service-instance=RPortPrototype8_DdsRequiredServiceInstance114
    RPortPrototype1_DdsRequiredServiceInstance107_ToDdsMachineMapping: service-instance=RPortPrototype1_DdsRequiredServiceInstance107
    RPortPrototype1_DdsRequiredServiceInstance107_ToDdsMachineMapping: service-instance=RPortPrototype1_DdsRequiredServiceInstance107
    RPortPrototype3_DdsRequiredServiceInstance109_ToDdsMachineMapping: service-instance=RPortPrototype3_DdsRequiredServiceInstance109
    RPortPrototype3_DdsRequiredServiceInstance109_ToDdsMachineMapping: service-instance=RPortPrototype3_DdsRequiredServiceInstance109
    RPortPrototype7_DdsRequiredServiceInstance113_ToDdsMachineMapping: service-instance=RPortPrototype7_DdsRequiredServiceInstance113
    tpfusionloc_DdsProvidedServiceInstance38_ToDdsMachineMapping: service-instance=tpfusionloc_DdsProvidedServiceInstance38
    RPortPrototype4_DdsRequiredServiceInstance110_ToDdsMachineMapping: service-instance=RPortPrototype4_DdsRequiredServiceInstance110
    RPortPrototype4_DdsRequiredServiceInstance110_ToDdsMachineMapping: service-instance=RPortPrototype4_DdsRequiredServiceInstance110
    ivwheelspeed_DdsRequiredServiceInstance186_ToDdsMachineMapping: service-instance=ivwheelspeed_DdsRequiredServiceInstance186
package /HuaweiMDC/instance_manifests/providedInstances
  dds provided service instance tpfusionloc_DdsProvidedServiceInstance38: service-interface-deployment=LocationInfoDdsInterfaceDeployment, qos-profile=default_qos.xml, domain-id=30, transport-plugins=SHM, dds-event-qos-props=LocationInfoEventDeployment, service-instance-id=20218
