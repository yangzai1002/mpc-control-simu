AUTOSAR XML (schema 00048)
package /HuaweiMDC/exe_manifests/exes
  executable Location: logging-behavior=USES-LOGGING, reporting-behavior=REPORTS-EXECUTION-STATE
    root sw component prototype LocationExecutable27Prototype: application-type=LocationCompositionSwComponentType27
package /HuaweiMDC/Common/Common
  composition sw component type LocationCompositionSwComponentType27
    component LocationPrototype: type=fusion_location_base
