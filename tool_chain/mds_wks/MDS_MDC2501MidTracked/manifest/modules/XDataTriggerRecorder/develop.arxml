AUTOSAR XML (schema 00048)
package /HuaweiMDC/exe_manifests/exes
  executable XDataTriggerRecorder: logging-behavior=USES-LOGGING, reporting-behavior=REPORTS-EXECUTION-STATE
    root sw component prototype xdata_trigger_recorder_baseExecutable46Prototype: application-type=xdata_trigger_recorder_baseCompositionSwComponentType46
package /HuaweiMDC/Common/Common
  composition sw component type xdata_trigger_recorder_baseCompositionSwComponentType46
    component xdata_trigger_recorder_basePrototype: type=xdata_trigger_recorder_base
