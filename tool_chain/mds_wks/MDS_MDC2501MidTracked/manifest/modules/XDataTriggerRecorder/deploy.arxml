AUTOSAR XML (schema 00048)
package /HuaweiMDC/process_manifests/processDesigns
  process design xdata_trigger_recorder_baseProcessDesign46: executable=XDataTriggerRecorder
package /HuaweiMDC/process_manifests/processes
  process xdata_trigger_recorder_baseProcess46: design=xdata_trigger_recorder_baseProcessDesign46, executable=XDataTriggerRecorder, log-trace-default-log-level=INFO, log-trace-log-modes=NETWORK
package /HuaweiMDC/process_manifests/processToMachineMappingSets
  process to machine mapping set ProcessToMachineMappingSet_xdata_trigger_recorder_baseProcess46
    process to machine mapping processToMachineMapping45: machine=Host0DpMachine, process=xdata_trigger_recorder_baseProcess46
package /HuaweiMDC/exe_manifests/InstanceToPortMappings
  service instance to port prototype mapping bag_ondemand_status_DdsProvidedServiceInstance25_PortMapping: port-prototype=xdata_trigger_recorder_baseExecutable46Prototype.bag_ondemand_status, process=xdata_trigger_recorder_baseProcessDesign46, service-instance=bag_ondemand_status_DdsProvidedServiceInstance25
  service instance to port prototype mapping RPortPrototype2_DdsRequiredServiceInstance167_PortMapping: port-prototype=xdata_trigger_recorder_baseExecutable46Prototype.tpfault_data, process=xdata_trigger_recorder_baseProcessDesign46, service-instance=RPortPrototype2_DdsRequiredServiceInstance167
package /HuaweiMDC/instance_manifests/providedInstances
  dds provided service instance bag_ondemand_status_DdsProvidedServiceInstance25: service-interface-deployment=BagStatusServiceInterface_DdsDeployment, qos-profile=default_qos.xml, domain-id=30, transport-plugins=SHM, dds-event-qos-props=EventBagStatusDdsDeployment, service-instance-id=20216
package /HuaweiMDC/instance_manifests/instanceToMachineMappings
  dds service instance to machine mapping bag_ondemand_status_DdsProvidedServiceInstance25_ToDdsMachineMapping: communication-connector=Host0DpEthernetCommConnector, service-instance=bag_ondemand_status_DdsProvidedServiceInstance25
  dds service instance to machine mapping RPortPrototype2_DdsRequiredServiceInstance167_ToDdsMachineMapping: communication-connector=Host0DpEthernetCommConnector, service-instance=RPortPrototype2_DdsRequiredServiceInstance167
package /HuaweiMDC/instance_manifests/requiredInstances
  dds required service instance RPortPrototype2_DdsRequiredServiceInstance167: service-interface-deployment=FaultDataServiceInterface_DdsDeployment, qos-profile=default_qos.xml, domain-id=30, transport-plugins=SHM, dds-event-qos-props=EventFaultDataDdsDeployment, required-service-instance-id=20220
