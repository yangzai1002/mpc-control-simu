AUTOSAR XML (schema 00048)
package /HuaweiMDC/process_manifests/processDesigns
  process design LibLidarDetectionProcessDesign28: executable=lidar_det_base
package /HuaweiMDC/process_manifests/processes
  process LibLidarDetectionProcess28: design=LibLidarDetectionProcessDesign28, executable=lidar_det_base, log-trace-default-log-level=INFO, log-trace-log-modes=NETWORK
package /HuaweiMDC/process_manifests/processToMachineMappingSets
  process to machine mapping set LibProcessToMachineMappingSet_LidarDetectionProcess28
    process to machine mapping LibprocessToMachineMapping27: machine=Host0DpMachine, process=LibLidarDetectionProcess28
package /HuaweiMDC/exe_manifests/InstanceToPortMappings
  service instance to port prototype mapping Libtplidarobjects_DdsProvidedServiceInstance39_PortMapping: port-prototype=lidar_det_base_rootswc.tplidarobjects, process=LibLidarDetectionProcessDesign28, service-instance=Libtplidarobjects_DdsProvidedServiceInstance39
  service instance to port prototype mapping LibRPortPrototype1_DdsRequiredServiceInstance53_PortMapping: port-prototype=lidar_det_base_rootswc.tpfront_middle_lidar_points, process=LibLidarDetectionProcessDesign28, service-instance=LibRPortPrototype1_DdsRequiredServiceInstance53
package /HuaweiMDC/instance_manifests/providedInstances
  dds provided service instance Libtplidarobjects_DdsProvidedServiceInstance39: service-interface-deployment=Object3dArrayDdsInterfaceDeployment, qos-profile=default_qos.xml, domain-id=30, transport-plugins=SHM, dds-event-qos-props=Object3dArrayEventDeployment, service-instance-id=5011
package /HuaweiMDC/instance_manifests/instanceToMachineMappings
  dds service instance to machine mapping Libtplidarobjects_DdsProvidedServiceInstance39_ToDdsMachineMapping: communication-connector=Host0DpEthernetCommConnector, service-instance=Libtplidarobjects_DdsProvidedServiceInstance39
  dds service instance to machine mapping LibRPortPrototype1_DdsRequiredServiceInstance53_ToDdsMachineMapping: communication-connector=Host0DpEthernetCommConnector, service-instance=LibRPortPrototype1_DdsRequiredServiceInstance53
package /HuaweiMDC/instance_manifests/requiredInstances
  dds required service instance LibRPortPrototype1_DdsRequiredServiceInstance53: service-interface-deployment=SensorLidarPointCloudServiceInterface_DdsDeployment, qos-profile=default_qos.xml, domain-id=30, transport-plugins=SHM, dds-event-qos-props=EventPointCloud2DdsDeployment, required-service-instance-id=5012
