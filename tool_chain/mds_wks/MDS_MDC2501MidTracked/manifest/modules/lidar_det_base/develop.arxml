AUTOSAR XML (schema 00048)
package /HuaweiMDC/FunctionalSoftware/LidarDet/SwComponent
  executable lidar_det_base
    root sw component prototype lidar_det_base_rootswc: application-type=lidar_det_base
