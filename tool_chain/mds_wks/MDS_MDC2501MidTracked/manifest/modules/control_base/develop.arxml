AUTOSAR XML (schema 00048)
package /HuaweiMDC/FunctionalSoftware/Control/SwComponent
  executable control_base
    root sw component prototype control_base_rootswc: application-type=control_base
