AUTOSAR XML (schema 00048)
package /HuaweiMDC/process_manifests/processDesigns
  process design LibControlProcessDesign16: executable=control_base
package /HuaweiMDC/process_manifests/processes
  process LibControlProcess16: design=LibControlProcessDesign16, executable=control_base, log-trace-default-log-level=INFO, log-trace-log-modes=NETWORK
package /HuaweiMDC/process_manifests/processToMachineMappingSets
  process to machine mapping set LibProcessToMachineMappingSet_ControlProcess16
    process to machine mapping LibprocessToMachineMapping15: machine=Host0DpMachine, process=LibControlProcess16
package /HuaweiMDC/exe_manifests/InstanceToPortMappings
  6 x service instance to port prototype mapping, all with process=LibControlProcessDesign16:
    Libtppathplan_recv_DdsRequiredServiceInstance111_PortMapping: port-prototype=control_base_rootswc.tppathplan_recv, service-instance=Libtppathplan_recv_DdsRequiredServiceInstance111
    LibRPortPrototype2_DdsRequiredServiceInstance108_PortMapping: port-prototype=control_base_rootswc.tppathplan_recv, service-instance=LibRPortPrototype2_DdsRequiredServiceInstance108
    LibRPortPrototype3_DdsRequiredServiceInstance97_PortMapping: port-prototype=control_base_rootswc.tpfault_data, service-instance=LibRPortPrototype3_DdsRequiredServiceInstance97
    LibRPortPrototype8_DdsRequiredServiceInstance129_PortMapping: port-prototype=control_base_rootswc.tpfusionloc, service-instance=LibRPortPrototype8_DdsRequiredServiceInstance129
    LibRPortPrototype2_DdsRequiredServiceInstance14_PortMapping: port-prototype=control_base_rootswc.tpvehiclestate, service-instance=LibRPortPrototype2_DdsRequiredServiceInstance14
    Libtpvehicle_to_can_pre_aeb_DdsProvidedServiceInstance39_PortMapping: port-prototype=control_base_rootswc.tpvehicle_to_can_pre_aeb, service-instance=Libtpvehicle_to_can_pre_aeb_DdsProvidedServiceInstance39
package /HuaweiMDC/instance_manifests/requiredInstances
  5 x dds required service instance, all with qos-profile=default_qos.xml, domain-id=30, transport-plugins=SHM:
    Libtppathplan_recv_DdsRequiredServiceInstance111: service-interface-deployment=PlanningResultDdsInterfaceDeployment, dds-event-qos-props=PlanningResultEventDeployment, required-service-instance-id=5116
    LibRPortPrototype2_DdsRequiredServiceInstance108: service-interface-deployment=PlanningResultDdsInterfaceDeployment, dds-event-qos-props=PlanningResultEventDeployment, required-service-instance-id=5117
    LibRPortPrototype3_DdsRequiredServiceInstance97: service-interface-deployment=FaultDataServiceInterface_DdsDeployment, dds-event-qos-props=EventFaultDataDdsDeployment, required-service-instance-id=5118
    LibRPortPrototype8_DdsRequiredServiceInstance129: service-interface-deployment=LocationInfoDdsInterfaceDeployment, dds-event-qos-props=LocationInfoEventDeployment, required-service-instance-id=5119
    LibRPortPrototype2_DdsRequiredServiceInstance14: service-interface-deployment=VehicleInfomationServiceInterface_DdsDeployment, dds-event-qos-props=EventVehicleInfoDdsDeployment, required-service-instance-id=5120
package /HuaweiMDC/instance_manifests/instanceToMachineMappings
  6 x dds service instance to machine mapping, all with communication-connector=Host0DpEthernetCommConnector:
    Libtppathplan_recv_DdsRequiredServiceInstance111_ToDdsMachineMapping: service-instance=Libtppathplan_recv_DdsRequiredServiceInstance111
    LibRPortPrototype2_DdsRequiredServiceInstance108_ToDdsMachineMapping: service-instance=LibRPortPrototype2_DdsRequiredServiceInstance108
    LibRPortPrototype3_DdsRequiredServiceInstance97_ToDdsMachineMapping: service-instance=LibRPortPrototype3_DdsRequiredServiceInstance97
    LibRPortPrototype8_DdsRequiredServiceInstance129_ToDdsMachineMapping: service-instance=LibRPortPrototype8_DdsRequiredServiceInstance129
    LibRPortPrototype2_DdsRequiredServiceInstance14_ToDdsMachineMapping: service-instance=LibRPortPrototype2_DdsRequiredServiceInstance14
    Libtpvehicle_to_can_pre_aeb_DdsProvidedServiceInstance39_ToDdsMachineMapping: service-instance=Libtpvehicle_to_can_pre_aeb_DdsProvidedServiceInstance39
package /HuaweiMDC/instance_manifests/providedInstances
  dds provided service instance Libtpvehicle_to_can_pre_aeb_DdsProvidedServiceInstance39: service-interface-deployment=BodyCommandServiceInterface_DdsDeployment, qos-profile=default_qos.xml, domain-id=30, transport-plugins=SHM, dds-event-qos-props=EventVehicleActControlDdsDeployment, service-instance-id=5121
