AUTOSAR XML (schema 00048)
package /HuaweiMDC/exe_manifests/swcs
  executable xdata_trigger_recorder_base
    root sw component prototype xdata_trigger_recorder_base_rootswc: application-type=xdata_trigger_recorder_base
