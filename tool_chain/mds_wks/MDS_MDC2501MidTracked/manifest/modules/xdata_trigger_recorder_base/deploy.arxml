AUTOSAR XML (schema 00048)
package /HuaweiMDC/process_manifests/processDesigns
  process design Libxdata_trigger_recorder_baseProcessDesign46: executable=xdata_trigger_recorder_base
package /HuaweiMDC/process_manifests/processes
  process Libxdata_trigger_recorder_baseProcess46: design=Libxdata_trigger_recorder_baseProcessDesign46, executable=xdata_trigger_recorder_base, log-trace-default-log-level=INFO, log-trace-log-modes=NETWORK
package /HuaweiMDC/process_manifests/processToMachineMappingSets
  process to machine mapping set LibProcessToMachineMappingSet_xdata_trigger_recorder_baseProcess46
    process to machine mapping LibprocessToMachineMapping45: machine=Host0DpMachine, process=Libxdata_trigger_recorder_baseProcess46
package /HuaweiMDC/exe_manifests/InstanceToPortMappings
  service instance to port prototype mapping Libbag_ondemand_status_DdsProvidedServiceInstance25_PortMapping: port-prototype=xdata_trigger_recorder_base_rootswc.bag_ondemand_status, process=Libxdata_trigger_recorder_baseProcessDesign46, service-instance=Libbag_ondemand_status_DdsProvidedServiceInstance25
  service instance to port prototype mapping LibRPortPrototype2_DdsRequiredServiceInstance167_PortMapping: port-prototype=xdata_trigger_recorder_base_rootswc.tpfault_data, process=Libxdata_trigger_recorder_baseProcessDesign46, service-instance=LibRPortPrototype2_DdsRequiredServiceInstance167
package /HuaweiMDC/instance_manifests/providedInstances
  dds provided service instance Libbag_ondemand_status_DdsProvidedServiceInstance25: service-interface-deployment=BagStatusServiceInterface_DdsDeployment, qos-profile=default_qos.xml, domain-id=30, transport-plugins=SHM, dds-event-qos-props=EventBagStatusDdsDeployment, service-instance-id=5066
package /HuaweiMDC/instance_manifests/instanceToMachineMappings
  dds service instance to machine mapping Libbag_ondemand_status_DdsProvidedServiceInstance25_ToDdsMachineMapping: communication-connector=Host0DpEthernetCommConnector, service-instance=Libbag_ondemand_status_DdsProvidedServiceInstance25
  dds service instance to machine mapping LibRPortPrototype2_DdsRequiredServiceInstance167_ToDdsMachineMapping: communication-connector=Host0DpEthernetCommConnector, service-instance=LibRPortPrototype2_DdsRequiredServiceInstance167
package /HuaweiMDC/instance_manifests/requiredInstances
  dds required service instance LibRPortPrototype2_DdsRequiredServiceInstance167: service-interface-deployment=FaultDataServiceInterface_DdsDeployment, qos-profile=default_qos.xml, domain-id=30, transport-plugins=SHM, dds-event-qos-props=EventFaultDataDdsDeployment, required-service-instance-id=5067
