AUTOSAR XML (schema 00048)
package /HuaweiMDC/process_manifests/processDesigns
  process design hw_l106_lidarProcessDesign4: executable=HwL106LidarLeft
package /HuaweiMDC/process_manifests/processes
  process hw_l106_lidarProcess4: design=hw_l106_lidarProcessDesign4, executable=HwL106LidarLeft, log-trace-default-log-level=INFO, log-trace-log-modes=NETWORK
package /HuaweiMDC/process_manifests/processToMachineMappingSets
  process to machine mapping set ProcessToMachineMappingSet_hw_l106_lidarProcess4
    process to machine mapping processToMachineMapping3: machine=Host0DpMachine, process=hw_l106_lidarProcess4
package /HuaweiMDC/exe_manifests/InstanceToPortMappings
  service instance to port prototype mapping PointCloudPPortPrototype_DdsProvidedServiceInstance3_PortMapping: port-prototype=hw_l106_lidarExecutable4Prototype.lidarpoints, process=hw_l106_lidarProcessDesign4, service-instance=PointCloudPPortPrototype_DdsProvidedServiceInstance3
  service instance to port prototype mapping lidarpackets_DdsProvidedServiceInstance45_PortMapping: port-prototype=hw_l106_lidarExecutable4Prototype.lidarpackets, process=hw_l106_lidarProcessDesign4, service-instance=lidarpackets_DdsProvidedServiceInstance45
package /HuaweiMDC/instance_manifests/providedInstances
  dds provided service instance PointCloudPPortPrototype_DdsProvidedServiceInstance3: service-interface-deployment=SensorLidarPointCloudServiceInterface_DdsDeployment, qos-profile=default_qos.xml, domain-id=30, transport-plugins=SHM, dds-event-qos-props=EventPointCloud2DdsDeployment, service-instance-id=20202
  dds provided service instance lidarpackets_DdsProvidedServiceInstance45: service-interface-deployment=SensorLidarPacketServiceInterface_DdsDeployment, qos-profile=default_qos.xml, domain-id=30, transport-plugins=SHM, dds-event-qos-props=EventLidarPacketDdsDeployment, service-instance-id=20231
package /HuaweiMDC/instance_manifests/instanceToMachineMappings
  dds service instance to machine mapping PointCloudPPortPrototype_DdsProvidedServiceInstance3_ToDdsMachineMapping: communication-connector=Host0DpEthernetCommConnector, service-instance=PointCloudPPortPrototype_DdsProvidedServiceInstance3
  dds service instance to machine mapping lidarpackets_DdsProvidedServiceInstance45_ToDdsMachineMapping: communication-connector=Host0DpEthernetCommConnector, service-instance=lidarpackets_DdsProvidedServiceInstance45
