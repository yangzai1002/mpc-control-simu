AUTOSAR XML (schema 00048)
package /HuaweiMDC/exe_manifests/exes
  executable Planning: logging-behavior=USES-LOGGING, reporting-behavior=REPORTS-EXECUTION-STATE
    root sw component prototype PlanningExecutable31Prototype: application-type=PlanningCompositionSwComponentType31
package /HuaweiMDC/Common/Common
  composition sw component type PlanningCompositionSwComponentType31
    component PlanningPrototype: type=planning_base
