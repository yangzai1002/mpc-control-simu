AUTOSAR XML (schema 00048)
package /HuaweiMDC/process_manifests/processDesigns
  process design PlanningProcessDesign31: executable=Planning
package /HuaweiMDC/process_manifests/processes
  process PlanningProcess31: design=PlanningProcessDesign31, executable=Planning, log-trace-default-log-level=INFO, log-trace-log-modes=NETWORK
package /HuaweiMDC/process_manifests/processToMachineMappingSets
  process to machine mapping set ProcessToMachineMappingSet_PlanningProcess31
    process to machine mapping processToMachineMapping30: machine=Host0DpMachine, process=PlanningProcess31
package /HuaweiMDC/exe_manifests/InstanceToPortMappings
  5 x service instance to port prototype mapping, all with process=PlanningProcessDesign31:
    RPortPrototype3_DdsRequiredServiceInstance107_PortMapping: port-prototype=PlanningExecutable31Prototype.tpterrainmap, service-instance=RPortPrototype3_DdsRequiredServiceInstance107
    RPortPrototype2_DdsRequiredServiceInstance106_PortMapping: port-prototype=PlanningExecutable31Prototype.tptarget_obj, service-instance=RPortPrototype2_DdsRequiredServiceInstance106
    RPortPrototype2_DdsRequiredServiceInstance112_PortMapping: port-prototype=PlanningExecutable31Prototype.tpvehiclestate4, service-instance=RPortPrototype2_DdsRequiredServiceInstance112
    tppathplan_track_DdsProvidedServiceInstance32_PortMapping: port-prototype=PlanningExecutable31Prototype.tppathplan_track, service-instance=tppathplan_track_DdsProvidedServiceInstance32
    RPortPrototype2_DdsRequiredServiceInstance113_PortMapping: port-prototype=PlanningExecutable31Prototype.tpfusionloc, service-instance=RPortPrototype2_DdsRequiredServiceInstance113
package /HuaweiMDC/instance_manifests/requiredInstances
  4 x dds required service instance, all with qos-profile=default_qos.xml, domain-id=30, transport-plugins=SHM:
    RPortPrototype3_DdsRequiredServiceInstance107: service-interface-deployment=FusionObjectArrayDdsInterfaceDeployment, dds-event-qos-props=FusionObjectArrayEventDeployment, required-service-instance-id=20228
    RPortPrototype2_DdsRequiredServiceInstance106: service-interface-deployment=PerceptionStaticEnvServiceInterface_DdsDeployment, dds-event-qos-props=EventPerceptionStaticEnvDdsDeployment, required-service-instance-id=20208
    RPortPrototype2_DdsRequiredServiceInstance112: service-interface-deployment=VehicleInfomationServiceInterface_DdsDeployment, dds-event-qos-props=EventVehicleInfoDdsDeployment, required-service-instance-id=20205
    RPortPrototype2_DdsRequiredServiceInstance113: service-interface-deployment=LocationInfoDdsInterfaceDeployment, dds-event-qos-props=LocationInfoEventDeployment, required-service-instance-id=20218
package /HuaweiMDC/instance_manifests/instanceToMachineMappings
  5 x dds service instance to machine mapping, all with communication-connector=Host0DpEthernetCommConnector:
    RPortPrototype3_DdsRequiredServiceInstance107_ToDdsMachineMapping: service-instance=RPortPrototype3_DdsRequiredServiceInstance107
    RPortPrototype2_DdsRequiredServiceInstance106_ToDdsMachineMapping: service-instance=RPortPrototype2_DdsRequiredServiceInstance106
    RPortPrototype2_DdsRequiredServiceInstance112_ToDdsMachineMapping: service-instance=RPortPrototype2_DdsRequiredServiceInstance112
    tppathplan_track_DdsProvidedServiceInstance32_ToDdsMachineMapping: service-instance=tppathplan_track_DdsProvidedServiceInstance32
    RPortPrototype2_DdsRequiredServiceInstance113_ToDdsMachineMapping: service-instance=RPortPrototype2_DdsRequiredServiceInstance113
package /HuaweiMDC/instance_manifests/providedInstances
  dds provided service instance tppathplan_track_DdsProvidedServiceInstance32: service-interface-deployment=PlanningResultDdsInterfaceDeployment, qos-profile=default_qos.xml, domain-id=30, transport-plugins=SHM, dds-event-qos-props=PlanningResultEventDeployment, service-instance-id=20212
