AUTOSAR XML (schema 00048)
package /HuaweiMDC/exe_manifests/swcs
  executable fusion_semantic_map_base
    root sw component prototype fusion_semantic_map_base_rootswc: application-type=fusion_semantic_map_base
