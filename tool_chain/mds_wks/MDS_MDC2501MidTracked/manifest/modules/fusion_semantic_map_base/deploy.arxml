AUTOSAR XML (schema 00048)
package /HuaweiMDC/process_manifests/processDesigns
  process design Libfusion_semantic_map_baseProcessDesign11: executable=fusion_semantic_map_base
package /HuaweiMDC/process_manifests/processes
  process Libfusion_semantic_map_baseProcess11: design=Libfusion_semantic_map_baseProcessDesign11, executable=fusion_semantic_map_base, log-trace-default-log-level=INFO, log-trace-log-modes=NETWORK
package /HuaweiMDC/process_manifests/processToMachineMappingSets
  process to machine mapping set LibProcessToMachineMappingSet_fusion_semantic_map_baseProcess11
    process to machine mapping LibprocessToMachineMapping10: machine=Host0DpMachine, process=Libfusion_semantic_map_baseProcess11
package /HuaweiMDC/exe_manifests/InstanceToPortMappings
  10 x service instance to port prototype mapping, all with process=Libfusion_semantic_map_baseProcessDesign11:
    Liblidarpointsleft_DdsRequiredServiceInstance198_PortMapping: port-prototype=fusion_semantic_map_base_rootswc.tpfront_left_lidar_points, service-instance=Liblidarpointsleft_DdsRequiredServiceInstance198
    LibRPortPrototype13_DdsRequiredServiceInstance174_PortMapping: port-prototype=fusion_semantic_map_base_rootswc.tpfront_right_lidar_points, service-instance=LibRPortPrototype13_DdsRequiredServiceInstance174
    LibRPortPrototype14_DdsRequiredServiceInstance122_PortMapping: port-prototype=fusion_semantic_map_base_rootswc.tplocalization, service-instance=LibRPortPrototype14_DdsRequiredServiceInstance122
    LibRPortPrototype12_DdsRequiredServiceInstance120_PortMapping: port-prototype=fusion_semantic_map_base_rootswc.tpfront_left_lidar_points, service-instance=LibRPortPrototype12_DdsRequiredServiceInstance120
    LibRPortPrototype10_DdsRequiredServiceInstance172_PortMapping: port-prototype=fusion_semantic_map_base_rootswc.tpfront_middle_lidar_points, service-instance=LibRPortPrototype10_DdsRequiredServiceInstance172
    LibRPortPrototype13_DdsRequiredServiceInstance121_PortMapping: port-prototype=fusion_semantic_map_base_rootswc.tpfront_right_lidar_points, service-instance=LibRPortPrototype13_DdsRequiredServiceInstance121
    Liblidarpointsfront_DdsRequiredServiceInstance197_PortMapping: port-prototype=fusion_semantic_map_base_rootswc.tpfront_middle_lidar_points, service-instance=Liblidarpointsfront_DdsRequiredServiceInstance197
    LibRPortPrototype10_DdsRequiredServiceInstance119_PortMapping: port-prototype=fusion_semantic_map_base_rootswc.tpfront_middle_lidar_points, service-instance=LibRPortPrototype10_DdsRequiredServiceInstance119
    Liblidarpointsright_DdsRequiredServiceInstance199_PortMapping: port-prototype=fusion_semantic_map_base_rootswc.tpfront_right_lidar_points, service-instance=Liblidarpointsright_DdsRequiredServiceInstance199
    LibRPortPrototype12_DdsRequiredServiceInstance173_PortMapping: port-prototype=fusion_semantic_map_base_rootswc.tpfront_left_lidar_points, service-instance=LibRPortPrototype12_DdsRequiredServiceInstance173
package /HuaweiMDC/instance_manifests/requiredInstances
  10 x dds required service instance, all with qos-profile=default_qos.xml, domain-id=30, transport-plugins=SHM:
    Liblidarpointsleft_DdsRequiredServiceInstance198: service-interface-deployment=SensorLidarPointCloudServiceInterface_DdsDeployment, dds-event-qos-props=EventPointCloud2DdsDeployment, required-service-instance-id=5068
    LibRPortPrototype13_DdsRequiredServiceInstance174: service-interface-deployment=SensorLidarPointCloudServiceInterface_DdsDeployment, dds-event-qos-props=EventPointCloud2DdsDeployment, required-service-instance-id=5069
    LibRPortPrototype14_DdsRequiredServiceInstance122: service-interface-deployment=LocationInfoDdsInterfaceDeployment, dds-event-qos-props=LocationInfoEventDeployment, required-service-instance-id=5070
    LibRPortPrototype12_DdsRequiredServiceInstance120: service-interface-deployment=SensorLidarPointCloudServiceInterface_DdsDeployment, dds-event-qos-props=EventPointCloud2DdsDeployment, required-service-instance-id=5071
    LibRPortPrototype10_DdsRequiredServiceInstance172: service-interface-deployment=SensorLidarPointCloudServiceInterface_DdsDeployment, dds-event-qos-props=EventPointCloud2DdsDeployment, required-service-instance-id=5072
    LibRPortPrototype13_DdsRequiredServiceInstance121: service-interface-deployment=SensorLidarPointCloudServiceInterface_DdsDeployment, dds-event-qos-props=EventPointCloud2DdsDeployment, required-service-instance-id=5073
    Liblidarpointsfront_DdsRequiredServiceInstance197: service-interface-deployment=SensorLidarPointCloudServiceInterface_DdsDeployment, dds-event-qos-props=EventPointCloud2DdsDeployment, required-service-instance-id=5074
    LibRPortPrototype10_DdsRequiredServiceInstance119: service-interface-deployment=SensorLidarPointCloudServiceInterface_DdsDeployment, dds-event-qos-props=EventPointCloud2DdsDeployment, required-service-instance-id=5075
    Liblidarpointsright_DdsRequiredServiceInstance199: service-interface-deployment=SensorLidarPointCloudServiceInterface_DdsDeployment, dds-event-qos-props=EventPointCloud2DdsDeployment, required-service-instance-id=5076
    LibRPortPrototype12_DdsRequiredServiceInstance173: service-interface-deployment=SensorLidarPointCloudServiceInterface_DdsDeployment, dds-event-qos-props=EventPointCloud2DdsDeployment, required-service-instance-id=5077
package /HuaweiMDC/instance_manifests/instanceToMachineMappings
  10 x dds service instance to machine mapping, all with communication-connector=Host0DpEthernetCommConnector:
    Liblidarpointsleft_DdsRequiredServiceInstance198_ToDdsMachineMapping: service-instance=Liblidarpointsleft_DdsRequiredServiceInstance198
    LibRPortPrototype13_DdsRequiredServiceInstance174_ToDdsMachineMapping: service-instance=LibRPortPrototype13_DdsRequiredServiceInstance174
    LibRPortPrototype14_DdsRequiredServiceInstance122_ToDdsMachineMapping: service-instance=LibRPortPrototype14_DdsRequiredServiceInstance122
    LibRPortPrototype12_DdsRequiredServiceInstance120_ToDdsMachineMapping: service-instance=LibRPortPrototype12_DdsRequiredServiceInstance120
    LibRPortPrototype10_DdsRequiredServiceInstance172_ToDdsMachineMapping: service-instance=LibRPortPrototype10_DdsRequiredServiceInstance172
    LibRPortPrototype13_DdsRequiredServiceInstance121_ToDdsMachineMapping: service-instance=LibRPortPrototype13_DdsRequiredServiceInstance121
    Liblidarpointsfront_DdsRequiredServiceInstance197_ToDdsMachineMapping: service-instance=Liblidarpointsfront_DdsRequiredServiceInstance197
    LibRPortPrototype10_DdsRequiredServiceInstance119_ToDdsMachineMapping: service-instance=LibRPortPrototype10_DdsRequiredServiceInstance119
    Liblidarpointsright_DdsRequiredServiceInstance199_ToDdsMachineMapping: service-instance=Liblidarpointsright_DdsRequiredServiceInstance199
    LibRPortPrototype12_DdsRequiredServiceInstance173_ToDdsMachineMapping: service-instance=LibRPortPrototype12_DdsRequiredServiceInstance173
