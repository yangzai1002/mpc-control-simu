AUTOSAR XML (schema 00048)
package /HuaweiMDC/process_manifests/processDesigns
  process design LibPlanningProcessDesign31: executable=planning_base
package /HuaweiMDC/process_manifests/processes
  process LibPlanningProcess31: design=LibPlanningProcessDesign31, executable=planning_base, log-trace-default-log-level=INFO, log-trace-log-modes=NETWORK
package /HuaweiMDC/process_manifests/processToMachineMappingSets
  process to machine mapping set LibProcessToMachineMappingSet_PlanningProcess31
    process to machine mapping LibprocessToMachineMapping30: machine=Host0DpMachine, process=LibPlanningProcess31
package /HuaweiMDC/exe_manifests/InstanceToPortMappings
  5 x service instance to port prototype mapping, all with process=LibPlanningProcessDesign31:
    LibRPortPrototype3_DdsRequiredServiceInstance107_PortMapping: port-prototype=planning_base_rootswc.tpterrainmap, service-instance=LibRPortPrototype3_DdsRequiredServiceInstance107
    LibRPortPrototype2_DdsRequiredServiceInstance106_PortMapping: port-prototype=planning_base_rootswc.tptarget_obj, service-instance=LibRPortPrototype2_DdsRequiredServiceInstance106
    LibRPortPrototype2_DdsRequiredServiceInstance112_PortMapping: port-prototype=planning_base_rootswc.tpvehiclestate4, service-instance=LibRPortPrototype2_DdsRequiredServiceInstance112
    Libtppathplan_track_DdsProvidedServiceInstance32_PortMapping: port-prototype=planning_base_rootswc.tppathplan_track, service-instance=Libtppathplan_track_DdsProvidedServiceInstance32
    LibRPortPrototype2_DdsRequiredServiceInstance113_PortMapping: port-prototype=planning_base_rootswc.tpfusionloc, service-instance=LibRPortPrototype2_DdsRequiredServiceInstance113
package /HuaweiMDC/instance_manifests/requiredInstances
  4 x dds required service instance, all with qos-profile=default_qos.xml, domain-id=30, transport-plugins=SHM:
    LibRPortPrototype3_DdsRequiredServiceInstance107: service-interface-deployment=FusionObjectArrayDdsInterfaceDeployment, dds-event-qos-props=FusionObjectArrayEventDeployment, required-service-instance-id=5106
    LibRPortPrototype2_DdsRequiredServiceInstance106: service-interface-deployment=PerceptionStaticEnvServiceInterface_DdsDeployment, dds-event-qos-props=EventPerceptionStaticEnvDdsDeployment, required-service-instance-id=5107
    LibRPortPrototype2_DdsRequiredServiceInstance112: service-interface-deployment=VehicleInfomationServiceInterface_DdsDeployment, dds-event-qos-props=EventVehicleInfoDdsDeployment, required-service-instance-id=5108
    LibRPortPrototype2_DdsRequiredServiceInstance113: service-interface-deployment=LocationInfoDdsInterfaceDeployment, dds-event-qos-props=LocationInfoEventDeployment, required-service-instance-id=5110
package /HuaweiMDC/instance_manifests/instanceToMachineMappings
  5 x dds service instance to machine mapping, all with communication-connector=Host0DpEthernetCommConnector:
    LibRPortPrototype3_DdsRequiredServiceInstance107_ToDdsMachineMapping: service-instance=LibRPortPrototype3_DdsRequiredServiceInstance107
    LibRPortPrototype2_DdsRequiredServiceInstance106_ToDdsMachineMapping: service-instance=LibRPortPrototype2_DdsRequiredServiceInstance106
    LibRPortPrototype2_DdsRequiredServiceInstance112_ToDdsMachineMapping: service-instance=LibRPortPrototype2_DdsRequiredServiceInstance112
    Libtppathplan_track_DdsProvidedServiceInstance32_ToDdsMachineMapping: service-instance=Libtppathplan_track_DdsProvidedServiceInstance32
    LibRPortPrototype2_DdsRequiredServiceInstance113_ToDdsMachineMapping: service-instance=LibRPortPrototype2_DdsRequiredServiceInstance113
package /HuaweiMDC/instance_manifests/providedInstances
  dds provided service instance Libtppathplan_track_DdsProvidedServiceInstance32: service-interface-deployment=PlanningResultDdsInterfaceDeployment, qos-profile=default_qos.xml, domain-id=30, transport-plugins=SHM, dds-event-qos-props=PlanningResultEventDeployment, service-instance-id=5109
