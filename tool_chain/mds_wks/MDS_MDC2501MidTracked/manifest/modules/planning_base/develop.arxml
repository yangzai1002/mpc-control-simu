AUTOSAR XML (schema 00048)
package /HuaweiMDC/FunctionalSoftware/Planning/SwComponent
  executable planning_base
    root sw component prototype planning_base_rootswc: application-type=planning_base
