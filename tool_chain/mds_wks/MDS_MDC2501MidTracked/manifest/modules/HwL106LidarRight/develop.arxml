AUTOSAR XML (schema 00048)
package /HuaweiMDC/exe_manifests/exes
  executable HwL106LidarRight: logging-behavior=USES-LOGGING, reporting-behavior=REPORTS-EXECUTION-STATE
    root sw component prototype hw_l106_lidarExecutable5Prototype: application-type=hw_l106_lidarCompositionSwComponentType5
package /HuaweiMDC/Common/Common
  composition sw component type hw_l106_lidarCompositionSwComponentType5
    component hw_l106_lidarPrototype: type=hw_l106_lidar
