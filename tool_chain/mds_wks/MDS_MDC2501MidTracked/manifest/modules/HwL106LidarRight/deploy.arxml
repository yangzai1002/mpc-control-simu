AUTOSAR XML (schema 00048)
package /HuaweiMDC/process_manifests/processDesigns
  process design hw_l106_lidarProcessDesign5: executable=HwL106LidarRight
package /HuaweiMDC/process_manifests/processes
  process hw_l106_lidarProcess5: design=hw_l106_lidarProcessDesign5, executable=HwL106LidarRight, log-trace-default-log-level=INFO, log-trace-log-modes=NETWORK
package /HuaweiMDC/process_manifests/processToMachineMappingSets
  process to machine mapping set ProcessToMachineMappingSet_hw_l106_lidarProcess5
    process to machine mapping processToMachineMapping4: machine=Host0DpMachine, process=hw_l106_lidarProcess5
package /HuaweiMDC/exe_manifests/InstanceToPortMappings
  service instance to port prototype mapping lidarpackets_DdsProvidedServiceInstance46_PortMapping: port-prototype=hw_l106_lidarExecutable5Prototype.lidarpackets, process=hw_l106_lidarProcessDesign5, service-instance=lidarpackets_DdsProvidedServiceInstance46
  service instance to port prototype mapping PointCloudPPortPrototype_DdsProvidedServiceInstance4_PortMapping: port-prototype=hw_l106_lidarExecutable5Prototype.lidarpoints, process=hw_l106_lidarProcessDesign5, service-instance=PointCloudPPortPrototype_DdsProvidedServiceInstance4
package /HuaweiMDC/instance_manifests/providedInstances
  dds provided service instance lidarpackets_DdsProvidedServiceInstance46: service-interface-deployment=SensorLidarPacketServiceInterface_DdsDeployment, qos-profile=default_qos.xml, domain-id=30, transport-plugins=SHM, dds-event-qos-props=EventLidarPacketDdsDeployment, service-instance-id=20232
  dds provided service instance PointCloudPPortPrototype_DdsProvidedServiceInstance4: service-interface-deployment=SensorLidarPointCloudServiceInterface_DdsDeployment, qos-profile=default_qos.xml, domain-id=30, transport-plugins=SHM, dds-event-qos-props=EventPointCloud2DdsDeployment, service-instance-id=20203
package /HuaweiMDC/instance_manifests/instanceToMachineMappings
  dds service instance to machine mapping lidarpackets_DdsProvidedServiceInstance46_ToDdsMachineMapping: communication-connector=Host0DpEthernetCommConnector, service-instance=lidarpackets_DdsProvidedServiceInstance46
  dds service instance to machine mapping PointCloudPPortPrototype_DdsProvidedServiceInstance4_ToDdsMachineMapping: communication-connector=Host0DpEthernetCommConnector, service-instance=PointCloudPPortPrototype_DdsProvidedServiceInstance4
