AUTOSAR XML (schema 00048)
package /HuaweiMDC/process_manifests/processDesigns
  process design ControlProcessDesign16: executable=Control
package /HuaweiMDC/process_manifests/processes
  process ControlProcess16: design=ControlProcessDesign16, executable=Control, log-trace-default-log-level=INFO, log-trace-log-modes=NETWORK
package /HuaweiMDC/process_manifests/processToMachineMappingSets
  process to machine mapping set ProcessToMachineMappingSet_ControlProcess16
    process to machine mapping processToMachineMapping15: machine=Host0DpMachine, process=ControlProcess16
package /HuaweiMDC/exe_manifests/InstanceToPortMappings
  6 x service instance to port prototype mapping, all with process=ControlProcessDesign16:
    tppathplan_recv_DdsRequiredServiceInstance111_PortMapping: port-prototype=ControlExecutable16Prototype.tppathplan_recv, service-instance=tppathplan_recv_DdsRequiredServiceInstance111
    RPortPrototype2_DdsRequiredServiceInstance108_PortMapping: port-prototype=ControlExecutable16Prototype.tppathplan_recv, service-instance=RPortPrototype2_DdsRequiredServiceInstance108
    RPortPrototype3_DdsRequiredServiceInstance97_PortMapping: port-prototype=ControlExecutable16Prototype.tpfault_data, service-instance=RPortPrototype3_DdsRequiredServiceInstance97
    RPortPrototype8_DdsRequiredServiceInstance129_PortMapping: port-prototype=ControlExecutable16Prototype.tpfusionloc, service-instance=RPortPrototype8_DdsRequiredServiceInstance129
    RPortPrototype2_DdsRequiredServiceInstance14_PortMapping: port-prototype=ControlExecutable16Prototype.tpvehiclestate, service-instance=RPortPrototype2_DdsRequiredServiceInstance14
    tpvehicle_to_can_pre_aeb_DdsProvidedServiceInstance39_PortMapping: port-prototype=ControlExecutable16Prototype.tpvehicle_to_can_pre_aeb, service-instance=tpvehicle_to_can_pre_aeb_DdsProvidedServiceInstance39
package /HuaweiMDC/instance_manifests/requiredInstances
  5 x dds required service instance, all with qos-profile=default_qos.xml, domain-id=30, transport-plugins=SHM:
    tppathplan_recv_DdsRequiredServiceInstance111: service-interface-deployment=PlanningResultDdsInterfaceDeployment, dds-event-qos-props=PlanningResultEventDeployment, required-service-instance-id=20212
    RPortPrototype2_DdsRequiredServiceInstance108: service-interface-deployment=PlanningResultDdsInterfaceDeployment, dds-event-qos-props=PlanningResultEventDeployment, required-service-instance-id=20212
    RPortPrototype3_DdsRequiredServiceInstance97: service-interface-deployment=FaultDataServiceInterface_DdsDeployment, dds-event-qos-props=EventFaultDataDdsDeployment, required-service-instance-id=20220
    RPortPrototype8_DdsRequiredServiceInstance129: service-interface-deployment=LocationInfoDdsInterfaceDeployment, dds-event-qos-props=LocationInfoEventDeployment, required-service-instance-id=20218
    RPortPrototype2_DdsRequiredServiceInstance14: service-interface-deployment=VehicleInfomationServiceInterface_DdsDeployment, dds-event-qos-props=EventVehicleInfoDdsDeployment, required-service-instance-id=20205
package /HuaweiMDC/instance_manifests/instanceToMachineMappings
  6 x dds service instance to machine mapping, all with communication-connector=Host0DpEthernetCommConnector:
    tppathplan_recv_DdsRequiredServiceInstance111_ToDdsMachineMapping: service-instance=tppathplan_recv_DdsRequiredServiceInstance111
    RPortPrototype2_DdsRequiredServiceInstance108_ToDdsMachineMapping: service-instance=RPortPrototype2_DdsRequiredServiceInstance108
    RPortPrototype3_DdsRequiredServiceInstance97_ToDdsMachineMapping: service-instance=RPortPrototype3_DdsRequiredServiceInstance97
    RPortPrototype8_DdsRequiredServiceInstance129_ToDdsMachineMapping: service-instance=RPortPrototype8_DdsRequiredServiceInstance129
    RPortPrototype2_DdsRequiredServiceInstance14_ToDdsMachineMapping: service-instance=RPortPrototype2_DdsRequiredServiceInstance14
    tpvehicle_to_can_pre_aeb_DdsProvidedServiceInstance39_ToDdsMachineMapping: service-instance=tpvehicle_to_can_pre_aeb_DdsProvidedServiceInstance39
package /HuaweiMDC/instance_manifests/providedInstances
  dds provided service instance tpvehicle_to_can_pre_aeb_DdsProvidedServiceInstance39: service-interface-deployment=BodyCommandServiceInterface_DdsDeployment, qos-profile=default_qos.xml, domain-id=30, transport-plugins=SHM, dds-event-qos-props=EventVehicleActControlDdsDeployment, service-instance-id=20211
