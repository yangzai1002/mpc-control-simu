AUTOSAR XML (schema 00048)
package /HuaweiMDC/exe_manifests/exes
  executable Control: logging-behavior=USES-LOGGING, reporting-behavior=REPORTS-EXECUTION-STATE
    root sw component prototype ControlExecutable16Prototype: application-type=ControlCompositionSwComponentType16
package /HuaweiMDC/Common/Common
  composition sw component type ControlCompositionSwComponentType16
    component ControlPrototype: type=control_base
