AUTOSAR XML (schema 00048)
package /HuaweiMDC/exe_manifests/swcs
  executable mid_track_chassis_recv
    root sw component prototype mid_track_chassis_recv_rootswc: application-type=mid_track_chassis_recv
