AUTOSAR XML (schema 00048)
package /HuaweiMDC/process_manifests/processDesigns
  process design Libmid_track_chassis_recvProcessDesign7: executable=mid_track_chassis_recv
package /HuaweiMDC/process_manifests/processes
  process Libmid_track_chassis_recvProcess7: design=Libmid_track_chassis_recvProcessDesign7, executable=mid_track_chassis_recv, log-trace-default-log-level=INFO, log-trace-log-modes=NETWORK
package /HuaweiMDC/process_manifests/processToMachineMappingSets
  process to machine mapping set LibProcessToMachineMappingSet_mid_track_chassis_recvProcess7
    process to machine mapping LibprocessToMachineMapping6: machine=Host0DpMachine, process=Libmid_track_chassis_recvProcess7
package /HuaweiMDC/exe_manifests/InstanceToPortMappings
  service instance to port prototype mapping LibVehicleInfoPPortPrototype_DdsProvidedServiceInstance6_PortMapping: port-prototype=mid_track_chassis_recv_rootswc.tpvehiclestate, process=Libmid_track_chassis_recvProcessDesign7, service-instance=LibVehicleInfoPPortPrototype_DdsProvidedServiceInstance6
package /HuaweiMDC/instance_manifests/providedInstances
  dds provided service instance LibVehicleInfoPPortPrototype_DdsProvidedServiceInstance6: service-interface-deployment=VehicleInfomationServiceInterface_DdsDeployment, qos-profile=default_qos.xml, domain-id=30, transport-plugins=SHM, dds-event-qos-props=EventVehicleInfoDdsDeployment, service-instance-id=5115
package /HuaweiMDC/instance_manifests/instanceToMachineMappings
  dds service instance to machine mapping LibVehicleInfoPPortPrototype_DdsProvidedServiceInstance6_ToDdsMachineMapping: communication-connector=Host0DpEthernetCommConnector, service-instance=LibVehicleInfoPPortPrototype_DdsProvidedServiceInstance6
