AUTOSAR XML (schema 00048)
package /HuaweiMDC/FunctionalSoftware/Odometry/SwComponent
  executable odometry_base
    root sw component prototype odometry_base_rootswc: application-type=odometry_base
