AUTOSAR XML (schema 00048)
package /HuaweiMDC/process_manifests/processDesigns
  process design LibOdometryProcessDesign26: executable=odometry_base
package /HuaweiMDC/process_manifests/processes
  process LibOdometryProcess26: design=LibOdometryProcessDesign26, executable=odometry_base, log-trace-default-log-level=INFO, log-trace-log-modes=NETWORK
package /HuaweiMDC/process_manifests/processToMachineMappingSets
  process to machine mapping set LibProcessToMachineMappingSet_OdometryProcess26
    process to machine mapping LibprocessToMachineMapping25: machine=Host0DpMachine, process=LibOdometryProcess26
package /HuaweiMDC/exe_manifests/InstanceToPortMappings
  5 x service instance to port prototype mapping, all with process=LibOdometryProcessDesign26:
    LibRPortPrototype4_DdsRequiredServiceInstance111_PortMapping: port-prototype=odometry_base_rootswc.tpsensorgps, service-instance=LibRPortPrototype4_DdsRequiredServiceInstance111
    LibRPortPrototype1_DdsRequiredServiceInstance40_PortMapping: port-prototype=odometry_base_rootswc.tpwheelspeed, service-instance=LibRPortPrototype1_DdsRequiredServiceInstance40
    LibRPortPrototype3_DdsRequiredServiceInstance110_PortMapping: port-prototype=odometry_base_rootswc.tpimu, service-instance=LibRPortPrototype3_DdsRequiredServiceInstance110
    Libtpododr_DdsProvidedServiceInstance37_PortMapping: port-prototype=odometry_base_rootswc.tpododr, service-instance=Libtpododr_DdsProvidedServiceInstance37
    LibRPortPrototype2_DdsRequiredServiceInstance41_PortMapping: port-prototype=odometry_base_rootswc.tpsensorimu, service-instance=LibRPortPrototype2_DdsRequiredServiceInstance41
package /HuaweiMDC/instance_manifests/requiredInstances
  4 x dds required service instance, all with qos-profile=default_qos.xml, domain-id=30, transport-plugins=SHM:
    LibRPortPrototype4_DdsRequiredServiceInstance111: service-interface-deployment=SensorGpsServiceInterface_DdsDeployment, dds-event-qos-props=EventGpsDdsDeployment, required-service-instance-id=5085
    LibRPortPrototype1_DdsRequiredServiceInstance40: service-interface-deployment=SensorWheelSpeedServiceInterface_DdsDeployment, dds-event-qos-props=EventWheelSpeedDdsDeployment, required-service-instance-id=5086
    LibRPortPrototype3_DdsRequiredServiceInstance110: service-interface-deployment=LocationDdsInterfaceDeployment, dds-event-qos-props=LocationEventDeployment, required-service-instance-id=5087
    LibRPortPrototype2_DdsRequiredServiceInstance41: service-interface-deployment=SensorImuServiceInterface_DdsDeployment, dds-event-qos-props=EventSensorImuDdsDeployment, required-service-instance-id=5089
package /HuaweiMDC/instance_manifests/instanceToMachineMappings
  5 x dds service instance to machine mapping, all with communication-connector=Host0DpEthernetCommConnector:
    LibRPortPrototype4_DdsRequiredServiceInstance111_ToDdsMachineMapping: service-instance=LibRPortPrototype4_DdsRequiredServiceInstance111
    LibRPortPrototype1_DdsRequiredServiceInstance40_ToDdsMachineMapping: service-instance=LibRPortPrototype1_DdsRequiredServiceInstance40
    LibRPortPrototype3_DdsRequiredServiceInstance110_ToDdsMachineMapping: service-instance=LibRPortPrototype3_DdsRequiredServiceInstance110
    Libtpododr_DdsProvidedServiceInstance37_ToDdsMachineMapping: service-instance=Libtpododr_DdsProvidedServiceInstance37
    LibRPortPrototype2_DdsRequiredServiceInstance41_ToDdsMachineMapping: service-instance=LibRPortPrototype2_DdsRequiredServiceInstance41
package /HuaweiMDC/instance_manifests/providedInstances
  dds provided service instance Libtpododr_DdsProvidedServiceInstance37: service-interface-deployment=LocationInfoDdsInterfaceDeployment, qos-profile=default_qos.xml, domain-id=30, transport-plugins=SHM, dds-event-qos-props=LocationInfoEventDeployment, service-instance-id=5088
