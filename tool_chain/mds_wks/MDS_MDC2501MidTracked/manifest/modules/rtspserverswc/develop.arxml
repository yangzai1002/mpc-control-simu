AUTOSAR XML (schema 00048)
package /HuaweiMDC/exe_manifests/swcs
  executable rtspserverswc
    root sw component prototype rtspserverswc_rootswc: application-type=rtspserverswc
