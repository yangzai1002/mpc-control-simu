AUTOSAR XML (schema 00048)
package /HuaweiMDC/process_manifests/processDesigns
  process design LibrtspserverswcProcessDesign24: executable=rtspserverswc
package /HuaweiMDC/process_manifests/processes
  process LibrtspserverswcProcess24: design=LibrtspserverswcProcessDesign24, executable=rtspserverswc, log-trace-default-log-level=INFO, log-trace-log-modes=NETWORK
package /HuaweiMDC/process_manifests/processToMachineMappingSets
  process to machine mapping set LibProcessToMachineMappingSet_rtspserverswcProcess24
    process to machine mapping LibprocessToMachineMapping23: machine=Host0DpMachine, process=LibrtspserverswcProcess24
package /HuaweiMDC/exe_manifests/InstanceToPortMappings
  service instance to port prototype mapping LibRPortPrototype2_DdsRequiredServiceInstance158_PortMapping: port-prototype=rtspserverswc_rootswc.video_encoded_frame, process=LibrtspserverswcProcessDesign24, service-instance=LibRPortPrototype2_DdsRequiredServiceInstance158
package /HuaweiMDC/instance_manifests/requiredInstances
  dds required service instance LibRPortPrototype2_DdsRequiredServiceInstance158: service-interface-deployment=SensorImageServiceInterface_DdsDeployment, qos-profile=default_qos.xml, domain-id=30, transport-plugins=SHM, dds-event-qos-props=EventSensorImageDdsDeployment, required-service-instance-id=5084
package /HuaweiMDC/instance_manifests/instanceToMachineMappings
  dds service instance to machine mapping LibRPortPrototype2_DdsRequiredServiceInstance158_ToDdsMachineMapping: communication-connector=Host0DpEthernetCommConnector, service-instance=LibRPortPrototype2_DdsRequiredServiceInstance158
