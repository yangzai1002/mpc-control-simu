AUTOSAR XML (schema 00048)
package /HuaweiMDC/process_manifests/processDesigns
  process design hw_fr671_radarProcessDesign22: executable=HwFr671RadarRight
package /HuaweiMDC/process_manifests/processes
  process hw_fr671_radarProcess22: design=hw_fr671_radarProcessDesign22, executable=HwFr671RadarRight, log-trace-default-log-level=INFO, log-trace-log-modes=NETWORK
package /HuaweiMDC/process_manifests/processToMachineMappingSets
  process to machine mapping set ProcessToMachineMappingSet_hw_fr671_radarProcess22
    process to machine mapping processToMachineMapping21: machine=Host0DpMachine, process=hw_fr671_radarProcess22
package /HuaweiMDC/exe_manifests/InstanceToPortMappings
  4 x service instance to port prototype mapping, all with process=hw_fr671_radarProcessDesign22:
    RPortPrototype2_DdsRequiredServiceInstance105_PortMapping: port-prototype=hw_fr671_radarExecutable22Prototype.tpimu1, service-instance=RPortPrototype2_DdsRequiredServiceInstance105
    radarpackets_DdsProvidedServiceInstance44_PortMapping: port-prototype=hw_fr671_radarExecutable22Prototype.radarpackets, service-instance=radarpackets_DdsProvidedServiceInstance44
    RadarPointCloudPPortPrototype_DdsProvidedServiceInstance40_PortMapping: port-prototype=hw_fr671_radarExecutable22Prototype.radarpoints, service-instance=RadarPointCloudPPortPrototype_DdsProvidedServiceInstance40
    RPortPrototype1_DdsRequiredServiceInstance200_PortMapping: port-prototype=hw_fr671_radarExecutable22Prototype.tpvehiclestate1, service-instance=RPortPrototype1_DdsRequiredServiceInstance200
package /HuaweiMDC/instance_manifests/requiredInstances
  dds required service instance RPortPrototype2_DdsRequiredServiceInstance105: service-interface-deployment=LocationDdsInterfaceDeployment, qos-profile=default_qos.xml, domain-id=30, transport-plugins=SHM, dds-event-qos-props=LocationEventDeployment, required-service-instance-id=20229
  dds required service instance RPortPrototype1_DdsRequiredServiceInstance200: service-interface-deployment=VehicleInfomationServiceInterface_DdsDeployment, qos-profile=default_qos.xml, domain-id=30, transport-plugins=SHM, dds-event-qos-props=EventVehicleInfoDdsDeployment, required-service-instance-id=20205
package /HuaweiMDC/instance_manifests/instanceToMachineMappings
  4 x dds service instance to machine mapping, all with communication-connector=Host0DpEthernetCommConnector:
    RPortPrototype2_DdsRequiredServiceInstance105_ToDdsMachineMapping: service-instance=RPortPrototype2_DdsRequiredServiceInstance105
    radarpackets_DdsProvidedServiceInstance44_ToDdsMachineMapping: service-instance=radarpackets_DdsProvidedServiceInstance44
    RadarPointCloudPPortPrototype_DdsProvidedServiceInstance40_ToDdsMachineMapping: service-instance=RadarPointCloudPPortPrototype_DdsProvidedServiceInstance40
    RPortPrototype1_DdsRequiredServiceInstance200_ToDdsMachineMapping: service-instance=RPortPrototype1_DdsRequiredServiceInstance200
package /HuaweiMDC/instance_manifests/providedInstances
  dds provided service instance radarpackets_DdsProvidedServiceInstance44: service-interface-deployment=SensorRadarPacketServiceInterface_DdsDeployment, qos-profile=default_qos.xml, domain-id=30, transport-plugins=SHM, dds-event-qos-props=EventSensorRadarPacketDdsDeployment, service-instance-id=20230
  dds provided service instance RadarPointCloudPPortPrototype_DdsProvidedServiceInstance40: service-interface-deployment=RadarPointCloudServiceInterface_DdsDeployment, qos-profile=default_qos.xml, domain-id=30, transport-plugins=SHM, dds-event-qos-props=EventRadarPointCloudDdsDeployment, service-instance-id=20224
