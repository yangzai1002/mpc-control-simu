AUTOSAR XML (schema 00048)
package /HuaweiMDC/process_manifests/processDesigns
  process design xh265_rtp_pusherProcessDesign14: executable=XH265RtpPusher
package /HuaweiMDC/process_manifests/processes
  process xh265_rtp_pusherProcess14: design=xh265_rtp_pusherProcessDesign14, executable=XH265RtpPusher, log-trace-default-log-level=INFO, log-trace-log-modes=NETWORK
package /HuaweiMDC/process_manifests/processToMachineMappingSets
  process to machine mapping set ProcessToMachineMappingSet_xh265_rtp_pusherProcess14
    process to machine mapping processToMachineMapping13: machine=Host0DpMachine, process=xh265_rtp_pusherProcess14
package /HuaweiMDC/exe_manifests/InstanceToPortMappings
  service instance to port prototype mapping RPortPrototype6_DdsRequiredServiceInstance160_PortMapping: port-prototype=xh265_rtp_pusherExecutable14Prototype.video_encoded_frame, process=xh265_rtp_pusherProcessDesign14, service-instance=RPortPrototype6_DdsRequiredServiceInstance160
package /HuaweiMDC/instance_manifests/requiredInstances
  dds required service instance RPortPrototype6_DdsRequiredServiceInstance160: service-interface-deployment=SensorImageServiceInterface_DdsDeployment, qos-profile=default_qos.xml, domain-id=30, transport-plugins=SHM, dds-event-qos-props=EventSensorImageDdsDeployment, required-service-instance-id=20247
package /HuaweiMDC/instance_manifests/instanceToMachineMappings
  dds service instance to machine mapping RPortPrototype6_DdsRequiredServiceInstance160_ToDdsMachineMapping: communication-connector=Host0DpEthernetCommConnector, service-instance=RPortPrototype6_DdsRequiredServiceInstance160
