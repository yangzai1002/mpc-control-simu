AUTOSAR XML (schema 00048)
package /HuaweiMDC/exe_manifests/exes
  executable XH265RtpPusher: logging-behavior=USES-LOGGING, reporting-behavior=REPORTS-EXECUTION-STATE
    root sw component prototype xh265_rtp_pusherExecutable14Prototype: application-type=xh265_rtp_pusherCompositionSwComponentType14
package /HuaweiMDC/Common/Common
  composition sw component type xh265_rtp_pusherCompositionSwComponentType14
    component xh265_rtp_pusherPrototype: type=xh265_rtp_pusher
