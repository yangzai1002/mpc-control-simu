AUTOSAR XML (schema 00048)
package /HuaweiMDC/exe_manifests/exes
  executable HwFr671RadarFront: logging-behavior=USES-LOGGING, reporting-behavior=REPORTS-EXECUTION-STATE
    root sw component prototype hw_fr671_radarExecutable20Prototype: application-type=hw_fr671_radarCompositionSwComponentType20
package /HuaweiMDC/Common/Common
  composition sw component type hw_fr671_radarCompositionSwComponentType20
    component hw_fr671_radarPrototype: type=hw_fr671_radar
