AUTOSAR XML (schema 00048)
package /HuaweiMDC/process_manifests/processDesigns
  process design hw_fr671_radarProcessDesign20: executable=HwFr671RadarFront
package /HuaweiMDC/process_manifests/processes
  process hw_fr671_radarProcess20: design=hw_fr671_radarProcessDesign20, executable=HwFr671RadarFront, log-trace-default-log-level=INFO, log-trace-log-modes=NETWORK
package /HuaweiMDC/process_manifests/processToMachineMappingSets
  process to machine mapping set ProcessToMachineMappingSet_hw_fr671_radarProcess20
    process to machine mapping processToMachineMapping19: machine=Host0DpMachine, process=hw_fr671_radarProcess20
package /HuaweiMDC/exe_manifests/InstanceToPortMappings
  4 x service instance to port prototype mapping, all with process=hw_fr671_radarProcessDesign20:
    radarpackets_DdsProvidedServiceInstance42_PortMapping: port-prototype=hw_fr671_radarExecutable20Prototype.radarpackets, service-instance=radarpackets_DdsProvidedServiceInstance42
    RadarPointCloudPPortPrototype_DdsProvidedServiceInstance41_PortMapping: port-prototype=hw_fr671_radarExecutable20Prototype.radarpoints, service-instance=RadarPointCloudPPortPrototype_DdsProvidedServiceInstance41
    RPortPrototype4_DdsRequiredServiceInstance107_PortMapping: port-prototype=hw_fr671_radarExecutable20Prototype.tpimu2, service-instance=RPortPrototype4_DdsRequiredServiceInstance107
    RPortPrototype2_DdsRequiredServiceInstance201_PortMapping: port-prototype=hw_fr671_radarExecutable20Prototype.tpvehiclestate2, service-instance=RPortPrototype2_DdsRequiredServiceInstance201
package /HuaweiMDC/instance_manifests/providedInstances
  dds provided service instance radarpackets_DdsProvidedServiceInstance42: service-interface-deployment=SensorRadarPacketServiceInterface_DdsDeployment, qos-profile=default_qos.xml, domain-id=30, transport-plugins=SHM, dds-event-qos-props=EventSensorRadarPacketDdsDeployment, service-instance-id=20219
  dds provided service instance RadarPointCloudPPortPrototype_DdsProvidedServiceInstance41: service-interface-deployment=RadarPointCloudServiceInterface_DdsDeployment, qos-profile=default_qos.xml, domain-id=30, transport-plugins=SHM, dds-event-qos-props=EventRadarPointCloudDdsDeployment, service-instance-id=20225
package /HuaweiMDC/instance_manifests/instanceToMachineMappings
  4 x dds service instance to machine mapping, all with communication-connector=Host0DpEthernetCommConnector:
    radarpackets_DdsProvidedServiceInstance42_ToDdsMachineMapping: service-instance=radarpackets_DdsProvidedServiceInstance42
    RadarPointCloudPPortPrototype_DdsProvidedServiceInstance41_ToDdsMachineMapping: service-instance=RadarPointCloudPPortPrototype_DdsProvidedServiceInstance41
    RPortPrototype4_DdsRequiredServiceInstance107_ToDdsMachineMapping: service-instance=RPortPrototype4_DdsRequiredServiceInstance107
    RPortPrototype2_DdsRequiredServiceInstance201_ToDdsMachineMapping: service-instance=RPortPrototype2_DdsRequiredServiceInstance201
package /HuaweiMDC/instance_manifests/requiredInstances
  dds required service instance RPortPrototype4_DdsRequiredServiceInstance107: service-interface-deployment=LocationDdsInterfaceDeployment, qos-profile=default_qos.xml, domain-id=30, transport-plugins=SHM, dds-event-qos-props=LocationEventDeployment, required-service-instance-id=20229
  dds required service instance RPortPrototype2_DdsRequiredServiceInstance201: service-interface-deployment=VehicleInfomationServiceInterface_DdsDeployment, qos-profile=default_qos.xml, domain-id=30, transport-plugins=SHM, dds-event-qos-props=EventVehicleInfoDdsDeployment, required-service-instance-id=20205
