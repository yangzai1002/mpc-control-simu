AUTOSAR XML (schema 00048)
package /HuaweiMDC/exe_manifests/swcs
  executable sensor_viualize_base
    root sw component prototype sensor_viualize_base_rootswc: application-type=sensor_viualize_base
