AUTOSAR XML (schema 00048)
package /HuaweiMDC/process_manifests/processDesigns
  process design Libsensor_viualize_baseProcessDesign38: executable=sensor_viualize_base
package /HuaweiMDC/process_manifests/processes
  process Libsensor_viualize_baseProcess38: design=Libsensor_viualize_baseProcessDesign38, executable=sensor_viualize_base, log-trace-default-log-level=INFO, log-trace-log-modes=NETWORK
package /HuaweiMDC/process_manifests/processToMachineMappingSets
  process to machine mapping set LibProcessToMachineMappingSet_sensor_viualize_baseProcess38
    process to machine mapping LibprocessToMachineMapping37: machine=Host0DpMachine, process=Libsensor_viualize_baseProcess38
package /HuaweiMDC/exe_manifests/InstanceToPortMappings
  service instance to port prototype mapping LibRPortPrototype1_DdsRequiredServiceInstance163_PortMapping: port-prototype=sensor_viualize_base_rootswc.tplidarfront, process=Libsensor_viualize_baseProcessDesign38, service-instance=Libtplidarfront
  service instance to port prototype mapping LibRPortPrototype2_DdsRequiredServiceInstance164_PortMapping: port-prototype=sensor_viualize_base_rootswc.tpcameralist, process=Libsensor_viualize_baseProcessDesign38, service-instance=LibRPortPrototype2_DdsRequiredServiceInstance164
  service instance to port prototype mapping LibRPortPrototype1_DdsRequiredServiceInstance110_PortMapping: port-prototype=sensor_viualize_base_rootswc.RPortPrototype1, process=Libsensor_viualize_baseProcessDesign38, service-instance=LibRPortPrototype1_DdsRequiredServiceInstance110
package /HuaweiMDC/instance_manifests/requiredInstances
  dds required service instance Libtplidarfront: service-interface-deployment=SensorLidarPointCloudServiceInterface_DdsDeployment, qos-profile=default_qos.xml, domain-id=30, transport-plugins=SHM, dds-event-qos-props=EventPointCloud2DdsDeployment, required-service-instance-id=5013
  dds required service instance LibRPortPrototype2_DdsRequiredServiceInstance164: service-interface-deployment=SensorImageListServiceInterface_DdsDeployment, qos-profile=default_qos.xml, domain-id=30, transport-plugins=SHM, dds-event-qos-props=EventImageListDdsDeployment, required-service-instance-id=5014
  dds required service instance LibRPortPrototype1_DdsRequiredServiceInstance110: service-interface-deployment=RadarPointCloudServiceInterface_DdsDeployment, qos-profile=default_qos.xml, domain-id=30, transport-plugins=SHM, dds-event-qos-props=EventRadarPointCloudDdsDeployment, required-service-instance-id=5015
package /HuaweiMDC/instance_manifests/instanceToMachineMappings
  dds service instance to machine mapping LibRPortPrototype1_DdsRequiredServiceInstance163_ToDdsMachineMapping: communication-connector=Host0DpEthernetCommConnector, service-instance=Libtplidarfront
  dds service instance to machine mapping LibRPortPrototype2_DdsRequiredServiceInstance164_ToDdsMachineMapping: communication-connector=Host0DpEthernetCommConnector, service-instance=LibRPortPrototype2_DdsRequiredServiceInstance164
  dds service instance to machine mapping LibRPortPrototype1_DdsRequiredServiceInstance110_ToDdsMachineMapping: communication-connector=Host0DpEthernetCommConnector, service-instance=LibRPortPrototype1_DdsRequiredServiceInstance110
