AUTOSAR XML (schema 00048)
package /HuaweiMDC/process_manifests/processDesigns
  process design driver_dev_nullProcessDesign37: executable=DriverDevNull
package /HuaweiMDC/process_manifests/processes
  process driver_dev_nullProcess37: design=driver_dev_nullProcessDesign37, executable=DriverDevNull, log-trace-default-log-level=INFO, log-trace-log-modes=NETWORK
package /HuaweiMDC/process_manifests/processToMachineMappingSets
  process to machine mapping set ProcessToMachineMappingSet_driver_dev_nullProcess37
    process to machine mapping processToMachineMapping36: machine=Host0DpMachine, process=driver_dev_nullProcess37
package /HuaweiMDC/exe_manifests/InstanceToPortMappings
  5 x service instance to port prototype mapping, all with process=driver_dev_nullProcessDesign37:
    RPortPrototype6_DdsRequiredServiceInstance159_PortMapping: port-prototype=driver_dev_nullExecutable37Prototype.RPortPrototype6, service-instance=RPortPrototype6_DdsRequiredServiceInstance159
    RPortPrototype5_DdsRequiredServiceInstance158_PortMapping: port-prototype=driver_dev_nullExecutable37Prototype.RPortPrototype5, service-instance=RPortPrototype5_DdsRequiredServiceInstance158
    RPortPrototype1_DdsRequiredServiceInstance154_PortMapping: port-prototype=driver_dev_nullExecutable37Prototype.RPortPrototype1, service-instance=RPortPrototype1_DdsRequiredServiceInstance154
    RPortPrototype7_DdsRequiredServiceInstance160_PortMapping: port-prototype=driver_dev_nullExecutable37Prototype.RPortPrototype7, service-instance=RPortPrototype7_DdsRequiredServiceInstance160
    RPortPrototype2_DdsRequiredServiceInstance155_PortMapping: port-prototype=driver_dev_nullExecutable37Prototype.RPortPrototype2, service-instance=RPortPrototype2_DdsRequiredServiceInstance155
package /HuaweiMDC/instance_manifests/requiredInstances
  5 x dds required service instance, all with qos-profile=default_qos.xml, domain-id=30, transport-plugins=SHM:
    RPortPrototype6_DdsRequiredServiceInstance159: service-interface-deployment=SensorLidarPacketServiceInterface_DdsDeployment, dds-event-qos-props=EventLidarPacketDdsDeployment, required-service-instance-id=20232
    RPortPrototype5_DdsRequiredServiceInstance158: service-interface-deployment=SensorLidarPacketServiceInterface_DdsDeployment, dds-event-qos-props=EventLidarPacketDdsDeployment, required-service-instance-id=20231
    RPortPrototype1_DdsRequiredServiceInstance154: service-interface-deployment=SensorCompressedImageListServiceInterface_DdsDeployment, dds-event-qos-props=EventCompressedImageListDdsDeployment, required-service-instance-id=20210
    RPortPrototype7_DdsRequiredServiceInstance160: service-interface-deployment=SensorLidarPacketServiceInterface_DdsDeployment, dds-event-qos-props=EventLidarPacketDdsDeployment, required-service-instance-id=20234
    RPortPrototype2_DdsRequiredServiceInstance155: service-interface-deployment=SensorRadarPacketServiceInterface_DdsDeployment, dds-event-qos-props=EventSensorRadarPacketDdsDeployment, required-service-instance-id=20219
package /HuaweiMDC/instance_manifests/instanceToMachineMappings
  5 x dds service instance to machine mapping, all with communication-connector=Host0DpEthernetCommConnector:
    RPortPrototype6_DdsRequiredServiceInstance159_ToDdsMachineMapping: service-instance=RPortPrototype6_DdsRequiredServiceInstance159
    RPortPrototype5_DdsRequiredServiceInstance158_ToDdsMachineMapping: service-instance=RPortPrototype5_DdsRequiredServiceInstance158
    RPortPrototype1_DdsRequiredServiceInstance154_ToDdsMachineMapping: service-instance=RPortPrototype1_DdsRequiredServiceInstance154
    RPortPrototype7_DdsRequiredServiceInstance160_ToDdsMachineMapping: service-instance=RPortPrototype7_DdsRequiredServiceInstance160
    RPortPrototype2_DdsRequiredServiceInstance155_ToDdsMachineMapping: service-instance=RPortPrototype2_DdsRequiredServiceInstance155
