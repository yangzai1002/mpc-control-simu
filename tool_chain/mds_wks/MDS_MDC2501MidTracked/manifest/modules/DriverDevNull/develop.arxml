AUTOSAR XML (schema 00048)
package /HuaweiMDC/exe_manifests/exes
  executable DriverDevNull: logging-behavior=USES-LOGGING, reporting-behavior=REPORTS-EXECUTION-STATE
    root sw component prototype driver_dev_nullExecutable37Prototype: application-type=driver_dev_nullCompositionSwComponentType37
package /HuaweiMDC/Common/Common
  composition sw component type driver_dev_nullCompositionSwComponentType37
    component driver_dev_nullPrototype: type=driver_dev_null
