AUTOSAR XML (schema 00048)
package /HuaweiMDC/FunctionalSoftware/LidarSlam/SwComponent
  executable lidar_slam_base
    root sw component prototype lidar_slam_base_rootswc: application-type=lidar_slam_base
