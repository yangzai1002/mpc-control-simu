AUTOSAR XML (schema 00048)
package /HuaweiMDC/process_manifests/processDesigns
  process design LibLidarSlamProcessDesign25: executable=lidar_slam_base
package /HuaweiMDC/process_manifests/processes
  process LibLidarSlamProcess25: design=LibLidarSlamProcessDesign25, executable=lidar_slam_base, log-trace-default-log-level=INFO, log-trace-log-modes=NETWORK
package /HuaweiMDC/process_manifests/processToMachineMappingSets
  process to machine mapping set LibProcessToMachineMappingSet_LidarSlamProcess25
    process to machine mapping LibprocessToMachineMapping24: machine=Host0DpMachine, process=LibLidarSlamProcess25
package /HuaweiMDC/exe_manifests/InstanceToPortMappings
  9 x service instance to port prototype mapping, all with process=LibLidarSlamProcessDesign25:
    LibRPortPrototype3_DdsRequiredServiceInstance109_PortMapping: port-prototype=lidar_slam_base_rootswc.tpfront_right_lidar_points, service-instance=LibRPortPrototype3_DdsRequiredServiceInstance109
    Libtpliodr_DdsProvidedServiceInstance36_PortMapping: port-prototype=lidar_slam_base_rootswc.tpliodr, service-instance=Libtpliodr_DdsProvidedServiceInstance36
    Liblidarpointsleft_DdsRequiredServiceInstance201_PortMapping: port-prototype=lidar_slam_base_rootswc.tpfront_left_lidar_points, service-instance=Liblidarpointsleft_DdsRequiredServiceInstance201
    Liblidarpointsfront_DdsRequiredServiceInstance200_PortMapping: port-prototype=lidar_slam_base_rootswc.tpfront_middle_lidar_points, service-instance=Liblidarpointsfront_DdsRequiredServiceInstance200
    LibRPortPrototype4_DdsRequiredServiceInstance110_PortMapping: port-prototype=lidar_slam_base_rootswc.tpsensorimu, service-instance=LibRPortPrototype4_DdsRequiredServiceInstance110
    Liblidarpointsright_DdsRequiredServiceInstance202_PortMapping: port-prototype=lidar_slam_base_rootswc.tpfront_right_lidar_points, service-instance=Liblidarpointsright_DdsRequiredServiceInstance202
    LibRPortPrototype1_DdsRequiredServiceInstance107_PortMapping: port-prototype=lidar_slam_base_rootswc.tpfront_middle_lidar_points, service-instance=LibRPortPrototype1_DdsRequiredServiceInstance107
    Libtpfront_middle_lidar_points_DdsRequiredServiceInstance109_PortMapping: port-prototype=lidar_slam_base_rootswc.tpfront_middle_lidar_points, service-instance=Libtpfront_middle_lidar_points_DdsRequiredServiceInstance109
    LibRPortPrototype5_DdsRequiredServiceInstance111_wspeedPortMapping: port-prototype=lidar_slam_base_rootswc.tpwheelspeed, service-instance=LibRPortPrototype5_DdsRequiredServiceInstance111_wspeed
package /HuaweiMDC/instance_manifests/requiredInstances
  8 x dds required service instance, all with qos-profile=default_qos.xml, domain-id=30, transport-plugins=SHM:
    LibRPortPrototype3_DdsRequiredServiceInstance109: service-interface-deployment=SensorLidarPointCloudServiceInterface_DdsDeployment, dds-event-qos-props=EventPointCloud2DdsDeployment, required-service-instance-id=5090
    Liblidarpointsleft_DdsRequiredServiceInstance201: service-interface-deployment=SensorLidarPointCloudServiceInterface_DdsDeployment, dds-event-qos-props=EventPointCloud2DdsDeployment, required-service-instance-id=5092
    Liblidarpointsfront_DdsRequiredServiceInstance200: service-interface-deployment=SensorLidarPointCloudServiceInterface_DdsDeployment, dds-event-qos-props=EventPointCloud2DdsDeployment, required-service-instance-id=5093
    LibRPortPrototype4_DdsRequiredServiceInstance110: service-interface-deployment=SensorImuServiceInterface_DdsDeployment, dds-event-qos-props=EventSensorImuDdsDeployment, required-service-instance-id=5094
    Liblidarpointsright_DdsRequiredServiceInstance202: service-interface-deployment=SensorLidarPointCloudServiceInterface_DdsDeployment, dds-event-qos-props=EventPointCloud2DdsDeployment, required-service-instance-id=5095
    LibRPortPrototype1_DdsRequiredServiceInstance107: service-interface-deployment=SensorLidarPointCloudServiceInterface_DdsDeployment, dds-event-qos-props=EventPointCloud2DdsDeployment, required-service-instance-id=5096
    Libtpfront_middle_lidar_points_DdsRequiredServiceInstance109: service-interface-deployment=SensorLidarPointCloudServiceInterface_DdsDeployment, dds-event-qos-props=EventPointCloud2DdsDeployment, required-service-instance-id=5097
    LibRPortPrototype5_DdsRequiredServiceInstance111_wspeed: service-interface-deployment=SensorWheelSpeedServiceInterface_DdsDeployment, dds-event-qos-props=EventWheelSpeedDdsDeployment, required-service-instance-id=5098
package /HuaweiMDC/instance_manifests/instanceToMachineMappings
  12 x dds service instance to machine mapping, all with communication-connector=Host0DpEthernetCommConnector:
    LibRPortPrototype3_DdsRequiredServiceInstance109_ToDdsMachineMapping: service-instance=LibRPortPrototype3_DdsRequiredServiceInstance109
    LibRPortPrototype3_DdsRequiredServiceInstance109_ToDdsMachineMapping: service-instance=LibRPortPrototype3_DdsRequiredServiceInstance109
    Libtpliodr_DdsProvidedServiceInstance36_ToDdsMachineMapping: service-instance=Libtpliodr_DdsProvidedServiceInstance36
    Liblidarpointsleft_DdsRequiredServiceInstance201_ToDdsMachineMapping: service-instance=Liblidarpointsleft_DdsRequiredServiceInstance201
    Liblidarpointsfront_DdsRequiredServiceInstance200_ToDdsMachineMapping: service-instance=Liblidarpointsfront_DdsRequiredServiceInstance200
    LibRPortPrototype4_DdsRequiredServiceInstance110_ToDdsMachineMapping: service-instance=LibRPortPrototype4_DdsRequiredServiceInstance110
    LibRPortPrototype4_DdsRequiredServiceInstance110_ToDdsMachineMapping: service-instance=LibRPortPrototype4_DdsRequiredServiceInstance110
    Liblidarpointsright_DdsRequiredServiceInstance202_ToDdsMachineMapping: service-instance=Liblidarpointsright_DdsRequiredServiceInstance202
    LibRPortPrototype1_DdsRequiredServiceInstance107_ToDdsMachineMapping: service-instance=LibRPortPrototype1_DdsRequiredServiceInstance107
    LibRPortPrototype1_DdsRequiredServiceInstance107_ToDdsMachineMapping: service-instance=LibRPortPrototype1_DdsRequiredServiceInstance107
    Libtpfront_middle_lidar_points_DdsRequiredServiceInstance109_ToDdsMachineMapping: service-instance=Libtpfront_middle_lidar_points_DdsRequiredServiceInstance109
    LibRPortPrototype5_DdsRequiredServiceInstance111_wspeedToDdsMachineMapping: service-instance=LibRPortPrototype5_DdsRequiredServiceInstance111_wspeed
package /HuaweiMDC/instance_manifests/providedInstances
  dds provided service instance Libtpliodr_DdsProvidedServiceInstance36: service-interface-deployment=LocationInfoDdsInterfaceDeployment, qos-profile=default_qos.xml, domain-id=30, transport-plugins=SHM, dds-event-qos-props=LocationInfoEventDeployment, service-instance-id=5091
