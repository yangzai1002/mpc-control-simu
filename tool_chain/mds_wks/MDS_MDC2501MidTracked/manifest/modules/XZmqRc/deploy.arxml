AUTOSAR XML (schema 00048)
package /HuaweiMDC/process_manifests/processDesigns
  process design xzmq_rcProcessDesign19: executable=XZmqRc
package /HuaweiMDC/process_manifests/processes
  process xzmq_rcProcess19: design=xzmq_rcProcessDesign19, executable=XZmqRc, log-trace-default-log-level=INFO, log-trace-log-modes=NETWORK
package /HuaweiMDC/process_manifests/processToMachineMappingSets
  process to machine mapping set ProcessToMachineMappingSet_xzmq_rcProcess19
    process to machine mapping processToMachineMapping18: machine=Host0DpMachine, process=xzmq_rcProcess19
package /HuaweiMDC/exe_manifests/InstanceToPortMappings
  service instance to port prototype mapping ZmqRRemoteControlPPortPrototype_DdsProvidedServiceInstance26_PortMapping: port-prototype=xzmq_rcExecutable19Prototype.tpappremotecmd, process=xzmq_rcProcessDesign19, service-instance=ZmqRRemoteControlPPortPrototype_DdsProvidedServiceInstance26
package /HuaweiMDC/instance_manifests/providedInstances
  dds provided service instance ZmqRRemoteControlPPortPrototype_DdsProvidedServiceInstance26: service-interface-deployment=RemoteControlServiceInterface_DdsDeployment, qos-profile=default_qos.xml, domain-id=30, transport-plugins=SHM, dds-event-qos-props=EventRCAppRemoteCtlDdsDeployment, service-instance-id=20213
package /HuaweiMDC/instance_manifests/instanceToMachineMappings
  dds service instance to machine mapping ZmqRRemoteControlPPortPrototype_DdsProvidedServiceInstance26_ToDdsMachineMapping: communication-connector=Host0DpEthernetCommConnector, service-instance=ZmqRRemoteControlPPortPrototype_DdsProvidedServiceInstance26
