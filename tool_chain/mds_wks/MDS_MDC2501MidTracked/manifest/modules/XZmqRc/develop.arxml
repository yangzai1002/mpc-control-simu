AUTOSAR XML (schema 00048)
package /HuaweiMDC/exe_manifests/exes
  executable XZmqRc: logging-behavior=USES-LOGGING, reporting-behavior=REPORTS-EXECUTION-STATE
    root sw component prototype xzmq_rcExecutable19Prototype: application-type=xzmq_rcCompositionSwComponentType19
package /HuaweiMDC/Common/Common
  composition sw component type xzmq_rcCompositionSwComponentType19
    component xzmq_rcPrototype: type=xzmq_rc
