AUTOSAR XML (schema 00048)
package /HuaweiMDC/exe_manifests/swcs
  executable xzmq_rc
    root sw component prototype xzmq_rc_rootswc: application-type=xzmq_rc
