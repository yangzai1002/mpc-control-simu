AUTOSAR XML (schema 00048)
package /HuaweiMDC/process_manifests/processDesigns
  process design Libxzmq_rcProcessDesign19: executable=xzmq_rc
package /HuaweiMDC/process_manifests/processes
  process Libxzmq_rcProcess19: design=Libxzmq_rcProcessDesign19, executable=xzmq_rc, log-trace-default-log-level=INFO, log-trace-log-modes=NETWORK
package /HuaweiMDC/process_manifests/processToMachineMappingSets
  process to machine mapping set LibProcessToMachineMappingSet_xzmq_rcProcess19
    process to machine mapping LibprocessToMachineMapping18: machine=Host0DpMachine, process=Libxzmq_rcProcess19
package /HuaweiMDC/exe_manifests/InstanceToPortMappings
  service instance to port prototype mapping LibZmqRRemoteControlPPortPrototype_DdsProvidedServiceInstance26_PortMapping: port-prototype=xzmq_rc_rootswc.tpappremotecmd, process=Libxzmq_rcProcessDesign19, service-instance=LibZmqRRemoteControlPPortPrototype_DdsProvidedServiceInstance26
package /HuaweiMDC/instance_manifests/providedInstances
  dds provided service instance LibZmqRRemoteControlPPortPrototype_DdsProvidedServiceInstance26: service-interface-deployment=RemoteControlServiceInterface_DdsDeployment, qos-profile=default_qos.xml, domain-id=30, transport-plugins=SHM, dds-event-qos-props=EventRCAppRemoteCtlDdsDeployment, service-instance-id=5125
package /HuaweiMDC/instance_manifests/instanceToMachineMappings
  dds service instance to machine mapping LibZmqRRemoteControlPPortPrototype_DdsProvidedServiceInstance26_ToDdsMachineMapping: communication-connector=Host0DpEthernetCommConnector, service-instance=LibZmqRRemoteControlPPortPrototype_DdsProvidedServiceInstance26
