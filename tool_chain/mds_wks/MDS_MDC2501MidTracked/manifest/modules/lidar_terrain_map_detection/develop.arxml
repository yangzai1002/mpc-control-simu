AUTOSAR XML (schema 00048)
package /HuaweiMDC/exe_manifests/swcs
  executable lidar_terrain_map_detection
    root sw component prototype lidar_terrain_map_detection_rootswc: application-type=lidar_terrain_map_detection
