AUTOSAR XML (schema 00048)
package /HuaweiMDC/process_manifests/processDesigns
  process design Liblidar_terrain_map_detectionProcessDesign29: executable=lidar_terrain_map_detection
package /HuaweiMDC/process_manifests/processes
  process Liblidar_terrain_map_detectionProcess29: design=Liblidar_terrain_map_detectionProcessDesign29, executable=lidar_terrain_map_detection, log-trace-default-log-level=INFO, log-trace-log-modes=NETWORK
package /HuaweiMDC/process_manifests/processToMachineMappingSets
  process to machine mapping set LibProcessToMachineMappingSet_lidar_terrain_map_detectionProcess29
    process to machine mapping LibprocessToMachineMapping28: machine=Host0DpMachine, process=Liblidar_terrain_map_detectionProcess29
package /HuaweiMDC/exe_manifests/InstanceToPortMappings
  6 x service instance to port prototype mapping, all with process=Liblidar_terrain_map_detectionProcessDesign29:
    Liblidarpointsright_DdsRequiredServiceInstance189_PortMapping: port-prototype=lidar_terrain_map_detection_rootswc.tpfront_right_lidar_points, service-instance=Liblidarpointsright_DdsRequiredServiceInstance189
    Libtpterrainmap_DdsProvidedServiceInstance31_PortMapping: port-prototype=lidar_terrain_map_detection_rootswc.tpterrainmap, service-instance=Libtpterrainmap_DdsProvidedServiceInstance31
    LibRPortPrototype5_DdsRequiredServiceInstance115_PortMapping: port-prototype=lidar_terrain_map_detection_rootswc.tplocalization, service-instance=LibRPortPrototype5_DdsRequiredServiceInstance115
    LibRPortPrototype3_DdsRequiredServiceInstance113_PortMapping: port-prototype=lidar_terrain_map_detection_rootswc.tpfront_right_lidar_points, service-instance=LibRPortPrototype3_DdsRequiredServiceInstance113
    LibRPortPrototype1_DdsRequiredServiceInstance111_PortMapping: port-prototype=lidar_terrain_map_detection_rootswc.tpfront_left_lidar_points, service-instance=LibRPortPrototype1_DdsRequiredServiceInstance111
    LibRPortPrototype1_DdsRequiredServiceInstance110_PortMapping: port-prototype=lidar_terrain_map_detection_rootswc.tpfront_middle_lidar_points, service-instance=LibRPortPrototype1_DdsRequiredServiceInstance110
package /HuaweiMDC/instance_manifests/requiredInstances
  5 x dds required service instance, all with qos-profile=default_qos.xml, domain-id=30, transport-plugins=SHM:
    Liblidarpointsright_DdsRequiredServiceInstance189: service-interface-deployment=SensorLidarPointCloudServiceInterface_DdsDeployment, dds-event-qos-props=EventPointCloud2DdsDeployment, required-service-instance-id=5047
    LibRPortPrototype5_DdsRequiredServiceInstance115: service-interface-deployment=LocationInfoDdsInterfaceDeployment, dds-event-qos-props=LocationInfoEventDeployment, required-service-instance-id=5049
    LibRPortPrototype3_DdsRequiredServiceInstance113: service-interface-deployment=SensorLidarPointCloudServiceInterface_DdsDeployment, dds-event-qos-props=EventPointCloud2DdsDeployment, required-service-instance-id=5050
    LibRPortPrototype1_DdsRequiredServiceInstance111: service-interface-deployment=SensorLidarPointCloudServiceInterface_DdsDeployment, dds-event-qos-props=EventPointCloud2DdsDeployment, required-service-instance-id=5051
    LibRPortPrototype1_DdsRequiredServiceInstance110: service-interface-deployment=SensorLidarPointCloudServiceInterface_DdsDeployment, dds-event-qos-props=EventPointCloud2DdsDeployment, required-service-instance-id=5052
package /HuaweiMDC/instance_manifests/instanceToMachineMappings
  6 x dds service instance to machine mapping, all with communication-connector=Host0DpEthernetCommConnector:
    Liblidarpointsright_DdsRequiredServiceInstance189_ToDdsMachineMapping: service-instance=Liblidarpointsright_DdsRequiredServiceInstance189
    Libtpterrainmap_DdsProvidedServiceInstance31_ToDdsMachineMapping: service-instance=Libtpterrainmap_DdsProvidedServiceInstance31
    LibRPortPrototype5_DdsRequiredServiceInstance115_ToDdsMachineMapping: service-instance=LibRPortPrototype5_DdsRequiredServiceInstance115
    LibRPortPrototype3_DdsRequiredServiceInstance113_ToDdsMachineMapping: service-instance=LibRPortPrototype3_DdsRequiredServiceInstance113
    LibRPortPrototype1_DdsRequiredServiceInstance111_ToDdsMachineMapping: service-instance=LibRPortPrototype1_DdsRequiredServiceInstance111
    LibRPortPrototype1_DdsRequiredServiceInstance110_ToDdsMachineMapping: service-instance=LibRPortPrototype1_DdsRequiredServiceInstance110
package /HuaweiMDC/instance_manifests/providedInstances
  dds provided service instance Libtpterrainmap_DdsProvidedServiceInstance31: service-interface-deployment=PerceptionStaticEnvServiceInterface_DdsDeployment, qos-profile=default_qos.xml, domain-id=30, transport-plugins=SHM, dds-event-qos-props=EventPerceptionStaticEnvDdsDeployment, service-instance-id=5048
