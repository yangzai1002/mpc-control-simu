AUTOSAR XML (schema 00048)
package /HuaweiMDC/FunctionalSoftware/Location/SwComponent
  executable fusion_location_base
    root sw component prototype fusion_location_base_rootswc: application-type=fusion_location_base
