AUTOSAR XML (schema 00048)
package /HuaweiMDC/process_manifests/processDesigns
  process design LibLocationProcessDesign27: executable=fusion_location_base
package /HuaweiMDC/process_manifests/processes
  process LibLocationProcess27: design=LibLocationProcessDesign27, executable=fusion_location_base, log-trace-default-log-level=INFO, log-trace-log-modes=NETWORK
package /HuaweiMDC/process_manifests/processToMachineMappingSets
  process to machine mapping set LibProcessToMachineMappingSet_LocationProcess27
    process to machine mapping LibprocessToMachineMapping26: machine=Host0DpMachine, process=LibLocationProcess27
package /HuaweiMDC/exe_manifests/InstanceToPortMappings
  11 x service instance to port prototype mapping, all with process=LibLocationProcessDesign27:
    LibRPortPrototype5_DdsRequiredServiceInstance111_PortMapping: port-prototype=fusion_location_base_rootswc.tpimu, service-instance=LibRPortPrototype5_DdsRequiredServiceInstance111
    Libtpimu_DdsRequiredServiceInstance185_PortMapping: port-prototype=fusion_location_base_rootswc.tpimu, service-instance=Libtpimu_DdsRequiredServiceInstance185
    LibRPortPrototype6_DdsRequiredServiceInstance112_PortMapping: port-prototype=fusion_location_base_rootswc.tpwheelspeed, service-instance=LibRPortPrototype6_DdsRequiredServiceInstance112
    Libivwheelspeed_DdsRequiredServiceInstance184_PortMapping: port-prototype=fusion_location_base_rootswc.tpwheelspeed, service-instance=Libivwheelspeed_DdsRequiredServiceInstance184
    LibRPortPrototype8_DdsRequiredServiceInstance114_PortMapping: port-prototype=fusion_location_base_rootswc.tpododr, service-instance=LibRPortPrototype8_DdsRequiredServiceInstance114
    LibRPortPrototype1_DdsRequiredServiceInstance107_PortMapping: port-prototype=fusion_location_base_rootswc.tpfront_middle_lidar_points, service-instance=LibRPortPrototype1_DdsRequiredServiceInstance107
    LibRPortPrototype3_DdsRequiredServiceInstance109_PortMapping: port-prototype=fusion_location_base_rootswc.tpfront_right_lidar_points, service-instance=LibRPortPrototype3_DdsRequiredServiceInstance109
    LibRPortPrototype7_DdsRequiredServiceInstance113_PortMapping: port-prototype=fusion_location_base_rootswc.tpliodr, service-instance=LibRPortPrototype7_DdsRequiredServiceInstance113
    Libtpfusionloc_DdsProvidedServiceInstance38_PortMapping: port-prototype=fusion_location_base_rootswc.tpfusionloc, service-instance=Libtpfusionloc_DdsProvidedServiceInstance38
    LibRPortPrototype4_DdsRequiredServiceInstance110_PortMapping: port-prototype=fusion_location_base_rootswc.tpsensorimu, service-instance=LibRPortPrototype4_DdsRequiredServiceInstance110
    Libivwheelspeed_DdsRequiredServiceInstance186_PortMapping: port-prototype=fusion_location_base_rootswc.tpwheelspeed, service-instance=Libivwheelspeed_DdsRequiredServiceInstance186
package /HuaweiMDC/instance_manifests/requiredInstances
  10 x dds required service instance, all with qos-profile=default_qos.xml, domain-id=30, transport-plugins=SHM:
    LibRPortPrototype5_DdsRequiredServiceInstance111: service-interface-deployment=LocationDdsInterfaceDeployment, dds-event-qos-props=LocationEventDeployment, required-service-instance-id=5000
    Libtpimu_DdsRequiredServiceInstance185: service-interface-deployment=LocationDdsInterfaceDeployment, dds-event-qos-props=LocationEventDeployment, required-service-instance-id=5001
    LibRPortPrototype6_DdsRequiredServiceInstance112: service-interface-deployment=SensorWheelSpeedServiceInterface_DdsDeployment, dds-event-qos-props=EventWheelSpeedDdsDeployment, required-service-instance-id=5002
    Libivwheelspeed_DdsRequiredServiceInstance184: service-interface-deployment=SensorWheelSpeedServiceInterface_DdsDeployment, dds-event-qos-props=EventWheelSpeedDdsDeployment, required-service-instance-id=5003
    LibRPortPrototype8_DdsRequiredServiceInstance114: service-interface-deployment=LocationInfoDdsInterfaceDeployment, dds-event-qos-props=LocationInfoEventDeployment, required-service-instance-id=5004
    LibRPortPrototype1_DdsRequiredServiceInstance107: service-interface-deployment=SensorLidarPointCloudServiceInterface_DdsDeployment, dds-event-qos-props=EventPointCloud2DdsDeployment, required-service-instance-id=5005
    LibRPortPrototype3_DdsRequiredServiceInstance109: service-interface-deployment=SensorLidarPointCloudServiceInterface_DdsDeployment, dds-event-qos-props=EventPointCloud2DdsDeployment, required-service-instance-id=5006
    LibRPortPrototype7_DdsRequiredServiceInstance113: service-interface-deployment=LocationInfoDdsInterfaceDeployment, dds-event-qos-props=LocationInfoEventDeployment, required-service-instance-id=5007
    LibRPortPrototype4_DdsRequiredServiceInstance110: service-interface-deployment=SensorImuServiceInterface_DdsDeployment, dds-event-qos-props=EventSensorImuDdsDeployment, required-service-instance-id=5009
    Libivwheelspeed_DdsRequiredServiceInstance186: service-interface-deployment=SensorWheelSpeedServiceInterface_DdsDeployment, dds-event-qos-props=EventWheelSpeedDdsDeployment, required-service-instance-id=5010
package /HuaweiMDC/instance_manifests/instanceToMachineMappings
  14 x dds service instance to machine mapping, all with communication-connector=Host0DpEthernetCommConnector:
    LibRPortPrototype5_DdsRequiredServiceInstance111_ToDdsMachineMapping: service-instance=LibRPortPrototype5_DdsRequiredServiceInstance111
    Libtpimu_DdsRequiredServiceInstance185_ToDdsMachineMapping: service-instance=Libtpimu_DdsRequiredServiceInstance185
    LibRPortPrototype6_DdsRequiredServiceInstance112_ToDdsMachineMapping: service-instance=LibRPortPrototype6_DdsRequiredServiceInstance112
    Libivwheelspeed_DdsRequiredServiceInstance184_ToDdsMachineMapping: service-instance=Libivwheelspeed_DdsRequiredServiceInstance184
    LibRPortPrototype8_DdsRequiredServiceInstance114_ToDdsMachineMapping: service-instance=LibRPortPrototype8_DdsRequiredServiceInstance114
    LibRPortPrototype1_DdsRequiredServiceInstance107_ToDdsMachineMapping: service-instance=LibRPortPrototype1_DdsRequiredServiceInstance107
    LibRPortPrototype1_DdsRequiredServiceInstance107_ToDdsMachineMapping: service-instance=LibRPortPrototype1_DdsRequiredServiceInstance107
    LibRPortPrototype3_DdsRequiredServiceInstance109_ToDdsMachineMapping: service-instance=LibRPortPrototype3_DdsRequiredServiceInstance109
    LibRPortPrototype3_DdsRequiredServiceInstance109_ToDdsMachineMapping: service-instance=LibRPortPrototype3_DdsRequiredServiceInstance109
    LibRPortPrototype7_DdsRequiredServiceInstance113_ToDdsMachineMapping: service-instance=LibRPortPrototype7_DdsRequiredServiceInstance113
    Libtpfusionloc_DdsProvidedServiceInstance38_ToDdsMachineMapping: service-instance=Libtpfusionloc_DdsProvidedServiceInstance38
    LibRPortPrototype4_DdsRequiredServiceInstance110_ToDdsMachineMapping: service-instance=LibRPortPrototype4_DdsRequiredServiceInstance110
    LibRPortPrototype4_DdsRequiredServiceInstance110_ToDdsMachineMapping: service-instance=LibRPortPrototype4_DdsRequiredServiceInstance110
    Libivwheelspeed_DdsRequiredServiceInstance186_ToDdsMachineMapping: service-instance=Libivwheelspeed_DdsRequiredServiceInstance186
package /HuaweiMDC/instance_manifests/providedInstances
  dds provided service instance Libtpfusionloc_DdsProvidedServiceInstance38: service-interface-deployment=LocationInfoDdsInterfaceDeployment, qos-profile=default_qos.xml, domain-id=30, transport-plugins=SHM, dds-event-qos-props=LocationInfoEventDeployment, service-instance-id=5008
