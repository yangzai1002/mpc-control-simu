AUTOSAR XML (schema 00048)
package /HuaweiMDC/process_manifests/processDesigns
  process design Libhw_camera_listProcessDesign1: executable=hw_camera_list
package /HuaweiMDC/process_manifests/processes
  process Libhw_camera_listProcess1: design=Libhw_camera_listProcessDesign1, executable=hw_camera_list, log-trace-default-log-level=INFO, log-trace-log-modes=NETWORK
package /HuaweiMDC/process_manifests/processToMachineMappingSets
  process to machine mapping set LibProcessToMachineMappingSet_hw_camera_listProcess1
    process to machine mapping LibprocessToMachineMapping0: machine=Host0DpMachine, process=Libhw_camera_listProcess1
package /HuaweiMDC/exe_manifests/InstanceToPortMappings
  service instance to port prototype mapping Libcompressed_image_list_DdsProvidedServiceInstance41_PortMapping: port-prototype=hw_camera_list_rootswc.compressed_image_list, process=Libhw_camera_listProcessDesign1, service-instance=Libcompressed_image_list_DdsProvidedServiceInstance41
  service instance to port prototype mapping LibImageListPPortPrototype_DdsProvidedServiceInstance1_PortMapping: port-prototype=hw_camera_list_rootswc.image_list, process=Libhw_camera_listProcessDesign1, service-instance=LibImageListPPortPrototype_DdsProvidedServiceInstance1
package /HuaweiMDC/instance_manifests/providedInstances
  dds provided service instance Libcompressed_image_list_DdsProvidedServiceInstance41: service-interface-deployment=SensorCompressedImageListServiceInterface_DdsDeployment, qos-profile=default_qos.xml, domain-id=30, transport-plugins=SHM, dds-event-qos-props=EventCompressedImageListDdsDeployment, service-instance-id=5017
  dds provided service instance LibImageListPPortPrototype_DdsProvidedServiceInstance1: service-interface-deployment=SensorImageListServiceInterface_DdsDeployment, qos-profile=default_qos.xml, domain-id=30, transport-plugins=SHM, dds-event-qos-props=EventImageListDdsDeployment, service-instance-id=5018
package /HuaweiMDC/instance_manifests/instanceToMachineMappings
  dds service instance to machine mapping Libcompressed_image_list_DdsProvidedServiceInstance41_ToDdsMachineMapping: communication-connector=Host0DpEthernetCommConnector, service-instance=Libcompressed_image_list_DdsProvidedServiceInstance41
  dds service instance to machine mapping LibImageListPPortPrototype_DdsProvidedServiceInstance1_ToDdsMachineMapping: communication-connector=Host0DpEthernetCommConnector, service-instance=LibImageListPPortPrototype_DdsProvidedServiceInstance1
