AUTOSAR XML (schema 00048)
package /HuaweiMDC/exe_manifests/swcs
  executable hw_camera_list
    root sw component prototype hw_camera_list_rootswc: application-type=hw_camera_list
