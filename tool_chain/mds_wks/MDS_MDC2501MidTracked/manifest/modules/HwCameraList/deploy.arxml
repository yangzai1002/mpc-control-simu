AUTOSAR XML (schema 00048)
package /HuaweiMDC/process_manifests/processDesigns
  process design hw_camera_listProcessDesign1: executable=HwCameraList
package /HuaweiMDC/process_manifests/processes
  process hw_camera_listProcess1: design=hw_camera_listProcessDesign1, executable=HwCameraList, log-trace-default-log-level=INFO, log-trace-log-modes=NETWORK
package /HuaweiMDC/process_manifests/processToMachineMappingSets
  process to machine mapping set ProcessToMachineMappingSet_hw_camera_listProcess1
    process to machine mapping processToMachineMapping0: machine=Host0DpMachine, process=hw_camera_listProcess1
package /HuaweiMDC/exe_manifests/InstanceToPortMappings
  service instance to port prototype mapping compressed_image_list_DdsProvidedServiceInstance41_PortMapping: port-prototype=hw_camera_listExecutable1Prototype.compressed_image_list, process=hw_camera_listProcessDesign1, service-instance=compressed_image_list_DdsProvidedServiceInstance41
  service instance to port prototype mapping ImageListPPortPrototype_DdsProvidedServiceInstance1_PortMapping: port-prototype=hw_camera_listExecutable1Prototype.image_list, process=hw_camera_listProcessDesign1, service-instance=ImageListPPortPrototype_DdsProvidedServiceInstance1
package /HuaweiMDC/instance_manifests/providedInstances
  dds provided service instance compressed_image_list_DdsProvidedServiceInstance41: service-interface-deployment=SensorCompressedImageListServiceInterface_DdsDeployment, qos-profile=default_qos.xml, domain-id=30, transport-plugins=SHM, dds-event-qos-props=EventCompressedImageListDdsDeployment, service-instance-id=20210
  dds provided service instance ImageListPPortPrototype_DdsProvidedServiceInstance1: service-interface-deployment=SensorImageListServiceInterface_DdsDeployment, qos-profile=default_qos.xml, domain-id=30, transport-plugins=SHM, dds-event-qos-props=EventImageListDdsDeployment, service-instance-id=20200
package /HuaweiMDC/instance_manifests/instanceToMachineMappings
  dds service instance to machine mapping compressed_image_list_DdsProvidedServiceInstance41_ToDdsMachineMapping: communication-connector=Host0DpEthernetCommConnector, service-instance=compressed_image_list_DdsProvidedServiceInstance41
  dds service instance to machine mapping ImageListPPortPrototype_DdsProvidedServiceInstance1_ToDdsMachineMapping: communication-connector=Host0DpEthernetCommConnector, service-instance=ImageListPPortPrototype_DdsProvidedServiceInstance1
