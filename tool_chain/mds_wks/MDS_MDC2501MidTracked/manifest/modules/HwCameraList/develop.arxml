AUTOSAR XML (schema 00048)
package /HuaweiMDC/exe_manifests/exes
  executable HwCameraList: logging-behavior=USES-LOGGING, reporting-behavior=REPORTS-EXECUTION-STATE
    root sw component prototype hw_camera_listExecutable1Prototype: application-type=hw_camera_listCompositionSwComponentType1
package /HuaweiMDC/Common/Common
  composition sw component type hw_camera_listCompositionSwComponentType1
    component hw_camera_listPrototype: type=hw_camera_list
