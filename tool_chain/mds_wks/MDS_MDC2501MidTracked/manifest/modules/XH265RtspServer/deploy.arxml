AUTOSAR XML (schema 00048)
package /HuaweiMDC/process_manifests/processDesigns
  process design rtspserverswcProcessDesign24: executable=XH265RtspServer
package /HuaweiMDC/process_manifests/processes
  process rtspserverswcProcess24: design=rtspserverswcProcessDesign24, executable=XH265RtspServer, log-trace-default-log-level=INFO, log-trace-log-modes=NETWORK
package /HuaweiMDC/process_manifests/processToMachineMappingSets
  process to machine mapping set ProcessToMachineMappingSet_rtspserverswcProcess24
    process to machine mapping processToMachineMapping23: machine=Host0DpMachine, process=rtspserverswcProcess24
package /HuaweiMDC/exe_manifests/InstanceToPortMappings
  service instance to port prototype mapping RPortPrototype2_DdsRequiredServiceInstance158_PortMapping: port-prototype=rtspserverswcExecutable24Prototype.video_encoded_frame, process=rtspserverswcProcessDesign24, service-instance=RPortPrototype2_DdsRequiredServiceInstance158
package /HuaweiMDC/instance_manifests/requiredInstances
  dds required service instance RPortPrototype2_DdsRequiredServiceInstance158: service-interface-deployment=SensorImageServiceInterface_DdsDeployment, qos-profile=default_qos.xml, domain-id=30, transport-plugins=SHM, dds-event-qos-props=EventSensorImageDdsDeployment, required-service-instance-id=20247
package /HuaweiMDC/instance_manifests/instanceToMachineMappings
  dds service instance to machine mapping RPortPrototype2_DdsRequiredServiceInstance158_ToDdsMachineMapping: communication-connector=Host0DpEthernetCommConnector, service-instance=RPortPrototype2_DdsRequiredServiceInstance158
