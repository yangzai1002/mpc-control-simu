AUTOSAR XML (schema 00048)
package /HuaweiMDC/exe_manifests/exes
  executable XH265RtspServer: logging-behavior=USES-LOGGING, reporting-behavior=REPORTS-EXECUTION-STATE
    root sw component prototype rtspserverswcExecutable24Prototype: application-type=rtspserverswcCompositionSwComponentType24
package /HuaweiMDC/Common/Common
  composition sw component type rtspserverswcCompositionSwComponentType24
    component rtspserverswcPrototype: type=rtspserverswc
