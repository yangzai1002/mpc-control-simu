AUTOSAR XML (schema 00048)
package /HuaweiMDC/process_manifests/processDesigns
  process design sensor_viualize_baseProcessDesign38: executable=SensorVisualize
package /HuaweiMDC/process_manifests/processes
  process sensor_viualize_baseProcess38: design=sensor_viualize_baseProcessDesign38, executable=SensorVisualize, log-trace-default-log-level=INFO, log-trace-log-modes=NETWORK
package /HuaweiMDC/process_manifests/processToMachineMappingSets
  process to machine mapping set ProcessToMachineMappingSet_sensor_viualize_baseProcess38
    process to machine mapping processToMachineMapping37: machine=Host0DpMachine, process=sensor_viualize_baseProcess38
package /HuaweiMDC/exe_manifests/InstanceToPortMappings
  service instance to port prototype mapping RPortPrototype1_DdsRequiredServiceInstance163_PortMapping: port-prototype=sensor_viualize_baseExecutable38Prototype.tplidarfront, process=sensor_viualize_baseProcessDesign38, service-instance=tplidarfront
  service instance to port prototype mapping RPortPrototype2_DdsRequiredServiceInstance164_PortMapping: port-prototype=sensor_viualize_baseExecutable38Prototype.tpcameralist, process=sensor_viualize_baseProcessDesign38, service-instance=RPortPrototype2_DdsRequiredServiceInstance164
  service instance to port prototype mapping RPortPrototype1_DdsRequiredServiceInstance110_PortMapping: port-prototype=sensor_viualize_baseExecutable38Prototype.RPortPrototype1, process=sensor_viualize_baseProcessDesign38, service-instance=RPortPrototype1_DdsRequiredServiceInstance110
package /HuaweiMDC/instance_manifests/requiredInstances
  dds required service instance tplidarfront: service-interface-deployment=SensorLidarPointCloudServiceInterface_DdsDeployment, qos-profile=default_qos.xml, domain-id=30, transport-plugins=SHM, dds-event-qos-props=EventPointCloud2DdsDeployment, required-service-instance-id=20201
  dds required service instance RPortPrototype2_DdsRequiredServiceInstance164: service-interface-deployment=SensorImageListServiceInterface_DdsDeployment, qos-profile=default_qos.xml, domain-id=30, transport-plugins=SHM, dds-event-qos-props=EventImageListDdsDeployment, required-service-instance-id=20200
  dds required service instance RPortPrototype1_DdsRequiredServiceInstance110: service-interface-deployment=RadarPointCloudServiceInterface_DdsDeployment, qos-profile=default_qos.xml, domain-id=30, transport-plugins=SHM, dds-event-qos-props=EventRadarPointCloudDdsDeployment, required-service-instance-id=20225
package /HuaweiMDC/instance_manifests/instanceToMachineMappings
  dds service instance to machine mapping RPortPrototype1_DdsRequiredServiceInstance163_ToDdsMachineMapping: communication-connector=Host0DpEthernetCommConnector, service-instance=tplidarfront
  dds service instance to machine mapping RPortPrototype2_DdsRequiredServiceInstance164_ToDdsMachineMapping: communication-connector=Host0DpEthernetCommConnector, service-instance=RPortPrototype2_DdsRequiredServiceInstance164
  dds service instance to machine mapping RPortPrototype1_DdsRequiredServiceInstance110_ToDdsMachineMapping: communication-connector=Host0DpEthernetCommConnector, service-instance=RPortPrototype1_DdsRequiredServiceInstance110
