AUTOSAR XML (schema 00048)
package /HuaweiMDC/exe_manifests/exes
  executable SensorVisualize: logging-behavior=USES-LOGGING, reporting-behavior=REPORTS-EXECUTION-STATE
    root sw component prototype sensor_viualize_baseExecutable38Prototype: application-type=sensor_viualize_baseCompositionSwComponentType38
package /HuaweiMDC/Common/Common
  composition sw component type sensor_viualize_baseCompositionSwComponentType38
    component sensor_viualize_basePrototype: type=sensor_viualize_base
