AUTOSAR XML (schema 00048)
package /HuaweiMDC/process_manifests/processDesigns
  process design xh265_encoderProcessDesign19: executable=XH265Encoder
package /HuaweiMDC/process_manifests/processes
  process xh265_encoderProcess19: design=xh265_encoderProcessDesign19, executable=XH265Encoder, log-trace-default-log-level=INFO, log-trace-log-modes=NETWORK
package /HuaweiMDC/process_manifests/processToMachineMappingSets
  process to machine mapping set ProcessToMachineMappingSet_xh265_encoderProcess19
    process to machine mapping processToMachineMapping18: machine=Host0DpMachine, process=xh265_encoderProcess19
package /HuaweiMDC/exe_manifests/InstanceToPortMappings
  service instance to port prototype mapping video_encoded_frame_DdsProvidedServiceInstance49_PortMapping: port-prototype=xh265_encoderExecutable19Prototype.video_encoded_frame, process=xh265_encoderProcessDesign19, service-instance=video_encoded_frame_DdsProvidedServiceInstance49
package /HuaweiMDC/instance_manifests/providedInstances
  dds provided service instance video_encoded_frame_DdsProvidedServiceInstance49: service-interface-deployment=SensorImageServiceInterface_DdsDeployment, qos-profile=default_qos.xml, domain-id=30, transport-plugins=SHM, dds-event-qos-props=EventSensorImageDdsDeployment, service-instance-id=20247
package /HuaweiMDC/instance_manifests/instanceToMachineMappings
  dds service instance to machine mapping video_encoded_frame_DdsProvidedServiceInstance49_ToDdsMachineMapping: communication-connector=Host0DpEthernetCommConnector, service-instance=video_encoded_frame_DdsProvidedServiceInstance49
