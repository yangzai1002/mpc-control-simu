AUTOSAR XML (schema 00048)
package /HuaweiMDC/exe_manifests/exes
  executable XH265Encoder: logging-behavior=USES-LOGGING, reporting-behavior=REPORTS-EXECUTION-STATE
    root sw component prototype xh265_encoderExecutable19Prototype: application-type=xh265_encoderCompositionSwComponentType19
package /HuaweiMDC/Common/Common
  composition sw component type xh265_encoderCompositionSwComponentType19
    component xh265_encoderPrototype: type=xh265_encoder
