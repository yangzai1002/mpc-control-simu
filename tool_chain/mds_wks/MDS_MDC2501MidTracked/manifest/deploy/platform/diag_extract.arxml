AUTOSAR XML (schema 00048)
package /HuaweiMDC/DiagnosticMdcExtractTemplate/DEM/DTCs/ExtendedDataRecords
  diagnostic extended data record extendDataRecord_1: record-number=1, trigger=TEST-FAILED, update=true
  diagnostic extended data record extendDataRecord_2: record-number=2, trigger=TEST-FAILED, update=true
package /HuaweiMDC/DiagnosticMdcExtractTemplate/DEM/DTCs/FreezeFrames
  diagnostic freeze frame snapshot1: record-number=1, trigger=TEST-FAILED, update=true
package /HuaweiMDC/DiagnosticMdcExtractTemplate/DEM/DTCs/DiagAgings
  diagnostic aging aging1: aging-cycles=opcycle_sleep_wakeup, threshold=100
package /HuaweiMDC/DiagnosticMdcExtractTemplate/DEM/OperationCylces
  diagnostic operation cycle opcycle_sleep_wakeup: automatic-end=false, cycle-autostart=false, cycle-status-storage=false, type=WARMUP
package /HuaweiMDC/DiagnosticMdcExtractTemplate/CommConfig
  diagnostic software cluster props DtcStatusAvailability: dtc-status-availability-mask=127
  diagnostic contribution set MdcDext
    common-properties aging-requires-tested-cycle=false, clear-dtc-limitation=ALL-SUPPORTED-DTCS, dtc-status-availability-mask=9, max-number-of-request-correctly-received-response-pending=3, memory-entry-storage-trigger=CONFIRMED, response-on-second-declined-request=false, status-bit-handling-test-failed-since-last-clear=STATUS-BIT-AGING-AND-DISPLACEMENT, type-of-dtc-supported=SAE-J-2012--DA, type-of-freeze-frame-record-numeration=CALCULATED:
      diagnostic debounce algorithm props debounceAlgorithm_noDebounce: debounce-behavior=FREEZE
        debounce-algorithm:
          diag event debounce monitor internal debounceAlgorithm_noDebounce
    elements:
      aging1
      AllSessionAccessPermission
      DefaultSession
      extendDataRecord_1
      extendDataRecord_2
      ExtendedSession
      Level1
      Level2
      NonDefaultSessionWithLevel1AccessPermission
      NonDefaultSessionAccessPermission
      NonProgrammingSessionAccessPermission
      OnlyExtendedSessionWithLevel1AccessPermission
      OnlyExtendedSessionAccessPermission
      OnlyProgrammingSessionWithLevel1AccessPermission
      ProgrammingSession
      snapshot1
      opcycle_sleep_wakeup
      DiagnosticDataIdentifier_0xd005
      DiagnosticDataIdentifier_0x{9103..9106}
      DiagnosticDataIdentifier_0xd003
      NonDefaultSessionWithLevel1AndLevel2AccessPermission
      NonDefaultSessionWithLevel2AccessPermission
      OnlyProgrammingSessionWithLevel1AndLevel2AccessPermission
      OnlyProgrammingSessionWithLevel2AccessPermission
      OnlyExtendedSessionWithLevel1AndLevel2AccessPermission
      OnlyExtendedSessionWithLevel2AccessPermission
      OnlyProgrammingSessionAccessPermission
package /HuaweiMDC/DiagnosticMdcExtractTemplate/DCM/DignosticSessions
  diagnostic session DefaultSession: id=1, jump-to-boot-loader=NO-BOOT, p-2-server-max=0.05, p-2-star-server-max=4.0
  diagnostic session ExtendedSession: id=3, jump-to-boot-loader=NO-BOOT, p-2-server-max=0.05, p-2-star-server-max=4.0
  diagnostic session ProgrammingSession: id=2, jump-to-boot-loader=NO-BOOT, p-2-server-max=0.05, p-2-star-server-max=4.0
package /HuaweiMDC/DiagnosticMdcExtractTemplate/DCM/SecurityLevels
  diagnostic security level Level1: key-size=4, num-failed-security-access=3, security-delay-time=10.0, seed-size=4
  diagnostic security level Level2: key-size=16, num-failed-security-access=3, security-delay-time=10.0, seed-size=16
package /HuaweiMDC/DiagnosticMdcExtractTemplate/DCM/DIDs
  6 x diagnostic data identifier:
    DiagnosticDataIdentifier_0x9103: id=37123, did-size=2
      diagnostic-parameter bit-offset=0:
        diagnostic data element DiagnosticDataElement_0x9103
    DiagnosticDataIdentifier_0x9104: id=37124, did-size=3
      diagnostic-parameter bit-offset=0:
        diagnostic data element DiagnosticDataElement_0x9104
    DiagnosticDataIdentifier_0x9105: id=37125, did-size=5
      diagnostic-parameter bit-offset=0:
        diagnostic data element DiagnosticDataElement_0x9105
    DiagnosticDataIdentifier_0x9106: id=37126, did-size=4
      diagnostic-parameter bit-offset=0:
        diagnostic data element DiagnosticDataElement_0x9106
    DiagnosticDataIdentifier_0xd003: id=53251, did-size=1
      diagnostic-parameter bit-offset=0:
        diagnostic data element DiagnosticDataElement_0xd003
    DiagnosticDataIdentifier_0xd005: id=53253, did-size=4
      diagnostic-parameter bit-offset=0:
        diagnostic data element DiagnosticDataElement_0xd005
package /HuaweiMDC/DiagnosticMdcExtractTemplate/DCM/AccessPermission
  14 x diagnostic access permission:
    AllSessionAccessPermission: diagnostic-session=[DefaultSession, ProgrammingSession, ExtendedSession]
    OnlyExtendedSessionAccessPermission: diagnostic-session=ExtendedSession
    NonDefaultSessionAccessPermission: diagnostic-session=[ProgrammingSession, ExtendedSession]
    OnlyProgrammingSessionAccessPermission: diagnostic-session=ProgrammingSession
    NonDefaultSessionWithLevel1AccessPermission: diagnostic-session=[ProgrammingSession, ExtendedSession], security-level=Level1
    OnlyProgrammingSessionWithLevel1AccessPermission: diagnostic-session=ProgrammingSession, security-level=Level1
    OnlyExtendedSessionWithLevel1AccessPermission: diagnostic-session=ExtendedSession, security-level=Level1
    NonProgrammingSessionAccessPermission: diagnostic-session=[DefaultSession, ExtendedSession]
    NonDefaultSessionWithLevel2AccessPermission: diagnostic-session=[ProgrammingSession, ExtendedSession], security-level=Level2
    NonDefaultSessionWithLevel1AndLevel2AccessPermission: diagnostic-session=[ProgrammingSession, ExtendedSession], security-level=[Level1, Level2]
    OnlyProgrammingSessionWithLevel2AccessPermission: diagnostic-session=ProgrammingSession, security-level=Level2
    OnlyProgrammingSessionWithLevel1AndLevel2AccessPermission: diagnostic-session=ProgrammingSession, security-level=[Level1, Level2]
    OnlyExtendedSessionWithLevel2AccessPermission: diagnostic-session=ExtendedSession, security-level=Level2
    OnlyExtendedSessionWithLevel1AndLevel2AccessPermission: diagnostic-session=ExtendedSession, security-level=[Level1, Level2]
package /HuaweiMDC/DiagnosticMdcExtractTemplate/DCM/DiagClass
  diagnostic read data by identifier class readDidClass: access-permission-validity=ACCESS-PERMISSION-INSTANCE-OVERRIDES-CLASS, max-did-to-read=1024
  diagnostic write data by identifier class writeDidClass: access-permission-validity=ACCESS-PERMISSION-INSTANCE-OVERRIDES-CLASS
  diagnostic io control class ioCtrlClass: access-permission-validity=ACCESS-PERMISSION-INSTANCE-OVERRIDES-CLASS
  diagnostic routine control class routineClass: access-permission-validity=ACCESS-PERMISSION-INSTANCE-OVERRIDES-CLASS
