AUTOSAR XML (schema 00048)
package /HuaweiMDC/FunctionalSoftware/CameraLane/Execution
  executable camera_lane_execute
    root sw component prototype camera_lane_root_swc: application-type=camera_lane_base
package /HuaweiMDC/FunctionalSoftware/CameraLane/SwComponent
  adaptive application sw component type camera_lane_base
    provide port LaneLinePPort: provided-interface=LaneArrayIntf
