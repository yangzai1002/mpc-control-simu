AUTOSAR XML (schema 00048)
package /HuaweiMDC/FunctionalSoftware/RoadFeature/Execution
  executable road_feature_execute
    root sw component prototype road_featue_root_swc: application-type=road_feature_base
package /HuaweiMDC/FunctionalSoftware/RoadFeature/SwComponent
  adaptive application sw component type road_feature_base
    provide port ImagePPort: provided-interface=CameraDecodedServiceInterface
