AUTOSAR XML (schema 00048)
package /HuaweiMDC/FunctionalSoftware/MapMatching/Execution
  executable mapping_execute
    root sw component prototype mapping_root_swc: application-type=map_matching_base
package /HuaweiMDC/FunctionalSoftware/MapMatching/SwComponent
  adaptive application sw component type map_matching_base
    provide port MapMatchingPPort: provided-interface=LocationInfoIntf
