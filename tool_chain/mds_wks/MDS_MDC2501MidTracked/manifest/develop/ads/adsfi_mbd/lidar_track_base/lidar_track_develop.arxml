AUTOSAR XML (schema 00048)
package /HuaweiMDC/FunctionalSoftware/LidarTrack/Execution
  executable lidar_track_execute
    root sw component prototype lidar_track_root_swc: application-type=lidar_track_base
package /HuaweiMDC/FunctionalSoftware/LidarTrack/SwComponent
  adaptive application sw component type lidar_track_base
    provide port Object3dPPort: provided-interface=Object3dArrayIntf
