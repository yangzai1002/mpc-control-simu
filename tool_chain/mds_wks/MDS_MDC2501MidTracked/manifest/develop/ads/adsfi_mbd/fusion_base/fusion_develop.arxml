AUTOSAR XML (schema 00048)
package /HuaweiMDC/FunctionalSoftware/Fusion/Execution
  executable fusion_execute
    root sw component prototype fusion_root_swc: application-type=fusion_base
package /HuaweiMDC/FunctionalSoftware/Fusion/SwComponent
  adaptive application sw component type fusion_base
    provide port FusionObjectPPort: provided-interface=FusionObjectArrayIntf
