AUTOSAR XML (schema 00048)
package /HuaweiMDC/FunctionalSoftware/CameraLidarDet/Execution
  executable camera_lidar_det_execute
    root sw component prototype camera_lidar_det_root_swc: application-type=camera_lidar_det_base
package /HuaweiMDC/FunctionalSoftware/CameraLidarDet/SwComponent
  adaptive application sw component type camera_lidar_det_base
    provide port Object3dPPort: provided-interface=Object3dArrayIntf
