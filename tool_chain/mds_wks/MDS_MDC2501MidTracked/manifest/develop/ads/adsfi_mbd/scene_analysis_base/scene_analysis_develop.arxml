AUTOSAR XML (schema 00048)
package /HuaweiMDC/FunctionalSoftware/SceneAnalysis/Execution
  executable scene_analysis_execute
    root sw component prototype scene_analysis_root_swc: application-type=scene_analysis_base
package /HuaweiMDC/FunctionalSoftware/SceneAnalysis/SwComponent
  adaptive application sw component type scene_analysis_base
    provide port SceneFeaturePPort: provided-interface=SceneFeatureIntf
