AUTOSAR XML (schema 00048)
package /HuaweiMDC/FunctionalSoftware/SceneManage/Execution
  executable scene_manage_execute
    root sw component prototype scene_manage_root_swc: application-type=scene_manage_base
package /HuaweiMDC/FunctionalSoftware/SceneManage/SwComponent
  adaptive application sw component type scene_manage_base
    provide port ScenePPort: provided-interface=SceneIntf
