AUTOSAR XML (schema 00048)
package /HuaweiMDC/FunctionalSoftware/VisualSlam/Execution
  executable visual_slam_execute
    root sw component prototype visual_slam_root_swc: application-type=visual_slam_base
package /HuaweiMDC/FunctionalSoftware/VisualSlam/SwComponent
  adaptive application sw component type visual_slam_base
    provide port VisualSLamPPort: provided-interface=LocationInfoIntf
