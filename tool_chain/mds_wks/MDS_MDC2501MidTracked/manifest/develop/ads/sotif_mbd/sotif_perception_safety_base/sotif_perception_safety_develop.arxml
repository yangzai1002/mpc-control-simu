AUTOSAR XML (schema 00048)
package /HuaweiMDC/Sotif/PerceptionSafety/Execution
  executable sotif_perception_safety_execute
    root sw component prototype sotif_perception_safety_root_swc: application-type=sotif_perception_safety_base
package /HuaweiMDC/Sotif/PerceptionSafety/SwComponent
  adaptive application sw component type sotif_perception_safety_base
    provide port PerceptionSafetyArrayPPort: provided-interface=PerceptionSafetyArrayIntf
