AUTOSAR XML (schema 00048)
package /HuaweiMDC/Sotif/DecisionSafety/Execution
  executable sotif_decision_safety_execute
    root sw component prototype sotif_decision_safety_root_swc: application-type=sotif_decision_safety_base
package /HuaweiMDC/Sotif/DecisionSafety/SwComponent
  adaptive application sw component type sotif_decision_safety_base
    provide port DecisionSafetyPPort: provided-interface=DecisionSafetyServiceInterface
