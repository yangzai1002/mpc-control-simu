AUTOSAR XML (schema 00048)
package /HuaweiMDC/PlatformApplication/LpmClientApplication/Execution
  executable lpm_client
    root sw component prototype lpm_client: application-type=lpm_client
package /HuaweiMDC/PlatformApplication/LpmClientApplication/SwComponent
  adaptive application sw component type lpm_client
    require port LpmClientFromLpmcRPort: required-interface=LpmcServiceInterface
