AUTOSAR XML (schema 00048)
package /HuaweiMDC/PlatformApplication/FmLibApplication/Execution
  executable fm_lib
    root sw component prototype fm_lib: application-type=fm_lib
package /HuaweiMDC/PlatformApplication/FmLibApplication/SwcComponent
  adaptive application sw component type fm_lib
    require port queryRPort: required-interface=FmQueryService
    require port reportEventRPort: required-interface=FmReportEventService
