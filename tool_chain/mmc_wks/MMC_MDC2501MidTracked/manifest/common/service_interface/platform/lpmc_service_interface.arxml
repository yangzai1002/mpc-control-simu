AUTOSAR XML (schema 00048)
package /HuaweiMDC/PlatformServiceInterface/LpmcMsgDataTypes/DataTypes
  std cpp implementation data type MdcWakeupEventData: category=STRUCTURE
    namespaces:
      symbol props mdc
      symbol props lpm
    cpp implementation data type element isWakeup: type-reference=int32_t
package /HuaweiMDC/PlatformServiceInterface/LpmcServiceInterface
  service interface LpmcServiceInterface: is-service=true, major-version=1, minor-version=0
    namespaces:
      symbol props mdc
      symbol props lpm
    events:
      data MdcWakeupEvent: type=MdcWakeupEventData
    methods:
      operation SetLowPowerMode
        arg errorCode: type=int32_t, direction=OUT
      operation SetEnterDeepSleepTime
        arg enterDeepSleepTime: type=uint32_t, direction=IN
        arg errorCode: type=int32_t, direction=OUT
  someip service interface deployment LpmcServiceInterfaceDeployment: service-interface=LpmcServiceInterface, service-interface-id=3266, service-interface-version={major-version=1, minor-version=0}
    someip event deployment MdcWakeupSomeipEventDeployment: event=MdcWakeupEvent, event-id=1103, transport-protocol=UDP
    someip method deployment SetLowPowerModeSomeipDeployment: method=SetLowPowerMode, method-id=1, transport-protocol=UDP
    someip method deployment SetEnterDeepSleepTimeDeployment: method=SetEnterDeepSleepTime, method-id=2, transport-protocol=UDP
    someip event group MdcWakeupSomeipEventGroup: event-group-id=1, event=MdcWakeupSomeipEventDeployment
