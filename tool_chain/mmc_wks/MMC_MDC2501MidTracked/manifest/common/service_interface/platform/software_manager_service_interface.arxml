AUTOSAR XML (schema 00048)
package /HuaweiMDC/PlatformServiceInterface/SoftwareManagerMsgDataTypes/DataTypes
  16 x std cpp implementation data type:
    ActionType: compu {0=kUpdate, 1=kInstall, 2=kRemove}, type-reference=UInt8
      namespaces:
        symbol props mdc
        symbol props swm
    ComponentHistoryRecordType: category=STRUCTURE
      namespaces:
        symbol props mdc
        symbol props swm
      10 x cpp implementation data type element:
        startTime: type-reference=UInt64
        endTime: type-reference=UInt64
        devName: type-reference=String
        pkgName: type-reference=String
        oldVersion: type-reference=String
        newVersion: type-reference=String
        actionType: type-reference=UInt8
        errorCode: type-reference=Int32
        status: type-reference=Int32
        message: type-reference=String
    ComponentHistoryRecordVector: category=VECTOR, cpp-template-argument=ComponentHistoryRecordType
      namespaces:
        symbol props mdc
        symbol props swm
    FinggerPrintType: category=VECTOR, cpp-template-argument=UInt8
      namespaces:
        symbol props mdc
        symbol props swm
    GetHistoryType: category=STRUCTURE
      namespaces:
        symbol props mdc
        symbol props swm
      5 x cpp implementation data type element:
        Time: type-reference=UInt64
        Name: type-reference=SwNameType
        Version: type-reference=StrongRevisionLabelString
        Action: type-reference=ActionType
        Resolution: type-reference=ResultType
    GetHistoryVectorType: category=VECTOR, cpp-template-argument=GetHistoryType
      namespaces:
        symbol props mdc
        symbol props swm
    ResultType: compu {0=kSuccessfull, 1=kFailed}, type-reference=UInt8
      namespaces:
        symbol props mdc
        symbol props swm
    SoftwarePackageHistoryRecordType: category=STRUCTURE
      namespaces:
        symbol props mdc
        symbol props swm
      8 x cpp implementation data type element:
        id: type-reference=Int32
        startTime: type-reference=UInt64
        endTime: type-reference=UInt64
        softwarePackageName: type-reference=String
        version: type-reference=String
        errorCode: type-reference=Int32
        componentRecord: type-reference=ComponentHistoryRecordVector
        message: type-reference=String
    SoftwarePackageHistoryRecordVector: category=VECTOR, cpp-template-argument=SoftwarePackageHistoryRecordType
      namespaces:
        symbol props mdc
        symbol props swm
    SysVersion: category=STRUCTURE
      namespaces:
        symbol props mdc
        symbol props swm
      cpp implementation data type element sysVersion: type-reference=String
      cpp implementation data type element state: type-reference=Int8
      cpp implementation data type element itemVersions: type-reference=VersionItemVector
    VersionInfo: category=STRUCTURE
      namespaces:
        symbol props mdc
        symbol props swm
      cpp implementation data type element partition: type-reference=UInt8
      cpp implementation data type element isRunning: type-reference=UInt8
      cpp implementation data type element version: type-reference=String
    VersionInfoVector: category=VECTOR, cpp-template-argument=VersionInfo
      namespaces:
        symbol props mdc
        symbol props swm
    VersionItem: category=STRUCTURE
      namespaces:
        symbol props mdc
        symbol props swm
      6 x cpp implementation data type element:
        name: type-reference=String
        location: type-reference=String
        state: type-reference=Int8
        type: type-reference=Int8
        versions: type-reference=VersionInfoVector
        deviceStatus: type-reference=UInt8
    VersionItemVector: category=VECTOR, cpp-template-argument=VersionItem
      namespaces:
        symbol props mdc
        symbol props swm
    LogVector: category=VECTOR, cpp-template-argument=String
      namespaces:
        symbol props mdc
        symbol props swm
    WhiteList: category=VECTOR, cpp-template-argument=String
      namespaces:
        symbol props mdc
        symbol props swm
package /HuaweiMDC/PlatformServiceInterface/SoftwareManagerServiceInterface
  service interface SoftwareManagerServiceInterface: is-service=true
    namespaces:
      symbol props mdc
      symbol props swm
    methods:
      12 x operation:
        GetFinggerPrint: fire-and-forget=false
          arg fingerPrint: type=FinggerPrintType, direction=OUT
          arg ret: type=Int32, direction=OUT
        GetHistory: fire-and-forget=false
          arg timestampGE: type=UInt64, direction=IN
          arg timestampLT: type=UInt64, direction=IN
          arg history: type=GetHistoryVectorType, direction=OUT
        GetHistoryInfo: fire-and-forget=false
          arg record: type=SoftwarePackageHistoryRecordVector, direction=OUT
          arg ret: type=Int32, direction=OUT
        GetSwClusterInfo: fire-and-forget=false
          arg SwInfo: type=SwClusterInfoVectorType, direction=OUT
        GetVersionInfo
          arg SysVersion: type=SysVersion, direction=OUT
          arg ret: type=Response, direction=OUT
        SetFinggerPrint: fire-and-forget=false
          arg fingerPrint: type=FinggerPrintType, direction=IN
          arg ret: type=Int32, direction=OUT
        GetSpecificVersionInfo
          4 x arg:
            versionItem: type=VersionItem, direction=OUT
            ret: type=Response, direction=OUT
            location: type=String, direction=IN
            name: type=String, direction=IN
        RefreshVersion
          arg ret: type=Int32, direction=OUT
          arg isSync: type=Boolean, direction=IN
        GetUpdateLogList
          arg ret: type=Int32, direction=OUT
          arg logList: type=LogVector, direction=OUT
          arg message: type=String, direction=OUT
        CleanWorkDir
          arg ret: type=Int32, direction=OUT
          arg path: type=String, direction=IN
          arg whiteList: type=WhiteList, direction=IN
        DoArchive
          arg ret: type=Response, direction=OUT
          arg pkgSource: type=String, direction=IN
          arg updateResult: type=Boolean, direction=IN
        SetHeartBeatValue
          arg duration: type=Int32, direction=IN
          arg type: type=String, direction=IN
          arg ret: type=Response, direction=OUT
  someip service interface deployment SoftwareManagerSomeipServiceInterfaceDeployment: service-interface=SoftwareManagerServiceInterface, service-interface-id=3072, service-interface-version={major-version=1, minor-version=0}
    12 x someip method deployment, all with transport-protocol=UDP:
      GetFinggerPrintSomeIpMethodDeploy: method=GetFinggerPrint, method-id=4
      GetHistoryInfoSomeIpMethodDeploy: method=GetHistoryInfo, method-id=5
      GetHistorySomeIpMethodDeploy: method=GetHistory, method-id=3
      GetSwClusterInfoSomeIpMethodDeploy: method=GetSwClusterInfo, method-id=2
      GetVersionInfoSomeIpMethodDeploy: method=GetVersionInfo, method-id=1
      SetFinggerPrintSomeIpMethodDeploy: method=SetFinggerPrint, method-id=6
      GetSpecificVersionInfoSomeIpMethodDeploy: method=GetSpecificVersionInfo, method-id=7
      RefreshVersionSomeIpMethodDeploy: method=RefreshVersion, method-id=8
      GetUpdateLogListSomeIpMethodDeploy: method=GetUpdateLogList, method-id=9
      CleanWorkDirSomeIpMethodDeploy: method=CleanWorkDir, method-id=10
      DoArchiveSomeIpMethodDeploy: method=DoArchive, method-id=11
      SetHeartBeatValueSomeIpMethodDeploy: method=SetHeartBeatValue, method-id=12
