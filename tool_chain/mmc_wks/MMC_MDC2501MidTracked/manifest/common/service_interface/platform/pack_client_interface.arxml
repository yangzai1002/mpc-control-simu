AUTOSAR XML (schema 00048)
package /HuaweiMDC/PlatformServiceInterface/PackClientType
  std cpp implementation data type PackParamType: category=STRUCTURE
    namespaces:
      symbol props mdc
      symbol props dcap
    5 x cpp implementation data type element, all with is-optional=false:
      startTimestamp: type-reference=String
      endTimestamp: type-reference=String
      fileType: type-reference=ObjectMap
      packageSize: type-reference=UInt32
      path: type-reference=String
  std cpp implementation data type ObjectMap: category=ASSOCIATIVE_MAP, template-arguments=[String, StringVector]
    namespaces:
      symbol props mdc
      symbol props dcap
  std cpp implementation data type PackageDigestType: category=STRUCTURE
    namespaces:
      symbol props mdc
      symbol props dcap
    cpp implementation data type element digestStr: is-optional=false, type-reference=String
    cpp implementation data type element retCode: is-optional=false, type-reference=Int32
package /HuaweiMDC/PlatformServiceInterface/PlatformServices
  service interface PackClientServiceInterface: is-service=true
    namespaces:
      symbol props mdc
      symbol props dcap
    methods:
      4 x operation:
        StartPack
          arg packParam: type=PackParamType, direction=IN
          arg responseData: type=Int32, direction=OUT
        QueryPackStatus
          arg responseData: type=Int32, direction=OUT
        StopPack
          arg responseData: type=Int32, direction=OUT
        QueryPackageDigest
          arg responseData: type=PackageDigestType, direction=OUT
  dds service interface deployment PackClientServiceInterfaceDeployment: service-interface=PackClientServiceInterface, service-interface-id=3777
    4 x dds method deployment, all with transport-protocols=UDP:
      StartPackDeployment: method=StartPack, dds-rpc-service=RpcOfStartPackDeployment
      StopPackDeployment: method=StopPack, dds-rpc-service=RpcOfStopPackDeployment
      QueryPackStatusDeployment: method=QueryPackStatus, dds-rpc-service=RpcOfQueryPackStatusDeployment
      QueryPackageDigestDeployment: method=QueryPackageDigest, dds-rpc-service=RpcOfQueryPackageDigestDeployment
    4 x dds rpc service deployment, all with frag-size=2048, list-size=256:
      RpcOfStartPackDeployment: reply-topic-name=ReplyOfRpcOfStartPackDeployment, request-topic-name=RequestOfRpcOfStartPackDeployment
      RpcOfStopPackDeployment: reply-topic-name=ReplyOfRpcOfStopPackDeployment, request-topic-name=RequestOfRpcOfStopPackDeployment
      RpcOfQueryPackStatusDeployment: reply-topic-name=ReplyOfRpcOfQueryPackStatusDeployment, request-topic-name=RequestOfRpcOfQueryPackStatusDeployment
      RpcOfQueryPackageDigestDeployment: reply-topic-name=ReplyOfRpcOfQueryPackageDigestDeployment, request-topic-name=RequestOfRpcOfQueryPackageDigestDeployment
