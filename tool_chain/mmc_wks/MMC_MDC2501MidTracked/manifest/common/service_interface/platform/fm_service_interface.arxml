AUTOSAR XML (schema 00048)
package /HuaweiMDC/MdcPlatformServices/PlatformServiceInterface/DataTypes
  11 x std cpp implementation data type:
    FmFaultData: category=STRUCTURE
      namespaces:
        symbol props mdc
        symbol props fm
      11 x cpp implementation data type element:
        faultId: type-reference=UInt16
        faultObj: type-reference=UInt16
        phyCpuNo: type-reference=UInt8
        cpuCoreNo: type-reference=UInt8
        componentId: type-reference=UInt32
        type: type-reference=UInt8
        flag: type-reference=UInt32
        paraNum: type-reference=UInt8
        para: type-reference=FmParaArray
        clss: type-reference=UInt8
        time: type-reference=FmCharVec
    FmFaultDetail: category=STRUCTURE
      namespaces:
        symbol props mdc
        symbol props fm
      4 x cpp implementation data type element:
        faultData: type-reference=FmFaultData
        actionName: type-reference=String
        timePointFirst: type-reference=UInt64
        timePointLast: type-reference=UInt64
    FmFaultDetailVector: category=VECTOR, cpp-template-argument=FmFaultDetail
      namespaces:
        symbol props mdc
        symbol props fm
    FmParaArray: category=ARRAY, array-size=4, cpp-template-argument=Int64
      namespaces:
        symbol props mdc
        symbol props fm
    FmFaultFull: category=STRUCTURE
      namespaces:
        symbol props mdc
        symbol props fm
      17 x cpp implementation data type element:
        faultId: type-reference=UInt16
        faultObj: type-reference=UInt16
        phyCpuNo: type-reference=UInt8
        cpuCoreNo: type-reference=UInt8
        type: type-reference=UInt8
        clss: type-reference=UInt8
        level: type-reference=UInt8
        flag: type-reference=UInt32
        componentId: type-reference=UInt32
        count: type-reference=UInt32
        timeFirst: type-reference=String
        timeLast: type-reference=String
        para: type-reference=String
        desc: type-reference=String
        actionName: type-reference=String
        actionResult: type-reference=Int32
        subFaultVec: type-reference=FmStringVec
    FmStringVec: category=VECTOR, cpp-template-argument=String
      namespaces:
        symbol props mdc
        symbol props fm
    FmFaultFullVec: category=VECTOR, cpp-template-argument=FmFaultFull
      namespaces:
        symbol props mdc
        symbol props fm
    FmCharVec: category=VECTOR, cpp-template-argument=Int8
      namespaces:
        symbol props mdc
        symbol props fm
    FmFaultStatData: category=STRUCTURE
      namespaces:
        symbol props mdc
        symbol props fm
      7 x cpp implementation data type element:
        faultCnt: type-reference=UInt32
        faultClearCnt: type-reference=UInt32
        minTimeInvl: type-reference=UInt64
        maxTimeInvl: type-reference=UInt64
        avgTimeInvl: type-reference=Double
        alarmCnt: type-reference=UInt32
        alarmClearCnt: type-reference=UInt32
    FmMcuDataHeader: category=STRUCTURE
      namespaces:
        symbol props mdc
        symbol props fm
      5 x cpp implementation data type element:
        type: type-reference=uint8_t
        version: type-reference=uint8_t
        checkSum: type-reference=uint32_t
        seqId: type-reference=uint32_t
        sendTime: type-reference=uint64_t
    FmMcuDataRetInfo: category=STRUCTURE
      namespaces:
        symbol props mdc
        symbol props fm
      cpp implementation data type element type: type-reference=uint8_t
      cpp implementation data type element seqId: type-reference=uint32_t
      cpp implementation data type element retCode: type-reference=uint32_t
package /HuaweiMDC/MdcPlatformServices/PlatformServiceInterface/FmServiceInterface
  service interface FmQueryService: is-service=true
    namespaces:
      symbol props mdc
      symbol props fm
    methods:
      4 x operation:
        QueryFaultDetail
          arg faultDetailVec: type=FmFaultDetailVector, direction=OUT
        QueryFaultOnFlag
          arg fmFltFullVec: type=FmFaultFullVec, direction=OUT
          arg flag: type=UInt32, direction=IN
        QueryFaultStatistic
          arg fmFltStatic: type=FmFaultStatData, direction=OUT
          arg flag: type=UInt32, direction=IN
        QuerySystemFaultStatus
          arg result: type=Int32, direction=OUT
          arg qryFlag: type=UInt32, direction=IN
  someip service interface deployment FmQueryServiceDeployment: service-interface=FmQueryService, service-interface-id=1088, service-interface-version={major-version=1, minor-version=0}
    4 x someip method deployment, all with transport-protocol=TCP:
      QueryFaultDetail_Someip: method=QueryFaultDetail, method-id=3
      QueryFaulOnFlag_Someip: method=QueryFaultOnFlag, method-id=4
      QueryFaultStatistic_Someip: method=QueryFaultStatistic, method-id=5
      QuerySystemFaultStatus_Someip: method=QuerySystemFaultStatus, method-id=6
  service interface FmReportEventService: is-service=true
    namespaces:
      symbol props mdc
      symbol props fm
    methods:
      operation ReportFault: fire-and-forget=false
        arg faultData: type=FmFaultData, direction=IN
        arg result: type=Int32, direction=OUT
      operation ReportCheckPoint: fire-and-forget=false
        arg procName: type=String, direction=IN
        arg result: type=int32_t, direction=OUT
      operation ReportProcState: fire-and-forget=false
        4 x arg:
          procName: type=String, direction=IN
          state: type=uint8_t, direction=IN
          reportPeriod: type=uint32_t, direction=OUT
          result: type=int32_t, direction=OUT
  someip service interface deployment FmReportEventServiceInterfaceDeployment: service-interface=FmReportEventService, service-interface-id=1089, service-interface-version={major-version=1, minor-version=0}
    someip method deployment ReportFault_Someip: method=ReportFault, method-id=3, transport-protocol=UDP
    someip method deployment ReportCheckPoint_Someip: method=ReportCheckPoint, method-id=4, transport-protocol=UDP
    someip method deployment ReportProcState_Someip: method=ReportProcState, method-id=5, transport-protocol=UDP
  dds service interface deployment FmQueryServiceDdsDeployment: service-interface=FmQueryService, service-interface-id=1088
    4 x dds method deployment:
      QueryFaultDetail_Dds: method=QueryFaultDetail, dds-rpc-service=QueryFaultDetial_DdsRpc
      QueryFaultOnFlag_Dds: method=QueryFaultOnFlag, dds-rpc-service=QueryFaultOnFlag_DdsRpc
      QueryFaultStatistic_Dds: method=QueryFaultStatistic, dds-rpc-service=QueryFaultStatistic_DdsRpc
      QuerySystemFaultStatus_Dds: method=QuerySystemFaultStatus, dds-rpc-service=QuerySystemFaultStatus_DdsRpc
    4 x dds rpc service deployment:
      QueryFaultDetial_DdsRpc: reply-topic-name=ReplyQueryFaultDetailDdsRpc, request-topic-name=RequestQueryFaultDetailDdsRpc
      QueryFaultOnFlag_DdsRpc: reply-topic-name=ReplyQueryFaultOnFlagDdsRpc, request-topic-name=RequestQueryFaultOnFlagDdsRpc
      QueryFaultStatistic_DdsRpc: reply-topic-name=ReplyQueryFaultStatisticDdsRpc, request-topic-name=RequestQueryFaultStatisticDdsRpc
      QuerySystemFaultStatus_DdsRpc: reply-topic-name=ReplyQuerySystemFaultStatusDdsRpc, request-topic-name=RequestQuerySystemFaultStatusDdsRpc
  dds service interface deployment FmReportEventServiceDdsDeployment: service-interface=FmReportEventService, service-interface-id=1089
    dds method deployment ReportFault_Dds: method=ReportFault, dds-rpc-service=ReportFault_DdsRpc
    dds method deployment ReportCheckPoint_Dds: method=ReportCheckPoint, dds-rpc-service=ReportCheckPoint_DdsRpc
    dds method deployment ReportProcState_Dds: method=ReportProcState, dds-rpc-service=ReportProcState_DdsRpc
    dds rpc service deployment ReportFault_DdsRpc: reply-topic-name=ReplyReportFaultDdsRpc, request-topic-name=RequestReportFaultDdsRpc
    dds rpc service deployment ReportCheckPoint_DdsRpc: reply-topic-name=ReplyReportCheckPointDdsRpc, request-topic-name=RequestReportCheckPointDdsRpc
    dds rpc service deployment ReportProcState_DdsRpc: reply-topic-name=ReplyReportProcStateDdsRpc, request-topic-name=RequestReportProcStateDdsRpc
  service interface FmTransMcuDataService: is-service=true
    namespaces:
      symbol props mdc
      symbol props fm
    methods:
      operation ReportMcuData: fire-and-forget=false
        arg header: type=FmMcuDataHeader, direction=IN
        arg dataBuf: type=Uint8Vector, direction=IN
        arg result: type=FmMcuDataRetInfo, direction=OUT
  someip service interface deployment FmTransMcuDataServiceInterfaceDeployment: service-interface=FmTransMcuDataService, service-interface-id=1090, service-interface-version={major-version=1, minor-version=0}
    someip method deployment ReportMcuData_Someip: method=ReportMcuData, method-id=1, transport-protocol=UDP
