AUTOSAR XML (schema 00048)
package /HuaweiMDC/DiagDataType
  std cpp implementation data type RequestTriggerType: category=STRUCTURE
    namespaces:
      symbol props ara
      symbol props diag
    cpp implementation data type element instanceSpecifier: is-optional=false, type-reference=String
    cpp implementation data type element serailNumber: type-reference=UInt64
    cpp implementation data type element eventType: is-optional=false, type-reference=UInt8
package /HuaweiMDC/PlatformServices
  service interface DiagComClient: is-service=true
    namespaces:
      symbol props ara
      symbol props diag
    events:
      data RequestTrigger: type=RequestTriggerType
    methods:
      operation GetRequest
        4 x arg:
          spec: type=String, direction=IN
          serialNumber: type=UInt64, direction=IN
          isResponsePositive: type=Boolean, direction=OUT
          responseData: type=ByteArray, direction=OUT
      operation SendResponse
        4 x arg, all with direction=IN:
          spec: type=String
          serialNumber: type=UInt64
          isPositive: type=Boolean
          responseData: type=ByteVector
  dds service interface deployment DiagComClientDeployment: service-interface=DiagComClient, service-interface-id=101
    dds event deployment RequestTriggerDeployment: event=RequestTrigger, frag-size=2048, list-size=256, topic-name=TopicNameOfRequestTriggerDeployment, transport-protocols=UDP
    dds method deployment GetRequestDeployment: method=GetRequest, dds-rpc-service=RpcOfGetRequestDeployment, transport-protocols=UDP
    dds method deployment SendResponseDeployment: method=SendResponse, dds-rpc-service=RpcOfSendResponseDeployment, transport-protocols=UDP
    dds rpc service deployment RpcOfGetRequestDeployment: frag-size=2048, list-size=256, reply-topic-name=ReplyOfRpcOfGetRequestDeployment, request-topic-name=RequestOfRpcOfGetRequestDeployment
    dds rpc service deployment RpcOfSendResponseDeployment: frag-size=2048, list-size=256, reply-topic-name=ReplyOfRpcOfSendResponseDeployment, request-topic-name=RequestOfRpcOfSendResponseDeployment
