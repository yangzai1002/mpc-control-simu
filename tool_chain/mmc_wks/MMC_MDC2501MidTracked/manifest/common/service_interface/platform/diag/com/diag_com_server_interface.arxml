AUTOSAR XML (schema 00048)
package /HuaweiMDC/PlatformServices
  service interface DiagComServer: is-service=true
    namespaces:
      symbol props ara
      symbol props diag
    methods:
      operation Request
        arg requestData: type=ByteVector, direction=IN
        arg isResponsePositive: type=Boolean, direction=OUT
        arg responseData: type=ByteVector, direction=OUT
  dds service interface deployment DiagComServerDeployment: service-interface=DiagComServer, frag-size=2048, list-size=256, service-interface-id=103
    dds method deployment RequestDeployment: method=Request, dds-rpc-service=RpcOfRequestDeployment, transport-protocols=UDP
    dds rpc service deployment RpcOfRequestDeployment: frag-size=2048, list-size=256, reply-topic-name=ReplyTopicNameOfRequestDeployment, request-topic-name=RequestTopicNameOfRequestDeployment
