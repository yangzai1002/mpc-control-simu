AUTOSAR XML (schema 00048)
package /HuaweiMDC/PlatformServiceInterface/DisplayMsgDataType
  std cpp implementation data type DisplayImageMbufStruct: category=STRUCTURE
    namespaces:
      symbol props ara
      symbol props Display
    10 x cpp implementation data type element:
      Height: type-reference=uint32_t
      Width: type-reference=uint32_t
      SendTimeStamp: type-reference=uint64_t
      DataSize: type-reference=uint32_t
      RawData: type-reference=rawBuffer
      Seq: type-reference=uint32_t
      ChannelId: type-reference=uint8_t
      InputFormat: type-reference=ImageFormatTypeE
      OutputFormat: type-reference=ImageFormatTypeE
      RotateMode: type-reference=RotateModeE
  std cpp implementation data type ImageFormatTypeE: compu {0=IMAGE_FORMAT_RGB888, 1=IMAGE_FORMAT_YUV420_NV12, 2=IMAGE_FORMAT_YUV420_NV21}, type-reference=uint8_t
    namespaces:
      symbol props ara
      symbol props Display
  std cpp implementation data type RotateModeE: compu {0=DO_NOT_ROTATE, 1=ROTATE_MODE_90_CLOCKWISE, 2=ROTATE_MODE_180_CLOCKWISE, 3=ROTATE_MODE_270_CLOCKWISE}, type-reference=uint8_t
    namespaces:
      symbol props ara
      symbol props Display
package /HuaweiMDC/PlatformServiceInterface/DisplayServiceInterfacePkg
  dds service interface deployment DisplayImageMbufDdsServiceInterfaceDeployment: service-interface=DisplayImageMbufServiceInterface, service-interface-id=5248
    dds event deployment DisplayImageMbufDdsEventDeployment: event=DisplayImageMbufEvent, frag-size=1000000, list-size=15, topic-name=DisplayImageDdsEvent, transport-protocols=UDP
  service interface DisplayImageMbufServiceInterface: is-service=true
    namespaces:
      symbol props mdc
      symbol props disp
      symbol props Display
    events:
      data DisplayImageMbufEvent: type=DisplayImageMbufStruct
