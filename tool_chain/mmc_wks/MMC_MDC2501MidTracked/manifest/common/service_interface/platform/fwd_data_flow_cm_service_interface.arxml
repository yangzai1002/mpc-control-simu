AUTOSAR XML (schema 00048)
package /HuaweiMDC/PlatformServiceInterface/DataFlowMsgDataType
  std cpp implementation data type DataFlowDataType: category=STRUCTURE
    namespaces:
      symbol props ara
      symbol props dataflow
    7 x cpp implementation data type element:
      header: type-reference=Header
      channel_type: type-reference=UInt8
      channel_id: type-reference=String
      recv_flow_stats_pps: type-reference=UInt32
      recv_flow_stats_bps: type-reference=UInt32
      send_flow_stats_pps: type-reference=UInt32
      send_flow_stats_bps: type-reference=UInt32
  std cpp implementation data type Header: category=STRUCTURE
    namespaces:
      symbol props ara
      symbol props dataflow
    cpp implementation data type element seq: type-reference=UInt32
    cpp implementation data type element stamp: type-reference=Time
    cpp implementation data type element frameId: type-reference=String
  std cpp implementation data type Time: category=STRUCTURE
    namespaces:
      symbol props ara
      symbol props dataflow
    cpp implementation data type element sec: type-reference=UInt32
    cpp implementation data type element nsec: type-reference=UInt32
package /HuaweiMDC/PlatformServiceInterface/DataFlowServiceInterface
  dds service interface deployment DataFlowDeployment: service-interface=DataFlowServiceInterface, service-interface-id=3586
    dds event deployment DataFlowDdsEventDeployment: event=mdcEvent, topic-name=DataFlowDdsEvent, transport-protocols=UDP
  service interface DataFlowServiceInterface: is-service=true
    namespaces:
      symbol props ara
      symbol props dataflow
    events:
      data mdcEvent: type=DataFlowDataType
