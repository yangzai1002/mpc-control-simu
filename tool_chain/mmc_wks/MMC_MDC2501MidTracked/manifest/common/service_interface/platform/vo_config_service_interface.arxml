AUTOSAR XML (schema 00048)
package /HuaweiMDC/PlatformServiceInterface/VoConfigDataType
  8 x std cpp implementation data type:
    ChnInfo: category=STRUCTURE
      namespaces:
        symbol props mdc
        symbol props vo
      5 x cpp implementation data type element:
        chnId: type-reference=uint8_t
        slotId: type-reference=SlotId
        isEnabled: type-reference=bool
        function: type-reference=String
        videoParam: type-reference=VideoParam
    VideoParam: category=STRUCTURE
      namespaces:
        symbol props mdc
        symbol props vo
      cpp implementation data type element imageFormat: type-reference=ImageFormatTypeE
      cpp implementation data type element frameRate: type-reference=uint32_t
      cpp implementation data type element resolution: type-reference=Resolution
    Resolution: category=STRUCTURE
      namespaces:
        symbol props mdc
        symbol props vo
      cpp implementation data type element width: type-reference=uint32_t
      cpp implementation data type element height: type-reference=uint32_t
    ChnAttr: category=STRUCTURE
      namespaces:
        symbol props mdc
        symbol props vo
      cpp implementation data type element isEnabled: type-reference=bool
    SlotId: compu {0=D4, 1=D3}, type-reference=uint8_t
      namespaces:
        symbol props mdc
        symbol props vo
    ChnInfoList: category=VECTOR, cpp-template-argument=ChnInfo
      namespaces:
        symbol props mdc
        symbol props vo
    VoEnum: compu {0=EXTERNAL, 1=INTERNAL, 2=VO3}, type-reference=uint8_t
      namespaces:
        symbol props mdc
        symbol props vo
    DisplayAttrEnum: compu {0=SETTING_1632_640_30HZ, 1=SETTING_1856_880_30HZ}, type-reference=uint8_t
      namespaces:
        symbol props mdc
        symbol props vo
package /HuaweiMDC/PlatformServiceInterface/VoConfigServiceInterface
  someip service interface deployment VoConfigSomeipServiceInterfaceDeployment: service-interface=VoConfigServiceInterface, service-interface-id=5249, service-interface-version={major-version=1, minor-version=0}
    6 x someip method deployment, all with transport-protocol=UDP:
      GetVoConfigDeployment: method=GetVoConfig, method-id=1
      GetVoChnAttrDeployemnt: method=GetVoChnAttr, method-id=2
      SetVoChnAttrDeployment: method=SetVoChnAttr, method-id=3
      SetVoSourceDeployment: method=SetVoSource, method-id=4
      GetVoSourceDeployment: method=GetVoSource, method-id=5
      SetChnDisplayAttrDeployment: method=SetChnDisplayAttr, method-id=6
  service interface VoConfigServiceInterface: is-service=true
    namespaces:
      symbol props mdc
      symbol props vo
    methods:
      6 x operation:
        GetVoConfig
          arg chnInfoList: type=ChnInfoList, direction=OUT
        GetVoChnAttr
          arg chnId: type=uint8_t, direction=IN
          arg chnAttr: type=ChnAttr, direction=OUT
        SetVoChnAttr
          arg chnId: type=uint8_t, direction=IN
          arg chnAttr: type=ChnAttr, direction=IN
          arg ret: type=int32_t, direction=OUT
        SetVoSource
          arg chnId: type=uint8_t, direction=IN
          arg ret: type=int32_t, direction=OUT
          arg videoSource: type=VoEnum, direction=IN
        GetVoSource
          arg chnId: type=uint8_t, direction=IN
          arg videoSource: type=VoEnum, direction=OUT
          arg ret: type=int32_t, direction=OUT
        SetChnDisplayAttr
          arg chnId: type=uint8_t, direction=IN
          arg ret: type=int32_t, direction=OUT
          arg setting: type=DisplayAttrEnum, direction=IN
