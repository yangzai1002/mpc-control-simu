AUTOSAR XML (schema 00048)
package /HuaweiMDC/MdcPlatformServices/PlatformServiceInterface/FmAlarmReceiveServiceInterface
  someip service interface deployment FmAlarmReceiveServiceDeployment: service-interface=FmAlarmReceiveService, service-interface-id=1100, service-interface-version={major-version=1, minor-version=0}
    someip method deployment ReportAlarm_Someip: method=ReportAlarm, method-id=1, transport-protocol=TCP
  service interface FmAlarmReceiveService: is-service=true
    namespaces:
      symbol props mdc
      symbol props fm
    methods:
      operation ReportAlarm
        arg alarmMsg: type=AlarmInfo, direction=IN
        arg result: type=Int32, direction=OUT
  someip service interface deployment FmReportAlmProcPolicyServiceDeployment: service-interface=FmReportAlmProcPolicyService, service-interface-id=1101, service-interface-version={major-version=1, minor-version=0}
    someip method deployment ReportAlmProcPolicy_Someip: method=ReportAlmProcPolicy, method-id=1, transport-protocol=TCP
    someip method deployment DisableOneAlarm_Someip: method=DisableOneAlarm, method-id=2, transport-protocol=TCP
  service interface FmReportAlmProcPolicyService: is-service=true
    namespaces:
      symbol props mdc
      symbol props fm
    methods:
      operation ReportAlmProcPolicy
        arg retryTimes: type=UInt8, direction=IN
        arg procPolicy: type=UInt8, direction=IN
        arg result: type=Int32, direction=OUT
      operation DisableOneAlarm
        4 x arg:
          alarmId: type=UInt16, direction=IN
          alarmObj: type=UInt16, direction=IN
          disable: type=UInt16, direction=IN
          result: type=Int32, direction=OUT
package /HuaweiMDC/MdcPlatformServices/PlatformServiceInterface/DataTypes
  std cpp implementation data type AlarmInfo: category=STRUCTURE
    namespaces:
      symbol props mdc
      symbol props fm
    7 x cpp implementation data type element:
      alarmId: type-reference=UInt16
      alarmObj: type-reference=UInt16
      clss: type-reference=UInt8
      level: type-reference=UInt8
      status: type-reference=UInt8
      time: type-reference=UInt64
      desc: type-reference=String
