AUTOSAR XML (schema 00048)
package /HuaweiMDC/PlatformServiceInterface/DevmCenterMsgDataType/CompuMethods
  compu method CM_ConfigMode: 0=kNormal, 1=kConfig, 3=kUnknown
  compu method CM_ConfigResultType: 0=kOk, 1=kError, 2=kUnsupport, 3=kUnkonw
  compu method CM_DeploymentMode: 0=kUnkonw, 1=kSingle, 2=kDual, 3=kCluster
  compu method CM_DeviceStatusType: 0=kOk, 1=kError, 2=kUnkonw
  compu method CM_SystemMode: 0=kUnkonw, 1=kPrimary, 2=kSlave
  compu method CM_WorkStatusType: 0=kOk, 1=kError, 2=kUnkonw
package /HuaweiMDC/PlatformServiceInterface/DevmCenterMsgDataType/DataTypes
  9 x std cpp implementation data type:
    BufArray12: category=ARRAY, array-size=12, cpp-template-argument=UInt8
      namespaces:
        symbol props mdc
        symbol props devm
    StringList: category=VECTOR, cpp-template-argument=String
    UInt32List: category=VECTOR, cpp-template-argument=UInt32
      namespaces:
        symbol props mdc
        symbol props devm
    Uint8List: category=VECTOR, cpp-template-argument=UInt8
      namespaces:
        symbol props mdc
        symbol props devm
    CanCtrlConfig: category=STRUCTURE
      namespaces:
        symbol props mdc
        symbol props devm
      cpp implementation data type element channelId: type-reference=UInt8
      cpp implementation data type element upStream: type-reference=CanCheckList
      cpp implementation data type element downStream: type-reference=CanCheckList
    CanCheckList: category=STRUCTURE
      namespaces:
        symbol props mdc
        symbol props devm
      cpp implementation data type element idNumber: type-reference=UInt8
      cpp implementation data type element controlMethod: type-reference=UInt8
      cpp implementation data type element canIdInfos: type-reference=CanIdInfoList
    CanIdInfoList: category=ARRAY, array-size=60, cpp-template-argument=CanIdInfo
      namespaces:
        symbol props mdc
        symbol props devm
    CanIdInfo: category=STRUCTURE
      namespaces:
        symbol props mdc
        symbol props devm
      cpp implementation data type element canIdRange: type-reference=UInt32Array2
      cpp implementation data type element canIdType: type-reference=UInt32
      cpp implementation data type element canIdRangeType: type-reference=UInt32
    UInt32Array2: category=ARRAY, array-size=2, cpp-template-argument=UInt32
      namespaces:
        symbol props mdc
        symbol props devm
package /HuaweiMDC/PlatformServiceInterface/DevmCenterServiceInterface
  service interface DevmCenterServiceInterface: is-service=true
    namespaces:
      symbol props mdc
      symbol props devm
      symbol props devmc
    methods:
      6 x operation:
        MsgPipeQuery
          arg in: type=Uint8List, direction=IN
          arg out: type=Uint8List, direction=OUT
        MsgPipeCtrl
          arg in: type=Uint8List, direction=IN
          arg out: type=Uint8List, direction=OUT
        MsgPipeUpdate
          arg in: type=Uint8List, direction=IN
          arg out: type=Uint8List, direction=OUT
        MsgPipe1
          arg in: type=Uint8List, direction=IN
          arg out: type=Uint8List, direction=OUT
        MsgPipe2
          arg in: type=Uint8List, direction=IN
          arg out: type=Uint8List, direction=OUT
        MsgPipe3
          arg in: type=Uint8List, direction=IN
          arg out: type=Uint8List, direction=OUT
  someip service interface deployment DevmCenterSomeipServiceInterfaceDeployment: service-interface=DevmCenterServiceInterface, service-interface-id=3456, service-interface-version={major-version=1, minor-version=0}
    6 x someip method deployment, all with transport-protocol=UDP:
      MsgPipeQuery_Method: method=MsgPipeQuery, method-id=501
      MsgPipeCtrl_Method: method=MsgPipeCtrl, method-id=502
      MsgPipeUpdate_Method: method=MsgPipeUpdate, method-id=503
      MsgPipe1_Method: method=MsgPipe1, method-id=504
      MsgPipe2_Method: method=MsgPipe2, method-id=505
      MsgPipe3_Method: method=MsgPipe3, method-id=506
