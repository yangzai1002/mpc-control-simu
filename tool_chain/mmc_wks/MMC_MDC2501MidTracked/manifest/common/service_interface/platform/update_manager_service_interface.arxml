AUTOSAR XML (schema 00048)
package /HuaweiMDC/PlatformServiceInterface/UpdateManagerMsgDataTypes/CompuMethods
  compu method CM_ProcessResultType: 0=kSuccess, 1=kReady, 2=kBusy, 3=kActivating, 4=kActivated, 5=kRollingBack, 6=kRolledBack, 7=kCleaning_Up, 8=kVerifying
package /HuaweiMDC/PlatformServiceInterface/UpdateManagerMsgDataTypes/DataTypes
  20 x std cpp implementation data type:
    CheckItemResult: category=STRUCTURE
      namespaces:
        symbol props mdc
        symbol props swm
      cpp implementation data type element name: type-reference=String
      cpp implementation data type element result: type-reference=Int32
      cpp implementation data type element message: type-reference=String
    CheckItemResultVector: category=VECTOR, cpp-template-argument=CheckItemResult
      namespaces:
        symbol props mdc
        symbol props swm
    ExpectedVersionCheckResult: category=STRUCTURE
      namespaces:
        symbol props mdc
        symbol props swm
      4 x cpp implementation data type element:
        state: type-reference=UInt8
        checkStatus: type-reference=UInt8
        expectedVersion: type-reference=SysVersion
        currVersion: type-reference=SysVersion
    ItemStateVector: category=VECTOR, cpp-template-argument=itemState
      namespaces:
        symbol props mdc
        symbol props swm
    PackageManagerStatusType: compu {0=kIdle, 1=kReady, 2=kBusy, 3=kActivating, 4=kActivated, 5=kRollingBack, 6=kRolledBack, 7=kCleaning_Up, 8=kVerifying}, type-reference=UInt8
      namespaces:
        symbol props mdc
        symbol props swm
    PreCheckResult: category=STRUCTURE
      namespaces:
        symbol props mdc
        symbol props swm
      cpp implementation data type element result: type-reference=UInt8
      cpp implementation data type element results: category=VECTOR, type-reference=CheckItemResultVector
    ProcessResultType: category=STRUCTURE
      namespaces:
        symbol props mdc
        symbol props swm
      cpp implementation data type element result: type-reference=ProcessSwPackageReturnType
      cpp implementation data type element transferId: type-reference=TransferIdType
    ProcessSwPackageReturnType: category=STRUCTURE
      namespaces:
        symbol props mdc
        symbol props swm
      cpp implementation data type element result: type-reference=String
      cpp implementation data type element transferId: type-reference=TransferIdType
    Response: category=STRUCTURE
      namespaces:
        symbol props mdc
        symbol props swm
      cpp implementation data type element code: type-reference=Int32
      cpp implementation data type element message: type-reference=String
    StrongRevisionLabelString: type-reference=String
      namespaces:
        symbol props mdc
        symbol props swm
    SwClusterInfoType: category=STRUCTURE
      namespaces:
        symbol props mdc
        symbol props swm
      cpp implementation data type element name: type-reference=SwNameType
      cpp implementation data type element Version: type-reference=StrongRevisionLabelString
      cpp implementation data type element State: type-reference=SwClusterStateType
    SwClusterInfoVectorType: category=VECTOR, cpp-template-argument=SwClusterInfoType
      namespaces:
        symbol props mdc
        symbol props swm
    SwClusterStateType: compu {0=kPresent, 1=kAdded, 2=kUpdated, 3=kRemoved}, type-reference=UInt8
      namespaces:
        symbol props mdc
        symbol props swm
    SwNameType: type-reference=String
      namespaces:
        symbol props mdc
        symbol props swm
    SwNameVectorType: category=VECTOR, cpp-template-argument=SwNameType
      namespaces:
        symbol props mdc
        symbol props swm
    TransferIdType: category=ARRAY, array-size=16, cpp-template-argument=UInt8
      namespaces:
        symbol props mdc
        symbol props swm
    itemState: category=STRUCTURE
      namespaces:
        symbol props mdc
        symbol props swm
      4 x cpp implementation data type element:
        name: type-reference=String
        process: type-reference=UInt8
        errcode: type-reference=Int32
        message: type-reference=String
    SoftwareVersionItem: category=STRUCTURE
      namespaces:
        symbol props mdc
        symbol props swm
      cpp implementation data type element deviceName: type-reference=String
      cpp implementation data type element swName: type-reference=Int32
      cpp implementation data type element version: type-reference=String
    VerifyCheckResultVectorType: category=VECTOR, cpp-template-argument=VerifyCheckResult
      namespaces:
        symbol props mdc
        symbol props swm
    VerifyCheckResult: category=STRUCTURE
      namespaces:
        symbol props mdc
        symbol props swm
      5 x cpp implementation data type element, all with type-reference=String:
        pkgName
        deviceName
        currentVersion
        expectVersion
        message
package /HuaweiMDC/PlatformServiceInterface/UpdateManagerServiceInterface
  service interface UpdateManagerServiceInterface: is-service=true
    namespaces:
      symbol props mdc
      symbol props swm
    methods:
      14 x operation, all with fire-and-forget=false:
        Activate
          arg preActivate: type=SwNameVectorType, direction=IN
          arg verify: type=SwNameVectorType, direction=IN
          arg ret: type=Response, direction=OUT
        Finish
          arg ret: type=Response, direction=OUT
        GetActivationProgress
          arg process: type=UInt8, direction=OUT
          arg errcode: type=Int32, direction=OUT
          arg message: type=String, direction=OUT
        GetSwProcessProgress
          arg id: type=TransferIdType, direction=IN
          arg progress: type=UInt8, direction=OUT
        GetUpdatePreCheckProgress
          arg process: type=UInt8, direction=OUT
          arg errcode: type=Int32, direction=OUT
          arg message: type=String, direction=OUT
        GetUpdatePreCheckResult
          arg ret: type=PreCheckResult, direction=OUT
        GetUpdateProgress
          4 x arg, all with direction=OUT:
            process: type=UInt8
            errcode: type=Int32
            message: type=String
            subItems: category=VECTOR, type=ItemStateVector
        GetUpdateStatus
          arg Status: type=PackageManagerStatusType, direction=OUT
        ProcessSwPackage
          arg id: type=TransferIdType, direction=IN
          arg ret: type=Int32, direction=OUT
        Update
          arg packagePath: type=String, direction=IN
          arg mode: type=Int8, direction=IN
          arg ret: type=Response, direction=OUT
        UpdatePreCheck
          arg mode: type=UInt8, direction=IN
          arg packagePath: type=String, direction=IN
          arg ret: type=Response, direction=OUT
        GetVerifyList
          arg checkResult: type=VerifyCheckResultVectorType, direction=OUT
          arg needArchive: type=Boolean, direction=OUT
          arg result: type=Int8, direction=OUT
        Rollback
          arg packagePath: type=String, direction=IN
          arg ret: type=Response, direction=OUT
        ActivateByMode
          4 x arg:
            preActivate: type=SwNameVectorType, direction=IN
            verify: type=SwNameVectorType, direction=IN
            mode: type=Int8, direction=IN
            ret: type=Response, direction=OUT
  someip service interface deployment UpdateManagerSomeipServiceInterfaceDeployment: service-interface=UpdateManagerServiceInterface, service-interface-id=3073, service-interface-version={major-version=1, minor-version=0}
    14 x someip method deployment, all with transport-protocol=UDP:
      ActivateSomeIpMethodDeploy: method=Activate, method-id=10
      FinishSomeIpMethodDeploy: method=Finish, method-id=11
      GetActivationProgressSomeIpMethodDeploy: method=GetActivationProgress, method-id=7
      GetSwProcessProgressSomeIpMethodDeploy: method=GetSwProcessProgress, method-id=14
      GetUpdatePreCheckProgressSomeIpMethodDeploy: method=GetUpdatePreCheckProgress, method-id=4
      GetUpdatePreCheckResultSomeIpMethodDeploy: method=GetUpdatePreCheckResult, method-id=5
      GetUpdateProgressSomeIpMethodDeploy: method=GetUpdateProgress, method-id=6
      GetUpdateStatusSomeIpMethodDeploy: method=GetUpdateStatus, method-id=3
      ProcessSwPackageSomeIpMethodDeploy: method=ProcessSwPackage, method-id=17
      UpdatePreCheckSomeIpMethodDeploy: method=UpdatePreCheck, method-id=1
      UpdateSomeIpMethodDeploy: method=Update, method-id=2
      GetVerifyListSomeIpMethodDeploy: method=GetVerifyList, method-id=18
      RollbackSomeIpMethodDeploy: method=Rollback, method-id=8
      ActivateByModeSomeIpMethodDeploy: method=ActivateByMode, method-id=20
