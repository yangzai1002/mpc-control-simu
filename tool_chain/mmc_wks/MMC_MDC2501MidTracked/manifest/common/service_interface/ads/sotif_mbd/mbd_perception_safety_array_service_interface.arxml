AUTOSAR XML (schema 00048)
package /HuaweiMDC/Sotif/PerceptionSafetyArrayMsgDataType
  std cpp implementation data type PerceptionSafety: category=STRUCTURE
    namespaces:
      symbol props sotif
    8 x cpp implementation data type element:
      timeStampFirst: type-reference=CommonTime
      eventId: type-reference=UInt32
      sensorId: type-reference=String
      eventLevel: type-reference=UInt8
      type: type-reference=UInt32
      actionName: type-reference=String
      para: type-reference=FloatArray
      timeStampLast: type-reference=CommonTime
  std cpp implementation data type PerceptionSafetyArray: category=STRUCTURE
    namespaces:
      symbol props sotif
    cpp implementation data type element header: type-reference=CommonHeader
    cpp implementation data type element result: type-reference=PerceptionSafetyVector
  std cpp implementation data type PerceptionSafetyVector: category=VECTOR, cpp-template-argument=PerceptionSafety
    namespaces:
      symbol props sotif
package /HuaweiMDC/Sotif/PerceptionSafetyArrayServiceInterface
  dds service interface deployment PerceptionSafetyArrayDdsInterfaceDeployment: service-interface=PerceptionSafetyArrayIntf, frag-size=409600, list-size=20, service-interface-id=3900
    dds event deployment PerceptionSafetyArrayEventDeployment: event=PerceptionSafetyArray, topic-name=PerceptionSafetyArrayDdsEvent, transport-protocols=UDP
  service interface PerceptionSafetyArrayIntf
    namespaces:
      symbol props sotif
    events:
      data PerceptionSafetyArray: type=PerceptionSafetyArray
