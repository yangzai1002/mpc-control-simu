AUTOSAR XML (schema 00048)
package /HuaweiMDC/FunctionalSoftware/SammFeatureMsgDataType
  6 x std cpp implementation data type:
    CustomFeatureVector: category=VECTOR, cpp-template-argument=Feature
    DefaultFeatureVector: category=VECTOR, cpp-template-argument=Feature
    Feature: category=STRUCTURE
      namespaces:
        symbol props ara
        symbol props samm
      cpp implementation data type element id: type-reference=UInt32
      cpp implementation data type element name: type-reference=String
      cpp implementation data type element description: type-reference=String
    Header: category=STRUCTURE
      namespaces:
        symbol props ara
        symbol props samm
      cpp implementation data type element seq: type-reference=Double
      cpp implementation data type element stamp: type-reference=Time
      cpp implementation data type element frameId: type-reference=String
    SammFeature: category=STRUCTURE
      namespaces:
        symbol props ara
        symbol props samm
      cpp implementation data type element defaultFeatures: type-reference=DefaultFeatureVector
      cpp implementation data type element header: type-reference=Header
      cpp implementation data type element customFeatures: type-reference=CustomFeatureVector
    Time: category=STRUCTURE
      namespaces:
        symbol props ara
        symbol props samm
      cpp implementation data type element sec: type-reference=UInt32
      cpp implementation data type element nsec: type-reference=UInt32
package /HuaweiMDC/FunctionalSoftware/SammFeatureServiceInterface
  dds service interface deployment SammFeatureDdsInterfaceDeployment: service-interface=SammFeatureServiceInterface, frag-size=409600, list-size=20, service-interface-id=6664
    dds event deployment SammFeatureEventDeployment: event=SammFeatureEvent, frag-size=204800, list-size=20, topic-name=SammFeatureDdsEvent, transport-protocols=TCP
  service interface SammFeatureServiceInterface: is-service=true
    namespaces:
      symbol props ara
      symbol props samm
    events:
      data SammFeatureEvent: type=SammFeature
