AUTOSAR XML (schema 00048)
package /HuaweiMDC/FunctionalSoftware/TrafficLightMsgDataType
  5 x std cpp implementation data type:
    TrafficLight: category=STRUCTURE
      namespaces:
        symbol props ara
        symbol props trafficlight
      13 x cpp implementation data type element, all with category=TYPE_REFERENCE:
        confidence: type-reference=Double
        objectID: type-reference=Int32
        color: type-reference=UInt8
        box_image: type-reference=Rect
        lanes_id: type-reference=Int32Array
        position: type-reference=Point
        type: type-reference=UInt8
        distance: type-reference=Double
        flash: type-reference=bool
        time_track: type-reference=Double
        time_flash: type-reference=Double
        time_v2x: type-reference=Double
        time_creation: type-reference=Double
    TrafficLightArray: category=STRUCTURE
      namespaces:
        symbol props ara
        symbol props trafficlight
      4 x cpp implementation data type element, all with category=TYPE_REFERENCE:
        header: type-reference=TrafficLightHeader
        object_list: type-reference=TrafficLightVector
        count: type-reference=int32_t
        is_valid: type-reference=bool
    TrafficLightHeader: category=STRUCTURE
      namespaces:
        symbol props ara
        symbol props trafficlight
      4 x cpp implementation data type element:
        seq: type-reference=UInt32
        stamp: type-reference=Time
        frameId: type-reference=String
        count: type-reference=int32_t
    TrafficLightVector: category=VECTOR, cpp-template-argument=TrafficLight
      namespaces:
        symbol props ara
        symbol props trafficlight
    Time: category=STRUCTURE
      namespaces:
        symbol props ara
        symbol props trafficlight
      cpp implementation data type element sec: type-reference=UInt32
      cpp implementation data type element nsec: type-reference=UInt32
package /HuaweiMDC/FunctionalSoftware/TrafficLightServiceInterface
  dds service interface deployment TrafficLightDdsInterfaceDeployment: service-interface=TrafficLightInterface, frag-size=409600, list-size=20, service-interface-id=3904
    dds event deployment TrafficLightArrayEventDeployment: event=TrafficLightArrayEvent, topic-name=TrafficlightArrayDdsEvent, transport-protocols=UDP
  service interface TrafficLightInterface
    namespaces:
      symbol props mdc
      symbol props trafficlight
    events:
      data TrafficLightArrayEvent: type=TrafficLightArray
