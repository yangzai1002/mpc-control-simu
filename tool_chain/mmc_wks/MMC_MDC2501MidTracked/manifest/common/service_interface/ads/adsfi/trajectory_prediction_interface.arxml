AUTOSAR XML (schema 00048)
package /HuaweiMDC/FunctionalSoftware/TrajetoryPredictionMsgDataType
  14 x std cpp implementation data type:
    PredictionHeader: category=STRUCTURE
      namespaces:
        symbol props ara
        symbol props adsfi
      cpp implementation data type element seq: type-reference=UInt32
      cpp implementation data type element stamp: type-reference=LaneTime
      cpp implementation data type element frameId: type-reference=String
    ObjPredictionOutArray: category=STRUCTURE
      namespaces:
        symbol props ara
        symbol props adsfi
      8 x cpp implementation data type element, all with category=TYPE_REFERENCE:
        header: type-reference=Header
        isValid: type-reference=bool
        predictionObstacle: type-reference=PredictionObstacleVector
        startTime: type-reference=Time
        endTime: type-reference=Time
        changeOriginFlag: type-reference=uint8_t
        selfIntent: type-reference=uint8_t
        scenario: type-reference=uint16_t
    PerceptionObstacle: category=STRUCTURE
      namespaces:
        symbol props ara
        symbol props adsfi
      22 x cpp implementation data type element, all with category=TYPE_REFERENCE:
        id: type-reference=uint32_t
        position: type-reference=Point
        theta: type-reference=Double
        velocity: type-reference=Point
        hasVelocity: type-reference=bool
        size: type-reference=Point
        polygonPoint: type-reference=PointArray
        trackingTime: type-reference=Double
        type: type-reference=uint8_t
        confidence: type-reference=Double
        gpsTime: type-reference=Time
        confidenceType: type-reference=uint8_t
        drops: type-reference=PointArray
        acceleration: type-reference=Point
        anchorPoint: type-reference=Point
        boundingBox: type-reference=PointArray
        subType: type-reference=uint8_t
        heightAboveGround: type-reference=Double
        positionCovariance: type-reference=DoubleArray9
        velocityCovariance: type-reference=DoubleArray9
        accelerationCovariance: type-reference=DoubleArray9
        lightStatus: type-reference=uint8_t
    PredictionTrajectoryPoint: category=STRUCTURE
      namespaces:
        symbol props ara
        symbol props adsfi
      cpp implementation data type element point: type-reference=Point
      cpp implementation data type element timestamp: type-reference=Time
    TrajectoryInPrediction: category=STRUCTURE
      namespaces:
        symbol props ara
        symbol props adsfi
      cpp implementation data type element probability: type-reference=Double
      cpp implementation data type element trajectoryPoints: type-reference=TrajectoryPointVector
    TrajectoryPoint: category=STRUCTURE
      namespaces:
        symbol props ara
        symbol props adsfi
      5 x cpp implementation data type element, all with category=TYPE_REFERENCE:
        pathPoint: type-reference=PathPoint
        speed: type-reference=Double
        velocity: type-reference=Double
        acceleration: type-reference=Double
        relativeTime: type-reference=Double
    TrajectoryPointVector: category=VECTOR, cpp-template-argument=TrajectoryPoint
      namespaces:
        symbol props ara
        symbol props adsfi
    TrajectoryInPredictionVector: category=VECTOR, cpp-template-argument=TrajectoryInPrediction
      namespaces:
        symbol props ara
        symbol props adsfi
    PredictionTrajectoryPointVector: category=VECTOR, cpp-template-argument=PredictionTrajectoryPoint
      namespaces:
        symbol props ara
        symbol props adsfi
    DoubleArray9: category=ARRAY, array-size=9, cpp-template-argument=Double
    ObstacleFeature: category=STRUCTURE
      namespaces:
        symbol props ara
        symbol props adsfi
      31 x cpp implementation data type element, all with category=TYPE_REFERENCE:
        id: type-reference=uint32_t
        polygonPoint: type-reference=PointArray
        position: type-reference=Point
        frontPosition: type-reference=Point
        velocity: type-reference=Point
        rawVelocity: type-reference=Point
        acceleration: type-reference=Point
        velocityHeading: type-reference=Double
        speed: type-reference=Double
        acc: type-reference=Double
        theta: type-reference=Double
        length: type-reference=Double
        width: type-reference=Double
        height: type-reference=Double
        trackingTime: type-reference=Double
        timestamp: type-reference=Time
        tPosition: type-reference=Point
        tVelocity: type-reference=Point
        tVelocityHeading: type-reference=Double
        tSpeed: type-reference=Double
        tAcceleration: type-reference=Point
        tAcc: type-reference=Double
        isStill: type-reference=bool
        type: type-reference=uint8_t
        labelUpdateTimeDelta: type-reference=Double
        priority: type-reference=uint8_t
        isNearJunction: type-reference=bool
        futureTrajectoryPoints: type-reference=PredictionTrajectoryPointVector
        shortTermPredictedTrajectoryPoints: type-reference=TrajectoryPointVector
        predictedTrajectory: type-reference=TrajectoryInPredictionVector
        adcTrajectoryPoint: type-reference=TrajectoryPointVector
    PredictionObstacle: category=STRUCTURE
      namespaces:
        symbol props ara
        symbol props adsfi
      8 x cpp implementation data type element, all with category=TYPE_REFERENCE:
        object: type-reference=PerceptionObstacle
        gpsTime: type-reference=Time
        predictedPeriod: type-reference=Double
        trajectory: type-reference=TrajectoryInPredictionVector
        intent: type-reference=uint8_t
        priority: type-reference=uint8_t
        isStatic: type-reference=bool
        feature: type-reference=ObstacleFeature
    PredictionObstacleVector: category=VECTOR, cpp-template-argument=PredictionObstacle
      namespaces:
        symbol props ara
        symbol props adsfi
    PathPoint: category=STRUCTURE
      namespaces:
        symbol props ara
        symbol props adsfi
      7 x cpp implementation data type element, all with category=TYPE_REFERENCE:
        point: type-reference=Point
        s: type-reference=Double
        theta: type-reference=Double
        kappa: type-reference=Double
        dkappa: type-reference=Double
        heading: type-reference=Double
        ddkappa: type-reference=Double
package /HuaweiMDC/FunctionalSoftware/TrajetoryPredictionServiceInterface
  service interface TrajetoryPredictionInterface
    namespaces:
      symbol props mdc
      symbol props adsfi
    events:
      data TrajetoryPredictionEvent: type=ObjPredictionOutArray
  dds service interface deployment TrajetoryPredictionDdsInterfaceDeployment: service-interface=TrajetoryPredictionInterface, frag-size=3200000, list-size=20, service-interface-id=4352
    dds event deployment TrajetoryPredictionEventDeployment: event=TrajetoryPredictionEvent, topic-name=TrajetoryPredictionDdsEvent, transport-protocols=UDP
