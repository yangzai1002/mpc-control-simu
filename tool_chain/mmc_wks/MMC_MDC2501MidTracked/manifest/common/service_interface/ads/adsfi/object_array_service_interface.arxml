AUTOSAR XML (schema 00048)
package /HuaweiMDC/FunctionalSoftware/ObjectArrayMsgDataType
  5 x std cpp implementation data type:
    Object: category=STRUCTURE
      namespaces:
        symbol props ara
        symbol props adsfi
      54 x cpp implementation data type element:
        header: type-reference=CommonHeader
        existence_probability: type-reference=Float
        id: type-reference=Int32
        time_last_update: type-reference=CommonHeader
        time_creation: type-reference=CommonHeader
        measurement_age_count: type-reference=Int32
        classification: type-reference=UInt8
        classification_description: type-reference=String
        classification_confidence: type-reference=Float
        classification_age_seconds: type-reference=Float
        classification_age_count: type-reference=Int32
        object_box_center: type-reference=Point
        object_box_center_absolute: type-reference=Point
        object_box_center_covariance: type-reference=Point
        object_box_size: type-reference=Point
        object_box_size_covariance: type-reference=Point
        box_image: type-reference=Rect
        object_box_orientation: type-reference=Float
        object_box_orientation_absolute: type-reference=Float
        object_box_orientation_covariance: type-reference=Float
        box_polygon: type-reference=Polygon
        box_polygon_absolute: type-reference=PointArray
        reference_point: type-reference=Point
        reference_point_covariance: type-reference=Point
        relative_velocity: type-reference=TwistWithCovariance
        absolute_velocity: type-reference=TwistWithCovariance
        enu_velocity: type-reference=TwistWithCovariance
        sl_velocity: type-reference=PointArray
        contour_points_absolute: type-reference=PointArray
        contour_points: type-reference=Polygon
        intention_paths: type-reference=PathWithCovarianceArray
        intention_time_step: type-reference=Float
        lane_id: type-reference=Int32Array
        lane_type: type-reference=Uint8Array
        position_in_lane: type-reference=PointArray
        length_in_lane: type-reference=FloatArray
        width_in_lane: type-reference=FloatArray
        road_id: type-reference=Int32
        road_type: type-reference=UInt8
        types: type-reference=UInt8
        cipv_flag: type-reference=UInt8
        fusion_type: type-reference=UInt8
        blinker_flag: type-reference=UInt8
        acceleration: type-reference=Point
        abs_acceleration: type-reference=Point
        anchor_point: type-reference=Point
        abs_anchor_point: type-reference=Point
        acceleration_covariance: type-reference=Matrix3d
        abs_acceleration_covariance: type-reference=Matrix3d
        velocity_covariance: type-reference=Matrix3d
        abs_velocity_covariance: type-reference=Matrix3d
        blinkerStatus: type-reference=UInt8
        cameraStatus: type-reference=UInt8
        coordinate: type-reference=UInt8
    ObjectArray: category=STRUCTURE
      namespaces:
        symbol props ara
        symbol props adsfi
      cpp implementation data type element header: type-reference=CommonHeader
      cpp implementation data type element package_type: type-reference=UInt8
      cpp implementation data type element object_list: type-reference=ObjectVector
    ObjectHeader: category=STRUCTURE
      namespaces:
        symbol props ara
        symbol props adsfi
      cpp implementation data type element seq: type-reference=UInt32
      cpp implementation data type element stamp: type-reference=Time
      cpp implementation data type element frameId: type-reference=String
    ObjectVector: category=VECTOR, cpp-template-argument=Object
      namespaces:
        symbol props ara
        symbol props adsfi
    Time: category=STRUCTURE
      namespaces:
        symbol props ara
        symbol props adsfi
      cpp implementation data type element sec: type-reference=UInt32
      cpp implementation data type element nsec: type-reference=UInt32
package /HuaweiMDC/FunctionalSoftware/ObjectArrayServiceInterface
  dds service interface deployment ObjectArrayDdsInterfaceDeployment: service-interface=ObjectArrayInterface, frag-size=409600, list-size=20, service-interface-id=3840
    dds event deployment ObjectArrayEventDeployment: event=ObjectArrayEvent, topic-name=ObjectArrayDdsEvent, transport-protocols=UDP
  service interface ObjectArrayInterface
    namespaces:
      symbol props mdc
      symbol props adsfi
    events:
      data ObjectArrayEvent: type=ObjectArray
