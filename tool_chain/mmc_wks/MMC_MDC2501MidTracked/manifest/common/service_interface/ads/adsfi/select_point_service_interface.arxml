AUTOSAR XML (schema 00048)
package /HuaweiMDC/FunctionalSoftware/SelectPointMsgDataType
  4 x std cpp implementation data type, all with category=STRUCTURE:
    Header
      namespaces:
        symbol props ara
        symbol props selectpoint
      cpp implementation data type element seq: type-reference=UInt32
      cpp implementation data type element stamp: type-reference=Time
      cpp implementation data type element frameId: type-reference=String
    Point
      namespaces:
        symbol props ara
        symbol props selectpoint
      cpp implementation data type element x: type-reference=Double
      cpp implementation data type element y: type-reference=Double
      cpp implementation data type element z: type-reference=Double
    SelectPoint
      namespaces:
        symbol props ara
        symbol props selectpoint
      cpp implementation data type element header: type-reference=Header
      cpp implementation data type element point: type-reference=Point
    Time
      namespaces:
        symbol props ara
        symbol props selectpoint
      cpp implementation data type element sec: type-reference=UInt32
      cpp implementation data type element nsec: type-reference=UInt32
package /HuaweiMDC/FunctionalSoftware/SelectPointServiceInterface
  dds service interface deployment SelectPointDdsInterfaceDeployment: service-interface=SelectPointServiceInterface, frag-size=409600, list-size=20, service-interface-id=4544
    dds event deployment SelectPointEventDeployment: event=SelectPointEvent, frag-size=204800, list-size=20, topic-name=SelectPointDdsEvent, transport-protocols=TCP
  service interface SelectPointServiceInterface: is-service=true
    namespaces:
      symbol props ara: symbol=mdc
      symbol props selectpoint
    events:
      data SelectPointEvent: type=SelectPoint
