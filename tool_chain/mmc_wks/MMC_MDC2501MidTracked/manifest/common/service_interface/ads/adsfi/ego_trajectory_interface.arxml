AUTOSAR XML (schema 00048)
package /HuaweiMDC/FunctionalSoftware/EgoTrajectoryMsgDataType
  8 x std cpp implementation data type:
    EgoTrajectory: category=STRUCTURE
      namespaces:
        symbol props ara
        symbol props egotrajectory
      18 x cpp implementation data type element:
        header: type-reference=Header
        locationState: type-reference=UInt8
        pose: type-reference=PoseWithCovariance
        velocity: type-reference=TwistWithCovariance
        acceleration: type-reference=AccelWithCovariance
        trajectoryLength: type-reference=Double
        trajectoryPeriod: type-reference=Double
        trajectoryPoints: type-reference=TrajectoryPointVector
        wayPoints: type-reference=WayPointVector
        isReplanning: type-reference=Boolean
        gear: type-reference=UInt32
        routingHeader: type-reference=Header
        selfLaneId: type-reference=String
        trajectoryType: type-reference=UInt32
        targetLaneId: type-reference=String
        estop: type-reference=Estop
        turnLight: type-reference=uint8_t
        isHold: type-reference=bool
    Estop: category=STRUCTURE
      namespaces:
        symbol props ara
        symbol props egotrajectory
      cpp implementation data type element isStop: type-reference=UInt8
      cpp implementation data type element description: type-reference=String
      cpp implementation data type element header: type-reference=Header
    Header: category=STRUCTURE
      namespaces:
        symbol props ara
        symbol props egotrajectory
      cpp implementation data type element seq: type-reference=UInt32
      cpp implementation data type element stamp: type-reference=Time
      cpp implementation data type element frameId: type-reference=String
    Time: category=STRUCTURE
      namespaces:
        symbol props ara
        symbol props egotrajectory
      cpp implementation data type element sec: type-reference=UInt32
      cpp implementation data type element nsec: type-reference=UInt32
    TrajectoryPoint: category=STRUCTURE
      namespaces:
        symbol props ara
        symbol props egotrajectory
      7 x cpp implementation data type element:
        speed: type-reference=Double
        acc: type-reference=Double
        timeRelative: type-reference=Double
        deltaAcc: type-reference=Double
        steerAngle: type-reference=Double
        wayPoint: type-reference=WayPoint
        header: type-reference=Header
    TrajectoryPointVector: category=VECTOR, cpp-template-argument=TrajectoryPoint
    WayPoint: category=STRUCTURE
      namespaces:
        symbol props ara
        symbol props egotrajectory
      11 x cpp implementation data type element:
        x: type-reference=Double
        y: type-reference=Double
        z: type-reference=Double
        theta: type-reference=Double
        curvature: type-reference=Double
        s: type-reference=Double
        deltaCurvature: type-reference=Double
        deltaX: type-reference=Double
        deltaY: type-reference=Double
        header: type-reference=Header
        laneId: type-reference=String
    WayPointVector: category=VECTOR, cpp-template-argument=WayPoint
package /HuaweiMDC/FunctionalSoftware/EgoTrajectoryServiceInterface
  dds service interface deployment EgoTrajectoryDdsInterfaceDeployment: service-interface=EgoTrajectoryServiceInterface, frag-size=409600, list-size=20, service-interface-id=4480
    dds event deployment EgoTrajectoryEventDeployment: event=EgoTrajectoryEvent, frag-size=204800, list-size=20, topic-name=EgoTrajectoryDdsEvent, transport-protocols=UDP
  service interface EgoTrajectoryServiceInterface: is-service=true
    namespaces:
      symbol props ara
      symbol props egotrajectory
    events:
      data EgoTrajectoryEvent: type=EgoTrajectory
