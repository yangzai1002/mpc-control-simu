AUTOSAR XML (schema 00048)
package /HuaweiMDC/FunctionalSoftware/SelectPointsMsgDataType
  std cpp implementation data type SelectPoints: category=STRUCTURE
    namespaces:
      symbol props adsfi
    cpp implementation data type element header: type-reference=CommonHeader
    cpp implementation data type element points: type-reference=PointArray
package /HuaweiMDC/FunctionalSoftware/SelectPointsServiceInterface
  dds service interface deployment SelectPointsDdsInterfaceDeployment: service-interface=SelectPointsIntf, frag-size=409600, list-size=20, service-interface-id=4546
    dds event deployment SelectPointsEventDeployment: event=SelectPoints, frag-size=204800, list-size=20, topic-name=SelectPointsDdsEvent, transport-protocols=TCP
  service interface SelectPointsIntf: is-service=true
    namespaces:
      symbol props adsfi
    events:
      data SelectPoints: type=SelectPoints
