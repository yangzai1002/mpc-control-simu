AUTOSAR XML (schema 00048)
package /HuaweiMDC/FunctionalSoftware/Object2dArrayMsgDataType
  std cpp implementation data type Object2d: category=STRUCTURE
    namespaces:
      symbol props adsfi
    15 x cpp implementation data type element:
      header: type-reference=CommonHeader
      existProb: type-reference=Double
      id: type-reference=UInt32
      timeCreation: type-reference=CommonTime
      cls: type-reference=UInt8
      clsDescription: type-reference=String
      clsConfidence: type-reference=Double
      velocity: type-reference=PointxyDouble
      absVelocity: type-reference=PointxyDouble
      cipvFlag: type-reference=UInt8
      acceleration: type-reference=PointxyDouble
      cameraStatus: type-reference=UInt8
      coordinate: type-reference=String
      blinkerStatus: type-reference=UInt8
      rect2d: type-reference=Rect2d
  std cpp implementation data type Object2dArray: category=STRUCTURE
    namespaces:
      symbol props adsfi
    cpp implementation data type element header: type-reference=CommonHeader
    cpp implementation data type element object: type-reference=Object2dVector
  std cpp implementation data type Object2dVector: category=VECTOR, cpp-template-argument=Object2d
    namespaces:
      symbol props adsfi
package /HuaweiMDC/FunctionalSoftware/Object2dArrayServiceInterface
  dds service interface deployment Object2dArrayDdsInterfaceDeployment: service-interface=Object2dArrayIntf, frag-size=409600, list-size=20, service-interface-id=3841
    dds event deployment Object2dArrayEventDeployment: event=Object2dArray, topic-name=Object2dArrayDdsEvent, transport-protocols=UDP
  service interface Object2dArrayIntf
    namespaces:
      symbol props adsfi
    events:
      data Object2dArray: type=Object2dArray
