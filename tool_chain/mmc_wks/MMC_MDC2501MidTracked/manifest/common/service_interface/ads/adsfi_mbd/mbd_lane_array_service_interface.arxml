AUTOSAR XML (schema 00048)
package /HuaweiMDC/FunctionalSoftware/LaneLineArrayMsgDataType
  4 x std cpp implementation data type:
    Lane: category=STRUCTURE
      namespaces:
        symbol props adsfi
      11 x cpp implementation data type element:
        id: type-reference=UInt32
        cls: type-reference=UInt8
        clsDescription: type-reference=String
        clsConfidence: type-reference=Float
        laneFit: type-reference=LaneFitParam
        startPoint: type-reference=Pointxy
        endPoint: type-reference=Pointxy
        keyPoints: type-reference=PointxyArray
        homographyMat: type-reference=Matrix3d
        homographyMatInv: type-reference=Matrix3d
        timeCreation: type-reference=CommonTime
    LaneArray: category=STRUCTURE
      namespaces:
        symbol props adsfi
      cpp implementation data type element header: type-reference=CommonHeader
      cpp implementation data type element lane: type-reference=LaneVector
    LaneFitParam: category=STRUCTURE
      namespaces:
        symbol props adsfi
      4 x cpp implementation data type element, all with category=TYPE_REFERENCE, type-reference=Double:
        a
        b
        c
        d
    LaneVector: category=VECTOR, cpp-template-argument=Lane
      namespaces:
        symbol props adsfi
package /HuaweiMDC/FunctionalSoftware/LaneLineArrayServiceInterface
  dds service interface deployment LaneArrayDdsInterfaceDeployment: service-interface=LaneArrayIntf, frag-size=409600, list-size=20, service-interface-id=3969
    dds event deployment LaneArrayEventDeployment: event=LaneArray, frag-size=204800, list-size=20, topic-name=LaneLineArrayDdsEvent, transport-protocols=UDP
  service interface LaneArrayIntf
    namespaces:
      symbol props adsfi
    events:
      data LaneArray: type=LaneArray
