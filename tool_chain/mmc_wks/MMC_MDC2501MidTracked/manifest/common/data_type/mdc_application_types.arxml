AUTOSAR XML (schema 00048)
package /HuaweiMDC/ApplicationDataType
  47 x std cpp implementation data type:
    Accel: category=STRUCTURE
      cpp implementation data type element linear: type-reference=Vector3
      cpp implementation data type element angular: type-reference=Vector3
    AccelWithCovariance: category=STRUCTURE
      cpp implementation data type element accel: type-reference=Accel
      cpp implementation data type element covariance: type-reference=DoubleArray36
    DoubleArray: category=VECTOR, cpp-template-argument=Double
    DoubleArray36: category=ARRAY, array-size=36, cpp-template-argument=Double
    FloatArray: category=VECTOR, cpp-template-argument=Float
    FloatArray36: category=ARRAY, array-size=36, cpp-template-argument=Float
    Gap: category=STRUCTURE
      5 x cpp implementation data type element, all with category=TYPE_REFERENCE:
        speed_front: type-reference=Float
        speed_back: type-reference=Float
        length: type-reference=Float
        distance: type-reference=Float
        lane_id: type-reference=Int32
    Int32Array: category=VECTOR, cpp-template-argument=Int32
    Lane: category=STRUCTURE
      20 x cpp implementation data type element, all with category=TYPE_REFERENCE:
        id: type-reference=Int32
        speed_limit: type-reference=Float
        left_changable: type-reference=UInt8
        left_changable_distance: type-reference=Float
        right_changable_distance: type-reference=Float
        right_changable: type-reference=UInt8
        road_points: type-reference=Pose2DArray
        left_edge: type-reference=Pose2DArray
        right_edge: type-reference=Pose2DArray
        next_lane_id: type-reference=Int32
        previous_lane_id: type-reference=Int32
        left_lane_id: type-reference=Int32
        right_lane_id: type-reference=Int32
        traffic_light_state: type-reference=UInt8
        traffic_light_distance: type-reference=Float
        stop_sign_distance: type-reference=Float
        parking_pole_distance: type-reference=Float
        cross_walk_distance: type-reference=Float
        type: type-reference=UInt8
        sub_lanes: type-reference=SubLaneArray
    LaneArray: category=VECTOR, cpp-template-argument=Lane
    ParkingSpot: category=STRUCTURE
      8 x cpp implementation data type element, all with category=TYPE_REFERENCE:
        header: type-reference=CommonHeader
        id: type-reference=UInt32
        parking_class: type-reference=UInt8
        class_confidence: type-reference=Float
        parking_spot_ego: type-reference=PointArray
        parking_spot_enu: type-reference=PointArray
        entry: type-reference=Uint8Array
        parking_spot_type: type-reference=UInt8
    ParkingSpotArray: category=VECTOR, cpp-template-argument=ParkingSpot
    PathWithCovariance: category=STRUCTURE
      cpp implementation data type element header: type-reference=CommonHeader
      cpp implementation data type element poses: type-reference=PoseWithCovarianceStamped
      cpp implementation data type element time_window: type-reference=TimeWindow
    PathWithCovarianceArray: category=VECTOR, cpp-template-argument=PathWithCovariance
    Point: category=STRUCTURE
      cpp implementation data type element x: type-reference=Double
      cpp implementation data type element y: type-reference=Double
      cpp implementation data type element z: type-reference=Double
    PointArray: category=VECTOR, cpp-template-argument=Point
    Pointxy: category=STRUCTURE
      cpp implementation data type element x: type-reference=Int32
      cpp implementation data type element y: type-reference=Int32
    PointxyArray: category=VECTOR, cpp-template-argument=Pointxy
    PointxyArrayArray: category=VECTOR, cpp-template-argument=PointxyArray
    Polygon: category=STRUCTURE
      cpp implementation data type element points: type-reference=PointArray
    Pose: category=STRUCTURE
      cpp implementation data type element position: type-reference=Point
      cpp implementation data type element orientation: type-reference=Quaternion
    Pose2D: category=STRUCTURE
      cpp implementation data type element x: type-reference=Double
      cpp implementation data type element y: type-reference=Double
      cpp implementation data type element theta: type-reference=Double
    Pose2DArray: category=VECTOR, cpp-template-argument=Pose2D
    PoseWithCovariance: category=STRUCTURE
      cpp implementation data type element pose: type-reference=Pose
      cpp implementation data type element covariance: type-reference=DoubleArray36
    PoseWithCovarianceStamped: category=STRUCTURE
      cpp implementation data type element header: type-reference=CommonHeader
      cpp implementation data type element pose: type-reference=PoseWithCovariance
    Quaternion: category=STRUCTURE
      4 x cpp implementation data type element, all with category=TYPE_REFERENCE, type-reference=Float:
        x
        y
        z
        w
    Rect: category=STRUCTURE
      4 x cpp implementation data type element, all with category=TYPE_REFERENCE, type-reference=Float:
        x
        y
        width
        height
    RoadPoint: category=STRUCTURE
      5 x cpp implementation data type element, all with category=TYPE_REFERENCE:
        x: type-reference=Double
        y: type-reference=Double
        z: type-reference=Double
        theta: type-reference=Double
        curvature: type-reference=Float
    RoadPointArray: category=VECTOR, cpp-template-argument=RoadPoint
    SubLane: category=STRUCTURE
      4 x cpp implementation data type element, all with category=TYPE_REFERENCE:
        lane_id: type-reference=Int32
        priority: type-reference=UInt8
        cross_point: type-reference=Pose2D
        stop_point: type-reference=Pose2D
    SubLaneArray: category=VECTOR, cpp-template-argument=SubLane
    TimeWindow: category=STRUCTURE
      cpp implementation data type element stamp: type-reference=CommonTime
      cpp implementation data type element age: type-reference=CommonTime
    Twist: category=STRUCTURE
      cpp implementation data type element linear: type-reference=Vector3
      cpp implementation data type element angular: type-reference=Vector3
    TwistWithCovariance: category=STRUCTURE
      cpp implementation data type element twist: type-reference=Twist
      cpp implementation data type element covariance: type-reference=DoubleArray36
    Uint8Array: category=VECTOR, cpp-template-argument=UInt8
    Vector3: category=STRUCTURE
      cpp implementation data type element x: type-reference=Double
      cpp implementation data type element y: type-reference=Double
      cpp implementation data type element z: type-reference=Double
    VirtualWall: category=STRUCTURE
      4 x cpp implementation data type element, all with category=TYPE_REFERENCE:
        target_speed: type-reference=Float
        target_distance: type-reference=Float
        desire_follow_seconds: type-reference=Float
        id: type-reference=Int32
    VirtualWallArray: category=VECTOR, cpp-template-argument=VirtualWall
    PointxyDouble: category=STRUCTURE
      cpp implementation data type element x: type-reference=Double
      cpp implementation data type element y: type-reference=Double
    PointxyDoubleArray: category=VECTOR, cpp-template-argument=PointxyDouble
    Rect3d: category=STRUCTURE
      7 x cpp implementation data type element:
        center: type-reference=Point
        centerCovariance: type-reference=Point
        size: type-reference=Point
        sizeCovariance: type-reference=Point
        orientation: type-reference=Point
        orientationCovariance: type-reference=Point
        corners: type-reference=PointArray
    Rect2d: category=STRUCTURE
      8 x cpp implementation data type element, all with type-reference=PointxyDouble:
        center: category=TYPE_REFERENCE
        centerCovariance: category=TYPE_REFERENCE
        size
        sizeCovariance
        orientation
        orientationCovariance
        corners
        leftTop
    Matrix3d: category=ARRAY, array-size=9, cpp-template-argument=Double
    StringVector: category=VECTOR, cpp-template-argument=String
    FloatArray4: category=ARRAY, array-size=4, cpp-template-argument=Float
    Uint8Vector: category=VECTOR, cpp-template-argument=UInt8
    Uint32Vector: category=VECTOR, cpp-template-argument=UInt32
package /HuaweiMDC/ApplicationComplexDataType/NavigationDataType
  8 x std cpp implementation data type:
    LanePiece: category=STRUCTURE
      cpp implementation data type element id: type-reference=String
      cpp implementation data type element startS: type-reference=Double
      cpp implementation data type element endS: type-reference=Double
    LanePieceVector: category=VECTOR, cpp-template-argument=LanePiece
    LaneSeries: category=STRUCTURE
      cpp implementation data type element laneSeries: type-reference=LanePieceVector
      cpp implementation data type element isDrivable: type-reference=Boolean
      cpp implementation data type element directionType: type-reference=UInt32
    LaneSeriesVector: category=VECTOR, cpp-template-argument=LaneSeries
    NaviRoadPoint: category=STRUCTURE
      cpp implementation data type element id: type-reference=String
      cpp implementation data type element s: type-reference=Double
      cpp implementation data type element pose: type-reference=Point
    NaviRoadPointVector: category=VECTOR, cpp-template-argument=NaviRoadPoint
    RoadPiece: category=STRUCTURE
      cpp implementation data type element roadPiece: type-reference=LaneSeriesVector
      cpp implementation data type element id: type-reference=String
      cpp implementation data type element roadType: type-reference=UInt32
    RoadPieceVector: category=VECTOR, cpp-template-argument=RoadPiece
