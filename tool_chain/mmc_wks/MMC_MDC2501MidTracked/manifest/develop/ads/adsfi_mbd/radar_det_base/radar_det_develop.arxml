AUTOSAR XML (schema 00048)
package /HuaweiMDC/FunctionalSoftware/RadarDet/Execution
  executable radar_det_execute
    root sw component prototype radar_det_root_swc: application-type=radar_det_base
package /HuaweiMDC/FunctionalSoftware/RadarDet/SwComponent
  adaptive application sw component type radar_det_base
    provide port Object3dPPort: provided-interface=Object3dArrayIntf
