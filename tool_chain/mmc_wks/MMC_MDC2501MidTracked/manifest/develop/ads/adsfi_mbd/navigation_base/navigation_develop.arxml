AUTOSAR XML (schema 00048)
package /HuaweiMDC/FunctionalSoftware/NavigationApplication/Execution
  executable navigation_execute
    root sw component prototype navigation_root_swc: application-type=navigation_base
package /HuaweiMDC/FunctionalSoftware/NavigationApplication/SwComponent
  adaptive application sw component type navigation_base
    provide port NavigationPPort: provided-interface=NavigationInfoIntf
