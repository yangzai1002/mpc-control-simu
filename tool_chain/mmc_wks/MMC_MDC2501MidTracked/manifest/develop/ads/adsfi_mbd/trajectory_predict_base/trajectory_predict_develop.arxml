AUTOSAR XML (schema 00048)
package /HuaweiMDC/FunctionalSoftware/TrajectoryPredict/Execution
  executable trajectory_predict_execute
    root sw component prototype trajectory_predict_root_swc: application-type=trajectory_predict_base
package /HuaweiMDC/FunctionalSoftware/TrajectoryPredict/SwComponent
  adaptive application sw component type trajectory_predict_base
    provide port TrajPredictPPort: provided-interface=TrajPredictIntf
