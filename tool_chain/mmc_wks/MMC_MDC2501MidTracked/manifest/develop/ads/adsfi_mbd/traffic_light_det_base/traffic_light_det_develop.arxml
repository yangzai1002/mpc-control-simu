AUTOSAR XML (schema 00048)
package /HuaweiMDC/FunctionalSoftware/TrafficLightDet/Execution
  executable traffic_light_det_execute
    root sw component prototype traffic_light_det_root_swc: application-type=traffic_light_det_base
package /HuaweiMDC/FunctionalSoftware/TrafficLightDet/SwComponent
  adaptive application sw component type traffic_light_det_base
    provide port TrafficLightPPort: provided-interface=TrafficSignalIntf
