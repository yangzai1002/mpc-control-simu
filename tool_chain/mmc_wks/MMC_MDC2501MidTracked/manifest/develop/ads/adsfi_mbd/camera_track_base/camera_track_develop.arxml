AUTOSAR XML (schema 00048)
package /HuaweiMDC/FunctionalSoftware/CameraTrack/Execution
  executable camera_track_execute
    root sw component prototype camera_track_root_swc: application-type=camera_track_base
package /HuaweiMDC/FunctionalSoftware/CameraTrack/SwComponent
  adaptive application sw component type camera_track_base
    provide port Object2dPPort: provided-interface=Object2dArrayIntf
