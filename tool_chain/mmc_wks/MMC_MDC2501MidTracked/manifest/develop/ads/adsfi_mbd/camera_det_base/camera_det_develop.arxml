AUTOSAR XML (schema 00048)
package /HuaweiMDC/FunctionalSoftware/CameraDet/Execution
  executable camera_det_execute
    root sw component prototype camera_det_root_swc: application-type=camera_det_base
package /HuaweiMDC/FunctionalSoftware/CameraDet/SwComponent
  adaptive application sw component type camera_det_base
    provide port Object2dPPort: provided-interface=Object2dArrayIntf
