AUTOSAR XML (schema 00048)
package /HuaweiMDC/Sotif/CrossValidate/Execution
  executable sotif_cross_validate_execute
    root sw component prototype sotif_cross_validate_root_swc: application-type=sotif_cross_validate_base
package /HuaweiMDC/Sotif/CrossValidate/SwComponent
  adaptive application sw component type sotif_cross_validate_base
    provide port CrossValidateArrayPPort: provided-interface=CrossValidateArrayIntf
