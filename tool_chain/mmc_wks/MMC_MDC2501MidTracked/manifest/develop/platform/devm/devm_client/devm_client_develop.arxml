AUTOSAR XML (schema 00048)
package /HuaweiMDC/PlatformApplication/DevmClientApplication/Execution
  executable devm_client
    root sw component prototype devm_client: application-type=devm_client
package /HuaweiMDC/PlatformApplication/DevmClientApplication/SwComponent
  adaptive application sw component type devm_client
    require port DevmAppFromCenterRPort: required-interface=DevmCenterServiceInterface
