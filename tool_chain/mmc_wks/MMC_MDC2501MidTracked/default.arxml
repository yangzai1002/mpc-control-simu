AUTOSAR XML (schema 00048)
package /HuaweiMDC/process_manifests/processes
  30 x process, all with log-trace-default-log-level=INFO, log-trace-log-modes=NETWORK:
    hw_camera_listProcess1: design=hw_camera_listProcessDesign1, executable=HwCameraList
    hw_l106_lidarProcess3: design=hw_l106_lidarProcessDesign3, executable=HwL106LidarFront
    hw_l106_lidarProcess4: design=hw_l106_lidarProcessDesign4, executable=HwL106LidarLeft
    hw_l106_lidarProcess5: design=hw_l106_lidarProcessDesign5, executable=HwL106LidarRight
    bd21_imuProcess6: design=bd21_imuProcessDesign6, executable=BD21Imu
    mid_track_chassis_recvProcess7: design=mid_track_chassis_recvProcessDesign7, executable=VehicleChassisRecv
    fusion_semantic_map_baseProcess11: design=fusion_semantic_map_baseProcessDesign11, executable=FusionSemanticMap
    xh265_rtp_pusherProcess14: design=xh265_rtp_pusherProcessDesign14, executable=XH265RtpPusher
    ControlProcess16: design=ControlProcessDesign16, executable=Control
    mid_track_chassis_sendProcess19: design=mid_track_chassis_sendProcessDesign19, executable=VehicleChassisSend
    xzmq_rcProcess19: design=xzmq_rcProcessDesign19, executable=XZmqRc
    xh265_encoderProcess19: design=xh265_encoderProcessDesign19, executable=XH265Encoder
    hw_fr671_radarProcess20: design=hw_fr671_radarProcessDesign20, executable=HwFr671RadarFront
    hw_fr671_radarProcess21: design=hw_fr671_radarProcessDesign21, executable=HwFr671RadarLeft
    hw_fr671_radarProcess22: design=hw_fr671_radarProcessDesign22, executable=HwFr671RadarRight
    rtspserverswcProcess24: design=rtspserverswcProcessDesign24, executable=XH265RtspServer
    LidarSlamProcess25: design=LidarSlamProcessDesign25, executable=LidarSlam
    OdometryProcess26: design=OdometryProcessDesign26, executable=Odometry
    LocationProcess27: design=LocationProcessDesign27, executable=Location
    LidarDetectionProcess28: design=LidarDetectionProcessDesign28, executable=LidarDetection
    lidar_terrain_map_detectionProcess29: design=lidar_terrain_map_detectionProcessDesign29, executable=LidarTerrainMapDetection
    fusion_follow_baseProcess30: design=fusion_follow_baseProcessDesign30, executable=FusionFollow
    xh265_recorderProcess42: design=xh265_recorderProcessDesign42, executable=XH265Recorder
    xfault_handler_baseProcess43: design=xfault_handler_baseProcessDesign43, executable=XFaultHandler
    xdata_trigger_recorder_baseProcess46: design=xdata_trigger_recorder_baseProcessDesign46, executable=XDataTriggerRecorder
    xvehicle_status_recorder_baseProcess47: design=xvehicle_status_recorder_baseProcessDesign47, executable=XVehicleStatusRecorder
    sensor_viualize_baseProcess38: design=sensor_viualize_baseProcessDesign38, executable=SensorVisualize
    driver_dev_nullProcess37: design=driver_dev_nullProcessDesign37, executable=DriverDevNull
    multy_camera_det_baseProcess34: design=multy_camera_det_baseProcessDesign34, executable=MultiCameraDetection
    PlanningProcess31: design=PlanningProcessDesign31, executable=Planning
package /HuaweiMDC/process_manifests/processDesigns
  30 x process design:
    hw_camera_listProcessDesign1: executable=HwCameraList
    hw_l106_lidarProcessDesign3: executable=HwL106LidarFront
    hw_l106_lidarProcessDesign4: executable=HwL106LidarLeft
    hw_l106_lidarProcessDesign5: executable=HwL106LidarRight
    bd21_imuProcessDesign6: executable=BD21Imu
    mid_track_chassis_recvProcessDesign7: executable=VehicleChassisRecv
    fusion_semantic_map_baseProcessDesign11: executable=FusionSemanticMap
    xh265_rtp_pusherProcessDesign14: executable=XH265RtpPusher
    ControlProcessDesign16: executable=Control
    mid_track_chassis_sendProcessDesign19: executable=VehicleChassisSend
    xzmq_rcProcessDesign19: executable=XZmqRc
    xh265_encoderProcessDesign19: executable=XH265Encoder
    hw_fr671_radarProcessDesign20: executable=HwFr671RadarFront
    hw_fr671_radarProcessDesign21: executable=HwFr671RadarLeft
    hw_fr671_radarProcessDesign22: executable=HwFr671RadarRight
    rtspserverswcProcessDesign24: executable=XH265RtspServer
    LidarSlamProcessDesign25: executable=LidarSlam
    OdometryProcessDesign26: executable=Odometry
    LocationProcessDesign27: executable=Location
    LidarDetectionProcessDesign28: executable=LidarDetection
    lidar_terrain_map_detectionProcessDesign29: executable=LidarTerrainMapDetection
    fusion_follow_baseProcessDesign30: executable=FusionFollow
    xh265_recorderProcessDesign42: executable=XH265Recorder
    xfault_handler_baseProcessDesign43: executable=XFaultHandler
    xdata_trigger_recorder_baseProcessDesign46: executable=XDataTriggerRecorder
    xvehicle_status_recorder_baseProcessDesign47: executable=XVehicleStatusRecorder
    sensor_viualize_baseProcessDesign38: executable=SensorVisualize
    driver_dev_nullProcessDesign37: executable=DriverDevNull
    multy_camera_det_baseProcessDesign34: executable=MultiCameraDetection
    PlanningProcessDesign31: executable=Planning
package /HuaweiMDC/process_manifests/processToMachineMappingSets
  30 x process to machine mapping set:
    ProcessToMachineMappingSet_hw_camera_listProcess1
      process to machine mapping processToMachineMapping0: machine=Host0DpMachine, process=hw_camera_listProcess1
    ProcessToMachineMappingSet_hw_l106_lidarProcess3
      process to machine mapping processToMachineMapping2: machine=Host0DpMachine, process=hw_l106_lidarProcess3
    ProcessToMachineMappingSet_hw_l106_lidarProcess4
      process to machine mapping processToMachineMapping3: machine=Host0DpMachine, process=hw_l106_lidarProcess4
    ProcessToMachineMappingSet_hw_l106_lidarProcess5
      process to machine mapping processToMachineMapping4: machine=Host0DpMachine, process=hw_l106_lidarProcess5
    ProcessToMachineMappingSet_bd21_imuProcess6
      process to machine mapping processToMachineMapping5: machine=Host0DpMachine, process=bd21_imuProcess6
    ProcessToMachineMappingSet_mid_track_chassis_recvProcess7
      process to machine mapping processToMachineMapping6: machine=Host0DpMachine, process=mid_track_chassis_recvProcess7
    ProcessToMachineMappingSet_fusion_semantic_map_baseProcess11
      process to machine mapping processToMachineMapping10: machine=Host0DpMachine, process=fusion_semantic_map_baseProcess11
    ProcessToMachineMappingSet_xh265_rtp_pusherProcess14
      process to machine mapping processToMachineMapping13: machine=Host0DpMachine, process=xh265_rtp_pusherProcess14
    ProcessToMachineMappingSet_ControlProcess16
      process to machine mapping processToMachineMapping15: machine=Host0DpMachine, process=ControlProcess16
    ProcessToMachineMappingSet_mid_track_chassis_sendProcess19
      process to machine mapping processToMachineMapping18: machine=Host0DpMachine, process=mid_track_chassis_sendProcess19
    ProcessToMachineMappingSet_xzmq_rcProcess19
      process to machine mapping processToMachineMapping18: machine=Host0DpMachine, process=xzmq_rcProcess19
    ProcessToMachineMappingSet_xh265_encoderProcess19
      process to machine mapping processToMachineMapping18: machine=Host0DpMachine, process=xh265_encoderProcess19
    ProcessToMachineMappingSet_hw_fr671_radarProcess20
      process to machine mapping processToMachineMapping19: machine=Host0DpMachine, process=hw_fr671_radarProcess20
    ProcessToMachineMappingSet_hw_fr671_radarProcess21
      process to machine mapping processToMachineMapping20: machine=Host0DpMachine, process=hw_fr671_radarProcess21
    ProcessToMachineMappingSet_hw_fr671_radarProcess22
      process to machine mapping processToMachineMapping21: machine=Host0DpMachine, process=hw_fr671_radarProcess22
    ProcessToMachineMappingSet_rtspserverswcProcess24
      process to machine mapping processToMachineMapping23: machine=Host0DpMachine, process=rtspserverswcProcess24
    ProcessToMachineMappingSet_LidarSlamProcess25
      process to machine mapping processToMachineMapping24: machine=Host0DpMachine, process=LidarSlamProcess25
    ProcessToMachineMappingSet_OdometryProcess26
      process to machine mapping processToMachineMapping25: machine=Host0DpMachine, process=OdometryProcess26
    ProcessToMachineMappingSet_LocationProcess27
      process to machine mapping processToMachineMapping26: machine=Host0DpMachine, process=LocationProcess27
    ProcessToMachineMappingSet_LidarDetectionProcess28
      process to machine mapping processToMachineMapping27: machine=Host0DpMachine, process=LidarDetectionProcess28
    ProcessToMachineMappingSet_lidar_terrain_map_detectionProcess29
      process to machine mapping processToMachineMapping28: machine=Host0DpMachine, process=lidar_terrain_map_detectionProcess29
    ProcessToMachineMappingSet_fusion_follow_baseProcess30
      process to machine mapping processToMachineMapping29: machine=Host0DpMachine, process=fusion_follow_baseProcess30
    ProcessToMachineMappingSet_xh265_recorderProcess42
      process to machine mapping processToMachineMapping41: machine=Host0DpMachine, process=xh265_recorderProcess42
    ProcessToMachineMappingSet_xfault_handler_baseProcess43
      process to machine mapping processToMachineMapping42: machine=Host0DpMachine, process=xfault_handler_baseProcess43
    ProcessToMachineMappingSet_xdata_trigger_recorder_baseProcess46
      process to machine mapping processToMachineMapping45: machine=Host0DpMachine, process=xdata_trigger_recorder_baseProcess46
    ProcessToMachineMappingSet_xvehicle_status_recorder_baseProcess47
      process to machine mapping processToMachineMapping46: machine=Host0DpMachine, process=xvehicle_status_recorder_baseProcess47
    ProcessToMachineMappingSet_sensor_viualize_baseProcess38
      process to machine mapping processToMachineMapping37: machine=Host0DpMachine, process=sensor_viualize_baseProcess38
    ProcessToMachineMappingSet_driver_dev_nullProcess37
      process to machine mapping processToMachineMapping36: machine=Host0DpMachine, process=driver_dev_nullProcess37
    ProcessToMachineMappingSet_multy_camera_det_baseProcess34
      process to machine mapping processToMachineMapping33: machine=Host0DpMachine, process=multy_camera_det_baseProcess34
    ProcessToMachineMappingSet_PlanningProcess31
      process to machine mapping processToMachineMapping30: machine=Host0DpMachine, process=PlanningProcess31
package /HuaweiMDC/exe_manifests/exes
  30 x executable, all with logging-behavior=USES-LOGGING, reporting-behavior=REPORTS-EXECUTION-STATE:
    HwCameraList
      root sw component prototype hw_camera_listExecutable1Prototype: application-type=hw_camera_listCompositionSwComponentType1
    HwL106LidarFront
      root sw component prototype hw_l106_lidarExecutable3Prototype: application-type=hw_l106_lidarCompositionSwComponentType3
    HwL106LidarLeft
      root sw component prototype hw_l106_lidarExecutable4Prototype: application-type=hw_l106_lidarCompositionSwComponentType4
    HwL106LidarRight
      root sw component prototype hw_l106_lidarExecutable5Prototype: application-type=hw_l106_lidarCompositionSwComponentType5
    BD21Imu
      root sw component prototype bd21_imuExecutable6Prototype: application-type=bd21_imuCompositionSwComponentType6
    VehicleChassisRecv
      root sw component prototype mid_track_chassis_recvExecutable7Prototype: application-type=mid_track_chassis_recvCompositionSwComponentType7
    FusionSemanticMap
      root sw component prototype fusion_semantic_map_baseExecutable11Prototype: application-type=fusion_semantic_map_baseCompositionSwComponentType11
    XH265RtpPusher
      root sw component prototype xh265_rtp_pusherExecutable14Prototype: application-type=xh265_rtp_pusherCompositionSwComponentType14
    Control
      root sw component prototype ControlExecutable16Prototype: application-type=ControlCompositionSwComponentType16
    VehicleChassisSend
      root sw component prototype mid_track_chassis_sendExecutable19Prototype: application-type=mid_track_chassis_sendCompositionSwComponentType19
    XZmqRc
      root sw component prototype xzmq_rcExecutable19Prototype: application-type=xzmq_rcCompositionSwComponentType19
    XH265Encoder
      root sw component prototype xh265_encoderExecutable19Prototype: application-type=xh265_encoderCompositionSwComponentType19
    HwFr671RadarFront
      root sw component prototype hw_fr671_radarExecutable20Prototype: application-type=hw_fr671_radarCompositionSwComponentType20
    HwFr671RadarLeft
      root sw component prototype hw_fr671_radarExecutable21Prototype: application-type=hw_fr671_radarCompositionSwComponentType21
    HwFr671RadarRight
      root sw component prototype hw_fr671_radarExecutable22Prototype: application-type=hw_fr671_radarCompositionSwComponentType22
    XH265RtspServer
      root sw component prototype rtspserverswcExecutable24Prototype: application-type=rtspserverswcCompositionSwComponentType24
    LidarSlam
      root sw component prototype LidarSlamExecutable25Prototype: application-type=LidarSlamCompositionSwComponentType25
    Odometry
      root sw component prototype OdometryExecutable26Prototype: application-type=OdometryCompositionSwComponentType26
    Location
      root sw component prototype LocationExecutable27Prototype: application-type=LocationCompositionSwComponentType27
    LidarDetection
      root sw component prototype LidarDetectionExecutable28Prototype: application-type=LidarDetectionCompositionSwComponentType28
    LidarTerrainMapDetection
      root sw component prototype lidar_terrain_map_detectionExecutable29Prototype: application-type=lidar_terrain_map_detectionCompositionSwComponentType29
    FusionFollow
      root sw component prototype fusion_follow_baseExecutable30Prototype: application-type=fusion_follow_baseCompositionSwComponentType30
    XH265Recorder
      root sw component prototype xh265_recorderExecutable42Prototype: application-type=xh265_recorderCompositionSwComponentType42
    XFaultHandler
      root sw component prototype xfault_handler_baseExecutable43Prototype: application-type=xfault_handler_baseCompositionSwComponentType43
    XDataTriggerRecorder
      root sw component prototype xdata_trigger_recorder_baseExecutable46Prototype: application-type=xdata_trigger_recorder_baseCompositionSwComponentType46
    XVehicleStatusRecorder
      root sw component prototype xvehicle_status_recorder_baseExecutable47Prototype: application-type=xvehicle_status_recorder_baseCompositionSwComponentType47
    SensorVisualize
      root sw component prototype sensor_viualize_baseExecutable38Prototype: application-type=sensor_viualize_baseCompositionSwComponentType38
    DriverDevNull
      root sw component prototype driver_dev_nullExecutable37Prototype: application-type=driver_dev_nullCompositionSwComponentType37
    MultiCameraDetection
      root sw component prototype multy_camera_det_baseExecutable34Prototype: application-type=multy_camera_det_baseCompositionSwComponentType34
    Planning
      root sw component prototype PlanningExecutable31Prototype: application-type=PlanningCompositionSwComponentType31
package /HuaweiMDC/exe_manifests/InstanceToPortMappings
  131 x service instance to port prototype mapping:
    ImageListPPortPrototype_DdsProvidedServiceInstance1_PortMapping: port-prototype=hw_camera_listExecutable1Prototype.image_list, process=hw_camera_listProcessDesign1, service-instance=ImageListPPortPrototype_DdsProvidedServiceInstance1
    PointCloudPPortPrototype_DdsProvidedServiceInstance2_PortMapping: port-prototype=hw_l106_lidarExecutable3Prototype.lidarpoints, process=hw_l106_lidarProcessDesign3, service-instance=PointCloudPPortPrototype_DdsProvidedServiceInstance2
    PointCloudPPortPrototype_DdsProvidedServiceInstance3_PortMapping: port-prototype=hw_l106_lidarExecutable4Prototype.lidarpoints, process=hw_l106_lidarProcessDesign4, service-instance=PointCloudPPortPrototype_DdsProvidedServiceInstance3
    PointCloudPPortPrototype_DdsProvidedServiceInstance4_PortMapping: port-prototype=hw_l106_lidarExecutable5Prototype.lidarpoints, process=hw_l106_lidarProcessDesign5, service-instance=PointCloudPPortPrototype_DdsProvidedServiceInstance4
    VehicleInfoPPortPrototype_DdsProvidedServiceInstance6_PortMapping: port-prototype=mid_track_chassis_recvExecutable7Prototype.tpvehiclestate, process=mid_track_chassis_recvProcessDesign7, service-instance=VehicleInfoPPortPrototype_DdsProvidedServiceInstance6
    RPortPrototype2_DdsRequiredServiceInstance14_PortMapping: port-prototype=ControlExecutable16Prototype.tpvehiclestate, process=ControlProcessDesign16, service-instance=RPortPrototype2_DdsRequiredServiceInstance14
    ZmqRRemoteControlPPortPrototype_DdsProvidedServiceInstance26_PortMapping: port-prototype=xzmq_rcExecutable19Prototype.tpappremotecmd, process=xzmq_rcProcessDesign19, service-instance=ZmqRRemoteControlPPortPrototype_DdsProvidedServiceInstance26
    WheelSpeedPPortPrototype_DdsProvidedServiceInstance23_PortMapping: port-prototype=bd21_imuExecutable6Prototype.ivwheelspeed, process=bd21_imuProcessDesign6, service-instance=WheelSpeedPPortPrototype_DdsProvidedServiceInstance23
    ImuPPortPrototype_DdsProvidedServiceInstance25_PortMapping: port-prototype=bd21_imuExecutable6Prototype.ivsensorimu, process=bd21_imuProcessDesign6, service-instance=ImuPPortPrototype_DdsProvidedServiceInstance25
    RPortPrototype1_DdsRequiredServiceInstance40_PortMapping: port-prototype=OdometryExecutable26Prototype.tpwheelspeed, process=OdometryProcessDesign26, service-instance=RPortPrototype1_DdsRequiredServiceInstance40
    RPortPrototype2_DdsRequiredServiceInstance41_PortMapping: port-prototype=OdometryExecutable26Prototype.tpsensorimu, process=OdometryProcessDesign26, service-instance=RPortPrototype2_DdsRequiredServiceInstance41
    bag_ondemand_status_DdsProvidedServiceInstance25_PortMapping: port-prototype=xdata_trigger_recorder_baseExecutable46Prototype.bag_ondemand_status, process=xdata_trigger_recorder_baseProcessDesign46, service-instance=bag_ondemand_status_DdsProvidedServiceInstance25
    tpfault_data_DdsProvidedServiceInstance27_PortMapping: port-prototype=xfault_handler_baseExecutable43Prototype.tpfault_data, process=xfault_handler_baseProcessDesign43, service-instance=tpfault_data_DdsProvidedServiceInstance27
    tpimu_DdsProvidedServiceInstance30_PortMapping: port-prototype=bd21_imuExecutable6Prototype.tpimu, process=bd21_imuProcessDesign6, service-instance=tpimu_DdsProvidedServiceInstance30
    RPortPrototype1_DdsRequiredServiceInstance53_PortMapping: port-prototype=LidarDetectionExecutable28Prototype.tpfront_middle_lidar_points, process=LidarDetectionProcessDesign28, service-instance=RPortPrototype1_DdsRequiredServiceInstance53
    RPortPrototype3_DdsRequiredServiceInstance97_PortMapping: port-prototype=ControlExecutable16Prototype.tpfault_data, process=ControlProcessDesign16, service-instance=RPortPrototype3_DdsRequiredServiceInstance97
    tpvehicle_to_can_pre_aeb_DdsProvidedServiceInstance39_PortMapping: port-prototype=ControlExecutable16Prototype.tpvehicle_to_can_pre_aeb, process=ControlProcessDesign16, service-instance=tpvehicle_to_can_pre_aeb_DdsProvidedServiceInstance39
    ivsensorgps_DdsProvidedServiceInstance45_PortMapping: port-prototype=bd21_imuExecutable6Prototype.ivsensorgps, process=bd21_imuProcessDesign6, service-instance=ivsensorgps_DdsProvidedServiceInstance45
    RPortPrototype2_DdsRequiredServiceInstance154_PortMapping: port-prototype=xfault_handler_baseExecutable43Prototype.tpappremotecmd, process=xfault_handler_baseProcessDesign43, service-instance=RPortPrototype2_DdsRequiredServiceInstance154
    RPortPrototype2_DdsRequiredServiceInstance167_PortMapping: port-prototype=xdata_trigger_recorder_baseExecutable46Prototype.tpfault_data, process=xdata_trigger_recorder_baseProcessDesign46, service-instance=RPortPrototype2_DdsRequiredServiceInstance167
    RPortPrototype2_DdsRequiredServiceInstance105_PortMapping: port-prototype=hw_fr671_radarExecutable22Prototype.tpimu1, process=hw_fr671_radarProcessDesign22, service-instance=RPortPrototype2_DdsRequiredServiceInstance105
    RPortPrototype4_DdsRequiredServiceInstance107_PortMapping: port-prototype=hw_fr671_radarExecutable20Prototype.tpimu2, process=hw_fr671_radarProcessDesign20, service-instance=RPortPrototype4_DdsRequiredServiceInstance107
    RPortPrototype6_DdsRequiredServiceInstance109_PortMapping: port-prototype=hw_fr671_radarExecutable21Prototype.tpimu3, process=hw_fr671_radarProcessDesign21, service-instance=RPortPrototype6_DdsRequiredServiceInstance109
    RPortPrototype3_DdsRequiredServiceInstance110_PortMapping: port-prototype=OdometryExecutable26Prototype.tpimu, process=OdometryProcessDesign26, service-instance=RPortPrototype3_DdsRequiredServiceInstance110
    RPortPrototype4_DdsRequiredServiceInstance111_PortMapping: port-prototype=OdometryExecutable26Prototype.tpsensorgps, process=OdometryProcessDesign26, service-instance=RPortPrototype4_DdsRequiredServiceInstance111
    RPortPrototype1_DdsRequiredServiceInstance107_PortMapping: port-prototype=LidarSlamExecutable25Prototype.tpfront_middle_lidar_points, process=LidarSlamProcessDesign25, service-instance=requiredInstances/RPortPrototype1_DdsRequiredServiceInstance107
    RPortPrototype3_DdsRequiredServiceInstance109_PortMapping: port-prototype=LidarSlamExecutable25Prototype.tpfront_right_lidar_points, process=LidarSlamProcessDesign25, service-instance=requiredInstances/RPortPrototype3_DdsRequiredServiceInstance109
    RPortPrototype4_DdsRequiredServiceInstance110_PortMapping: port-prototype=LidarSlamExecutable25Prototype.tpsensorimu, process=LidarSlamProcessDesign25, service-instance=requiredInstances/RPortPrototype4_DdsRequiredServiceInstance110
    RPortPrototype5_DdsRequiredServiceInstance111_wspeedPortMapping: port-prototype=LidarSlamExecutable25Prototype.tpwheelspeed, process=LidarSlamProcessDesign25, service-instance=RPortPrototype5_DdsRequiredServiceInstance111_wspeed
    RPortPrototype1_DdsRequiredServiceInstance107_PortMapping: port-prototype=LocationExecutable27Prototype.tpfront_middle_lidar_points, process=LocationProcessDesign27, service-instance=requiredInstances/RPortPrototype1_DdsRequiredServiceInstance107
    RPortPrototype3_DdsRequiredServiceInstance109_PortMapping: port-prototype=LocationExecutable27Prototype.tpfront_right_lidar_points, process=LocationProcessDesign27, service-instance=requiredInstances/RPortPrototype3_DdsRequiredServiceInstance109
    RPortPrototype4_DdsRequiredServiceInstance110_PortMapping: port-prototype=LocationExecutable27Prototype.tpsensorimu, process=LocationProcessDesign27, service-instance=requiredInstances/RPortPrototype4_DdsRequiredServiceInstance110
    RPortPrototype5_DdsRequiredServiceInstance111_PortMapping: port-prototype=LocationExecutable27Prototype.tpimu, process=LocationProcessDesign27, service-instance=RPortPrototype5_DdsRequiredServiceInstance111
    RPortPrototype6_DdsRequiredServiceInstance112_PortMapping: port-prototype=LocationExecutable27Prototype.tpwheelspeed, process=LocationProcessDesign27, service-instance=RPortPrototype6_DdsRequiredServiceInstance112
    tpliodr_DdsProvidedServiceInstance36_PortMapping: port-prototype=LidarSlamExecutable25Prototype.tpliodr, process=LidarSlamProcessDesign25, service-instance=tpliodr_DdsProvidedServiceInstance36
    RPortPrototype7_DdsRequiredServiceInstance113_PortMapping: port-prototype=LocationExecutable27Prototype.tpliodr, process=LocationProcessDesign27, service-instance=RPortPrototype7_DdsRequiredServiceInstance113
    tpododr_DdsProvidedServiceInstance37_PortMapping: port-prototype=OdometryExecutable26Prototype.tpododr, process=OdometryProcessDesign26, service-instance=tpododr_DdsProvidedServiceInstance37
    RPortPrototype8_DdsRequiredServiceInstance114_PortMapping: port-prototype=LocationExecutable27Prototype.tpododr, process=LocationProcessDesign27, service-instance=RPortPrototype8_DdsRequiredServiceInstance114
    RPortPrototype3_DdsRequiredServiceInstance113_PortMapping: port-prototype=lidar_terrain_map_detectionExecutable29Prototype.tpfront_right_lidar_points, process=lidar_terrain_map_detectionProcessDesign29, service-instance=RPortPrototype3_DdsRequiredServiceInstance113
    tpfusionloc_DdsProvidedServiceInstance38_PortMapping: port-prototype=LocationExecutable27Prototype.tpfusionloc, process=LocationProcessDesign27, service-instance=tpfusionloc_DdsProvidedServiceInstance38
    RPortPrototype5_DdsRequiredServiceInstance115_PortMapping: port-prototype=lidar_terrain_map_detectionExecutable29Prototype.tplocalization, process=lidar_terrain_map_detectionProcessDesign29, service-instance=RPortPrototype5_DdsRequiredServiceInstance115
    RPortPrototype10_DdsRequiredServiceInstance119_PortMapping: port-prototype=fusion_semantic_map_baseExecutable11Prototype.tpfront_middle_lidar_points, process=fusion_semantic_map_baseProcessDesign11, service-instance=RPortPrototype10_DdsRequiredServiceInstance119
    RPortPrototype12_DdsRequiredServiceInstance120_PortMapping: port-prototype=fusion_semantic_map_baseExecutable11Prototype.tpfront_left_lidar_points, process=fusion_semantic_map_baseProcessDesign11, service-instance=RPortPrototype12_DdsRequiredServiceInstance120
    RPortPrototype13_DdsRequiredServiceInstance121_PortMapping: port-prototype=fusion_semantic_map_baseExecutable11Prototype.tpfront_right_lidar_points, process=fusion_semantic_map_baseProcessDesign11, service-instance=RPortPrototype13_DdsRequiredServiceInstance121
    RPortPrototype14_DdsRequiredServiceInstance122_PortMapping: port-prototype=fusion_semantic_map_baseExecutable11Prototype.tplocalization, process=fusion_semantic_map_baseProcessDesign11, service-instance=RPortPrototype14_DdsRequiredServiceInstance122
    tplidarobjects_DdsProvidedServiceInstance39_PortMapping: port-prototype=LidarDetectionExecutable28Prototype.tplidarobjects, process=LidarDetectionProcessDesign28, service-instance=tplidarobjects_DdsProvidedServiceInstance39
    RPortPrototype4_DdsRequiredServiceInstance116_flidar_PortMapping: port-prototype=fusion_follow_baseExecutable30Prototype.tpfront_middle_lidar_points, process=fusion_follow_baseProcessDesign30, service-instance=RPortPrototype4_DdsRequiredServiceInstance116_flidar
    RPortPrototype6_DdsRequiredServiceInstance118_flidarPortMapping: port-prototype=fusion_follow_baseExecutable30Prototype.tpfront_right_lidar_points, process=fusion_follow_baseProcessDesign30, service-instance=RPortPrototype6_DdsRequiredServiceInstance118_flidar
    RadarPointCloudPPortPrototype_DdsProvidedServiceInstance40_PortMapping: port-prototype=hw_fr671_radarExecutable22Prototype.radarpoints, process=hw_fr671_radarProcessDesign22, service-instance=RadarPointCloudPPortPrototype_DdsProvidedServiceInstance40
    RPortPrototype7_DdsRequiredServiceInstance119_fradar_PortMapping: port-prototype=fusion_follow_baseExecutable30Prototype.tpfront_middle_radar_points, process=fusion_follow_baseProcessDesign30, service-instance=RPortPrototype7_DdsRequiredServiceInstance119_fradar
    RadarPointCloudPPortPrototype_DdsProvidedServiceInstance41_PortMapping: port-prototype=hw_fr671_radarExecutable20Prototype.radarpoints, process=hw_fr671_radarProcessDesign20, service-instance=RadarPointCloudPPortPrototype_DdsProvidedServiceInstance41
    RPortPrototype8_DdsRequiredServiceInstance120_lradarPortMapping: port-prototype=fusion_follow_baseExecutable30Prototype.tpfront_left_radar_points, process=fusion_follow_baseProcessDesign30, service-instance=RPortPrototype8_DdsRequiredServiceInstance120_lradar
    RadarPointCloudPPortPrototype_DdsProvidedServiceInstance42_PortMapping: port-prototype=hw_fr671_radarExecutable21Prototype.radarpoints, process=hw_fr671_radarProcessDesign21, service-instance=RadarPointCloudPPortPrototype_DdsProvidedServiceInstance42
    RPortPrototype9_DdsRequiredServiceInstance121_PortMapping: port-prototype=fusion_follow_baseExecutable30Prototype.tpfront_right_radar_points, process=fusion_follow_baseProcessDesign30, service-instance=RPortPrototype9_DdsRequiredServiceInstance121
    RPortPrototype10_DdsRequiredServiceInstance122_PortMapping: port-prototype=fusion_follow_baseExecutable30Prototype.tplocalization, process=fusion_follow_baseProcessDesign30, service-instance=RPortPrototype10_DdsRequiredServiceInstance122
    tptarget_obj_DdsProvidedServiceInstance38_PortMapping: port-prototype=fusion_follow_baseExecutable30Prototype.tptarget_obj, process=fusion_follow_baseProcessDesign30, service-instance=tptarget_obj_DdsProvidedServiceInstance38
    RPortPrototype8_DdsRequiredServiceInstance129_PortMapping: port-prototype=ControlExecutable16Prototype.tpfusionloc, process=ControlProcessDesign16, service-instance=RPortPrototype8_DdsRequiredServiceInstance129
    RPortPrototype4_DdsRequiredServiceInstance139_PortMapping: port-prototype=mid_track_chassis_sendExecutable19Prototype.tpfault_data, process=mid_track_chassis_sendProcessDesign19, service-instance=RPortPrototype4_DdsRequiredServiceInstance139
    video_encoded_frame_DdsProvidedServiceInstance49_PortMapping: port-prototype=xh265_encoderExecutable19Prototype.video_encoded_frame, process=xh265_encoderProcessDesign19, service-instance=video_encoded_frame_DdsProvidedServiceInstance49
    RPortPrototype2_DdsRequiredServiceInstance158_PortMapping: port-prototype=rtspserverswcExecutable24Prototype.video_encoded_frame, process=rtspserverswcProcessDesign24, service-instance=RPortPrototype2_DdsRequiredServiceInstance158
    RPortPrototype1_DdsRequiredServiceInstance159_PortMapping: port-prototype=xh265_recorderExecutable42Prototype.video_encoded_frame, process=xh265_recorderProcessDesign42, service-instance=RPortPrototype1_DdsRequiredServiceInstance159
    RPortPrototype6_DdsRequiredServiceInstance160_PortMapping: port-prototype=xh265_rtp_pusherExecutable14Prototype.video_encoded_frame, process=xh265_rtp_pusherProcessDesign14, service-instance=RPortPrototype6_DdsRequiredServiceInstance160
    RPortPrototype1_DdsRequiredServiceInstance156_PortMapping: port-prototype=xvehicle_status_recorder_baseExecutable47Prototype.tpappremotecmd, process=xvehicle_status_recorder_baseProcessDesign47, service-instance=RPortPrototype1_DdsRequiredServiceInstance156
    RPortPrototype5_DdsRequiredServiceInstance160_PortMapping: port-prototype=xvehicle_status_recorder_baseExecutable47Prototype.tpvehicle_to_can_pre_aeb, process=xvehicle_status_recorder_baseProcessDesign47, service-instance=RPortPrototype5_DdsRequiredServiceInstance160
    RPortPrototype6_DdsRequiredServiceInstance161_PortMapping: port-prototype=xvehicle_status_recorder_baseExecutable47Prototype.tpfusionloc, process=xvehicle_status_recorder_baseProcessDesign47, service-instance=RPortPrototype6_DdsRequiredServiceInstance161
    RPortPrototype8_DdsRequiredServiceInstance162_PortMapping: port-prototype=xvehicle_status_recorder_baseExecutable47Prototype.ivsensorgps, process=xvehicle_status_recorder_baseProcessDesign47, service-instance=RPortPrototype8_DdsRequiredServiceInstance162
    RPortPrototype9_DdsRequiredServiceInstance163_PortMapping: port-prototype=xvehicle_status_recorder_baseExecutable47Prototype.tpvehiclestate, process=xvehicle_status_recorder_baseProcessDesign47, service-instance=RPortPrototype9_DdsRequiredServiceInstance163
    RPortPrototype10_DdsRequiredServiceInstance164_PortMapping: port-prototype=xvehicle_status_recorder_baseExecutable47Prototype.tpfault_data, process=xvehicle_status_recorder_baseProcessDesign47, service-instance=RPortPrototype10_DdsRequiredServiceInstance164
    RPortPrototype11_DdsRequiredServiceInstance171_PortMapping: port-prototype=xvehicle_status_recorder_baseExecutable47Prototype.image_list, process=xvehicle_status_recorder_baseProcessDesign47, service-instance=RPortPrototype11_DdsRequiredServiceInstance171
    RPortPrototype10_DdsRequiredServiceInstance172_PortMapping: port-prototype=fusion_semantic_map_baseExecutable11Prototype.tpfront_middle_lidar_points, process=fusion_semantic_map_baseProcessDesign11, service-instance=RPortPrototype10_DdsRequiredServiceInstance172
    RPortPrototype12_DdsRequiredServiceInstance173_PortMapping: port-prototype=fusion_semantic_map_baseExecutable11Prototype.tpfront_left_lidar_points, process=fusion_semantic_map_baseProcessDesign11, service-instance=RPortPrototype12_DdsRequiredServiceInstance173
    RPortPrototype13_DdsRequiredServiceInstance174_PortMapping: port-prototype=fusion_semantic_map_baseExecutable11Prototype.tpfront_right_lidar_points, process=fusion_semantic_map_baseProcessDesign11, service-instance=RPortPrototype13_DdsRequiredServiceInstance174
    RPortPrototype4_DdsRequiredServiceInstance175_PortMapping: port-prototype=fusion_follow_baseExecutable30Prototype.tpfront_middle_lidar_points, process=fusion_follow_baseProcessDesign30, service-instance=RPortPrototype4_DdsRequiredServiceInstance175
    RPortPrototype5_DdsRequiredServiceInstance176_PortMapping: port-prototype=fusion_follow_baseExecutable30Prototype.tpfront_left_lidar_points, process=fusion_follow_baseProcessDesign30, service-instance=RPortPrototype5_DdsRequiredServiceInstance176
    RPortPrototype6_DdsRequiredServiceInstance177_PortMapping: port-prototype=fusion_follow_baseExecutable30Prototype.tpfront_right_lidar_points, process=fusion_follow_baseProcessDesign30, service-instance=RPortPrototype6_DdsRequiredServiceInstance177
    lidarpointsfront_DdsRequiredServiceInstance178_PortMapping: port-prototype=fusion_follow_baseExecutable30Prototype.tpfront_middle_lidar_points, process=fusion_follow_baseProcessDesign30, service-instance=lidarpointsfront_DdsRequiredServiceInstance178
    lidarpointsleft_DdsRequiredServiceInstance179_PortMapping: port-prototype=fusion_follow_baseExecutable30Prototype.tpfront_left_lidar_points, process=fusion_follow_baseProcessDesign30, service-instance=lidarpointsleft_DdsRequiredServiceInstance179
    lidarpointsright_DdsRequiredServiceInstance180_PortMapping: port-prototype=fusion_follow_baseExecutable30Prototype.tpfront_right_lidar_points, process=fusion_follow_baseProcessDesign30, service-instance=lidarpointsright_DdsRequiredServiceInstance180
    radarpointsfront_DdsRequiredServiceInstance181_PortMapping: port-prototype=fusion_follow_baseExecutable30Prototype.tpfront_middle_radar_points, process=fusion_follow_baseProcessDesign30, service-instance=radarpointsfront_DdsRequiredServiceInstance181
    radarpointsleft_DdsRequiredServiceInstance182_PortMapping: port-prototype=fusion_follow_baseExecutable30Prototype.tpfront_left_radar_points, process=fusion_follow_baseProcessDesign30, service-instance=radarpointsleft_DdsRequiredServiceInstance182
    radarpointsright_DdsRequiredServiceInstance183_PortMapping: port-prototype=fusion_follow_baseExecutable30Prototype.tpfront_right_radar_points, process=fusion_follow_baseProcessDesign30, service-instance=radarpointsright_DdsRequiredServiceInstance183
    ivwheelspeed_DdsRequiredServiceInstance184_PortMapping: port-prototype=LocationExecutable27Prototype.tpwheelspeed, process=LocationProcessDesign27, service-instance=ivwheelspeed_DdsRequiredServiceInstance184
    tpimu_DdsRequiredServiceInstance185_PortMapping: port-prototype=LocationExecutable27Prototype.tpimu, process=LocationProcessDesign27, service-instance=tpimu_DdsRequiredServiceInstance185
    ivwheelspeed_DdsRequiredServiceInstance186_PortMapping: port-prototype=LocationExecutable27Prototype.tpwheelspeed, process=LocationProcessDesign27, service-instance=ivwheelspeed_DdsRequiredServiceInstance186
    lidarpointsright_DdsRequiredServiceInstance189_PortMapping: port-prototype=lidar_terrain_map_detectionExecutable29Prototype.tpfront_right_lidar_points, process=lidar_terrain_map_detectionProcessDesign29, service-instance=lidarpointsright_DdsRequiredServiceInstance189
    radarpointsfront_DdsRequiredServiceInstance190_PortMapping: port-prototype=fusion_follow_baseExecutable30Prototype.tpfront_middle_radar_points, process=fusion_follow_baseProcessDesign30, service-instance=radarpointsfront_DdsRequiredServiceInstance190
    radarpointsfront_DdsRequiredServiceInstance191_PortMapping: port-prototype=fusion_follow_baseExecutable30Prototype.tpfront_middle_radar_points, process=fusion_follow_baseProcessDesign30, service-instance=radarpointsfront_DdsRequiredServiceInstance191
    radarpointsright_DdsRequiredServiceInstance192_PortMapping: port-prototype=fusion_follow_baseExecutable30Prototype.tpfront_right_radar_points, process=fusion_follow_baseProcessDesign30, service-instance=radarpointsright_DdsRequiredServiceInstance192
    radarpointsleft_DdsRequiredServiceInstance193_PortMapping: port-prototype=fusion_follow_baseExecutable30Prototype.tpfront_left_radar_points, process=fusion_follow_baseProcessDesign30, service-instance=radarpointsleft_DdsRequiredServiceInstance193
    radarpointsright_DdsRequiredServiceInstance194_PortMapping: port-prototype=fusion_follow_baseExecutable30Prototype.tpfront_right_radar_points, process=fusion_follow_baseProcessDesign30, service-instance=radarpointsright_DdsRequiredServiceInstance194
    radarpointsfront_DdsRequiredServiceInstance195_PortMapping: port-prototype=fusion_follow_baseExecutable30Prototype.tpfront_middle_radar_points, process=fusion_follow_baseProcessDesign30, service-instance=radarpointsfront_DdsRequiredServiceInstance195
    radarpointsleft_DdsRequiredServiceInstance196_PortMapping: port-prototype=fusion_follow_baseExecutable30Prototype.tpfront_left_radar_points, process=fusion_follow_baseProcessDesign30, service-instance=radarpointsleft_DdsRequiredServiceInstance196
    lidarpointsfront_DdsRequiredServiceInstance197_PortMapping: port-prototype=fusion_semantic_map_baseExecutable11Prototype.tpfront_middle_lidar_points, process=fusion_semantic_map_baseProcessDesign11, service-instance=lidarpointsfront_DdsRequiredServiceInstance197
    lidarpointsleft_DdsRequiredServiceInstance198_PortMapping: port-prototype=fusion_semantic_map_baseExecutable11Prototype.tpfront_left_lidar_points, process=fusion_semantic_map_baseProcessDesign11, service-instance=lidarpointsleft_DdsRequiredServiceInstance198
    lidarpointsright_DdsRequiredServiceInstance199_PortMapping: port-prototype=fusion_semantic_map_baseExecutable11Prototype.tpfront_right_lidar_points, process=fusion_semantic_map_baseProcessDesign11, service-instance=lidarpointsright_DdsRequiredServiceInstance199
    lidarpointsfront_DdsRequiredServiceInstance200_PortMapping: port-prototype=LidarSlamExecutable25Prototype.tpfront_middle_lidar_points, process=LidarSlamProcessDesign25, service-instance=lidarpointsfront_DdsRequiredServiceInstance200
    lidarpointsleft_DdsRequiredServiceInstance201_PortMapping: port-prototype=LidarSlamExecutable25Prototype.tpfront_left_lidar_points, process=LidarSlamProcessDesign25, service-instance=lidarpointsleft_DdsRequiredServiceInstance201
    lidarpointsright_DdsRequiredServiceInstance202_PortMapping: port-prototype=LidarSlamExecutable25Prototype.tpfront_right_lidar_points, process=LidarSlamProcessDesign25, service-instance=lidarpointsright_DdsRequiredServiceInstance202
    RPortPrototype1_DdsRequiredServiceInstance200_PortMapping: port-prototype=hw_fr671_radarExecutable22Prototype.tpvehiclestate1, process=hw_fr671_radarProcessDesign22, service-instance=RPortPrototype1_DdsRequiredServiceInstance200
    RPortPrototype2_DdsRequiredServiceInstance201_PortMapping: port-prototype=hw_fr671_radarExecutable20Prototype.tpvehiclestate2, process=hw_fr671_radarProcessDesign20, service-instance=RPortPrototype2_DdsRequiredServiceInstance201
    RPortPrototype3_DdsRequiredServiceInstance202_PortMapping: port-prototype=hw_fr671_radarExecutable21Prototype.tpvehiclestate3, process=hw_fr671_radarProcessDesign21, service-instance=RPortPrototype3_DdsRequiredServiceInstance202
    RPortPrototype1_DdsRequiredServiceInstance211_PortMapping: port-prototype=fusion_follow_baseExecutable30Prototype.tplidarobjects, process=fusion_follow_baseProcessDesign30, service-instance=RPortPrototype1_DdsRequiredServiceInstance211
    RPortPrototype1_DdsRequiredServiceInstance163_PortMapping: port-prototype=sensor_viualize_baseExecutable38Prototype.tplidarfront, process=sensor_viualize_baseProcessDesign38, service-instance=tplidarfront
    RPortPrototype2_DdsRequiredServiceInstance164_PortMapping: port-prototype=sensor_viualize_baseExecutable38Prototype.tpcameralist, process=sensor_viualize_baseProcessDesign38, service-instance=RPortPrototype2_DdsRequiredServiceInstance164
    compressed_image_list_DdsProvidedServiceInstance41_PortMapping: port-prototype=hw_camera_listExecutable1Prototype.compressed_image_list, process=hw_camera_listProcessDesign1, service-instance=compressed_image_list_DdsProvidedServiceInstance41
    RPortPrototype1_DdsRequiredServiceInstance154_PortMapping: port-prototype=driver_dev_nullExecutable37Prototype.RPortPrototype1, process=driver_dev_nullProcessDesign37, service-instance=RPortPrototype1_DdsRequiredServiceInstance154
    radarpackets_DdsProvidedServiceInstance42_PortMapping: port-prototype=hw_fr671_radarExecutable20Prototype.radarpackets, process=hw_fr671_radarProcessDesign20, service-instance=radarpackets_DdsProvidedServiceInstance42
    RPortPrototype2_DdsRequiredServiceInstance155_PortMapping: port-prototype=driver_dev_nullExecutable37Prototype.RPortPrototype2, process=driver_dev_nullProcessDesign37, service-instance=RPortPrototype2_DdsRequiredServiceInstance155
    radarpackets_DdsProvidedServiceInstance43_PortMapping: port-prototype=hw_fr671_radarExecutable21Prototype.radarpackets, process=hw_fr671_radarProcessDesign21, service-instance=radarpackets_DdsProvidedServiceInstance43
    radarpackets_DdsProvidedServiceInstance44_PortMapping: port-prototype=hw_fr671_radarExecutable22Prototype.radarpackets, process=hw_fr671_radarProcessDesign22, service-instance=radarpackets_DdsProvidedServiceInstance44
    lidarpackets_DdsProvidedServiceInstance45_PortMapping: port-prototype=hw_l106_lidarExecutable4Prototype.lidarpackets, process=hw_l106_lidarProcessDesign4, service-instance=lidarpackets_DdsProvidedServiceInstance45
    RPortPrototype5_DdsRequiredServiceInstance158_PortMapping: port-prototype=driver_dev_nullExecutable37Prototype.RPortPrototype5, process=driver_dev_nullProcessDesign37, service-instance=RPortPrototype5_DdsRequiredServiceInstance158
    lidarpackets_DdsProvidedServiceInstance46_PortMapping: port-prototype=hw_l106_lidarExecutable5Prototype.lidarpackets, process=hw_l106_lidarProcessDesign5, service-instance=lidarpackets_DdsProvidedServiceInstance46
    RPortPrototype6_DdsRequiredServiceInstance159_PortMapping: port-prototype=driver_dev_nullExecutable37Prototype.RPortPrototype6, process=driver_dev_nullProcessDesign37, service-instance=RPortPrototype6_DdsRequiredServiceInstance159
    lidarpackets_DdsProvidedServiceInstance47_PortMapping: port-prototype=hw_l106_lidarExecutable3Prototype.lidarpackets, process=hw_l106_lidarProcessDesign3, service-instance=lidarpackets_DdsProvidedServiceInstance47
    RPortPrototype7_DdsRequiredServiceInstance160_PortMapping: port-prototype=driver_dev_nullExecutable37Prototype.RPortPrototype7, process=driver_dev_nullProcessDesign37, service-instance=RPortPrototype7_DdsRequiredServiceInstance160
    RPortPrototype2_DdsRequiredServiceInstance124_PortMapping: port-prototype=multy_camera_det_baseExecutable34Prototype.tpimage_list, process=multy_camera_det_baseProcessDesign34, service-instance=RPortPrototype2_DdsRequiredServiceInstance124
    tpperception_vp_result_DdsProvidedServiceInstance38_PortMapping: port-prototype=multy_camera_det_baseExecutable34Prototype.tpperception_vp_result, process=multy_camera_det_baseProcessDesign34, service-instance=tpperception_vp_result_DdsProvidedServiceInstance38
    RPortPrototype1_DdsRequiredServiceInstance125_PortMapping: port-prototype=fusion_follow_baseExecutable30Prototype.tpperception_vp_result, process=fusion_follow_baseProcessDesign30, service-instance=RPortPrototype1_DdsRequiredServiceInstance125
    tpterrainmap_DdsProvidedServiceInstance31_PortMapping: port-prototype=lidar_terrain_map_detectionExecutable29Prototype.tpterrainmap, process=lidar_terrain_map_detectionProcessDesign29, service-instance=tpterrainmap_DdsProvidedServiceInstance31
    RPortPrototype2_DdsRequiredServiceInstance106_PortMapping: port-prototype=PlanningExecutable31Prototype.tptarget_obj, process=PlanningProcessDesign31, service-instance=RPortPrototype2_DdsRequiredServiceInstance106
    RPortPrototype3_DdsRequiredServiceInstance107_PortMapping: port-prototype=PlanningExecutable31Prototype.tpterrainmap, process=PlanningProcessDesign31, service-instance=RPortPrototype3_DdsRequiredServiceInstance107
    tppathplan_track_DdsProvidedServiceInstance32_PortMapping: port-prototype=PlanningExecutable31Prototype.tppathplan_track, process=PlanningProcessDesign31, service-instance=tppathplan_track_DdsProvidedServiceInstance32
    RPortPrototype2_DdsRequiredServiceInstance108_PortMapping: port-prototype=ControlExecutable16Prototype.tppathplan_recv, process=ControlProcessDesign16, service-instance=requiredInstances/RPortPrototype2_DdsRequiredServiceInstance108
    tpfront_middle_lidar_points_DdsRequiredServiceInstance109_PortMapping: port-prototype=LidarSlamExecutable25Prototype.tpfront_middle_lidar_points, process=LidarSlamProcessDesign25, service-instance=tpfront_middle_lidar_points_DdsRequiredServiceInstance109
    RPortPrototype1_DdsRequiredServiceInstance110_PortMapping: port-prototype=sensor_viualize_baseExecutable38Prototype.RPortPrototype1, process=sensor_viualize_baseProcessDesign38, service-instance=requiredInstances/RPortPrototype1_DdsRequiredServiceInstance110
    tppathplan_recv_DdsRequiredServiceInstance111_PortMapping: port-prototype=ControlExecutable16Prototype.tppathplan_recv, process=ControlProcessDesign16, service-instance=tppathplan_recv_DdsRequiredServiceInstance111
    RPortPrototype2_DdsRequiredServiceInstance113_PortMapping: port-prototype=PlanningExecutable31Prototype.tpfusionloc, process=PlanningProcessDesign31, service-instance=RPortPrototype2_DdsRequiredServiceInstance113
    RPortPrototype1_DdsRequiredServiceInstance110_PortMapping: port-prototype=lidar_terrain_map_detectionExecutable29Prototype.tpfront_middle_lidar_points, process=lidar_terrain_map_detectionProcessDesign29, service-instance=requiredInstances/RPortPrototype1_DdsRequiredServiceInstance110
    RPortPrototype1_DdsRequiredServiceInstance111_PortMapping: port-prototype=lidar_terrain_map_detectionExecutable29Prototype.tpfront_left_lidar_points, process=lidar_terrain_map_detectionProcessDesign29, service-instance=RPortPrototype1_DdsRequiredServiceInstance111
    RPortPrototype2_DdsRequiredServiceInstance112_PortMapping: port-prototype=PlanningExecutable31Prototype.tpvehiclestate4, process=PlanningProcessDesign31, service-instance=requiredInstances/RPortPrototype2_DdsRequiredServiceInstance112
package /HuaweiMDC/Common/Common
  composition sw component type hw_camera_listCompositionSwComponentType1
    component hw_camera_listPrototype: type=hw_camera_list
  composition sw component type hw_l106_lidarCompositionSwComponentType3
    component hw_l106_lidarPrototype: type=hw_l106_lidar
  composition sw component type hw_l106_lidarCompositionSwComponentType4
    component hw_l106_lidarPrototype: type=hw_l106_lidar
  composition sw component type hw_l106_lidarCompositionSwComponentType5
    component hw_l106_lidarPrototype: type=hw_l106_lidar
  composition sw component type bd21_imuCompositionSwComponentType6
    component bd21_imuPrototype: type=bd21_imu
  composition sw component type mid_track_chassis_recvCompositionSwComponentType7
    component mid_track_chassis_recvPrototype: type=mid_track_chassis_recv
  composition sw component type fusion_semantic_map_baseCompositionSwComponentType11
    component fusion_semantic_map_basePrototype: type=fusion_semantic_map_base
  composition sw component type xh265_rtp_pusherCompositionSwComponentType14
    component xh265_rtp_pusherPrototype: type=xh265_rtp_pusher
  composition sw component type ControlCompositionSwComponentType16
    component ControlPrototype: type=control_base
  composition sw component type mid_track_chassis_sendCompositionSwComponentType19
    component mid_track_chassis_sendPrototype: type=mid_track_chassis_send
  composition sw component type xzmq_rcCompositionSwComponentType19
    component xzmq_rcPrototype: type=xzmq_rc
  composition sw component type xh265_encoderCompositionSwComponentType19
    component xh265_encoderPrototype: type=xh265_encoder
  composition sw component type hw_fr671_radarCompositionSwComponentType20
    component hw_fr671_radarPrototype: type=hw_fr671_radar
  composition sw component type hw_fr671_radarCompositionSwComponentType21
    component hw_fr671_radarPrototype: type=hw_fr671_radar
  composition sw component type hw_fr671_radarCompositionSwComponentType22
    component hw_fr671_radarPrototype: type=hw_fr671_radar
  composition sw component type rtspserverswcCompositionSwComponentType24
    component rtspserverswcPrototype: type=rtspserverswc
  composition sw component type LidarSlamCompositionSwComponentType25
    component LidarSlamPrototype: type=lidar_slam_base
  composition sw component type OdometryCompositionSwComponentType26
    component OdometryPrototype: type=odometry_base
  composition sw component type LocationCompositionSwComponentType27
    component LocationPrototype: type=fusion_location_base
  composition sw component type LidarDetectionCompositionSwComponentType28
    component LidarDetectionPrototype: type=lidar_det_base
  composition sw component type lidar_terrain_map_detectionCompositionSwComponentType29
    component lidar_terrain_map_detectionPrototype: type=lidar_terrain_map_detection
  composition sw component type fusion_follow_baseCompositionSwComponentType30
    component fusion_follow_basePrototype: type=fusion_follow_base
  composition sw component type xh265_recorderCompositionSwComponentType42
    component xh265_recorderPrototype: type=xh265_recorder
  composition sw component type xfault_handler_baseCompositionSwComponentType43
    component xfault_handler_basePrototype: type=xfault_handler_base
  composition sw component type xdata_trigger_recorder_baseCompositionSwComponentType46
    component xdata_trigger_recorder_basePrototype: type=xdata_trigger_recorder_base
  composition sw component type xvehicle_status_recorder_baseCompositionSwComponentType47
    component xvehicle_status_recorder_basePrototype: type=xvehicle_status_recorder_base
  composition sw component type sensor_viualize_baseCompositionSwComponentType38
    component sensor_viualize_basePrototype: type=sensor_viualize_base
  composition sw component type driver_dev_nullCompositionSwComponentType37
    component driver_dev_nullPrototype: type=driver_dev_null
  composition sw component type multy_camera_det_baseCompositionSwComponentType34
    component multy_camera_det_basePrototype: type=multy_camera_det_base
  composition sw component type PlanningCompositionSwComponentType31
    component PlanningPrototype: type=planning_base
package /HuaweiMDC/instance_manifests/providedInstances
  32 x dds provided service instance, all with qos-profile=default_qos.xml, domain-id=30, transport-plugins=SHM:
    ImageListPPortPrototype_DdsProvidedServiceInstance1: service-interface-deployment=SensorImageListServiceInterface_DdsDeployment, dds-event-qos-props=EventImageListDdsDeployment, service-instance-id=20200
    PointCloudPPortPrototype_DdsProvidedServiceInstance2: service-interface-deployment=SensorLidarPointCloudServiceInterface_DdsDeployment, dds-event-qos-props=EventPointCloud2DdsDeployment, service-instance-id=20201
    PointCloudPPortPrototype_DdsProvidedServiceInstance3: service-interface-deployment=SensorLidarPointCloudServiceInterface_DdsDeployment, dds-event-qos-props=EventPointCloud2DdsDeployment, service-instance-id=20202
    PointCloudPPortPrototype_DdsProvidedServiceInstance4: service-interface-deployment=SensorLidarPointCloudServiceInterface_DdsDeployment, dds-event-qos-props=EventPointCloud2DdsDeployment, service-instance-id=20203
    VehicleInfoPPortPrototype_DdsProvidedServiceInstance6: service-interface-deployment=VehicleInfomationServiceInterface_DdsDeployment, dds-event-qos-props=EventVehicleInfoDdsDeployment, service-instance-id=20205
    ZmqRRemoteControlPPortPrototype_DdsProvidedServiceInstance26: service-interface-deployment=RemoteControlServiceInterface_DdsDeployment, dds-event-qos-props=EventRCAppRemoteCtlDdsDeployment, service-instance-id=20213
    WheelSpeedPPortPrototype_DdsProvidedServiceInstance23: service-interface-deployment=SensorWheelSpeedServiceInterface_DdsDeployment, dds-event-qos-props=EventWheelSpeedDdsDeployment, service-instance-id=20204
    ImuPPortPrototype_DdsProvidedServiceInstance25: service-interface-deployment=SensorImuServiceInterface_DdsDeployment, dds-event-qos-props=EventSensorImuDdsDeployment, service-instance-id=20223
    bag_ondemand_status_DdsProvidedServiceInstance25: service-interface-deployment=BagStatusServiceInterface_DdsDeployment, dds-event-qos-props=EventBagStatusDdsDeployment, service-instance-id=20216
    tpfault_data_DdsProvidedServiceInstance27: service-interface-deployment=FaultDataServiceInterface_DdsDeployment, dds-event-qos-props=EventFaultDataDdsDeployment, service-instance-id=20220
    tpimu_DdsProvidedServiceInstance30: service-interface-deployment=LocationDdsInterfaceDeployment, dds-event-qos-props=LocationEventDeployment, service-instance-id=20229
    tpvehicle_to_can_pre_aeb_DdsProvidedServiceInstance39: service-interface-deployment=BodyCommandServiceInterface_DdsDeployment, dds-event-qos-props=EventVehicleActControlDdsDeployment, service-instance-id=20211
    ivsensorgps_DdsProvidedServiceInstance45: service-interface-deployment=SensorGpsServiceInterface_DdsDeployment, dds-event-qos-props=EventGpsDdsDeployment, service-instance-id=20244
    tpliodr_DdsProvidedServiceInstance36: service-interface-deployment=LocationInfoDdsInterfaceDeployment, dds-event-qos-props=LocationInfoEventDeployment, service-instance-id=20206
    tpododr_DdsProvidedServiceInstance37: service-interface-deployment=LocationInfoDdsInterfaceDeployment, dds-event-qos-props=LocationInfoEventDeployment, service-instance-id=20209
    tpfusionloc_DdsProvidedServiceInstance38: service-interface-deployment=LocationInfoDdsInterfaceDeployment, dds-event-qos-props=LocationInfoEventDeployment, service-instance-id=20218
    tplidarobjects_DdsProvidedServiceInstance39: service-interface-deployment=Object3dArrayDdsInterfaceDeployment, dds-event-qos-props=Object3dArrayEventDeployment, service-instance-id=20222
    RadarPointCloudPPortPrototype_DdsProvidedServiceInstance40: service-interface-deployment=RadarPointCloudServiceInterface_DdsDeployment, dds-event-qos-props=EventRadarPointCloudDdsDeployment, service-instance-id=20224
    RadarPointCloudPPortPrototype_DdsProvidedServiceInstance41: service-interface-deployment=RadarPointCloudServiceInterface_DdsDeployment, dds-event-qos-props=EventRadarPointCloudDdsDeployment, service-instance-id=20225
    RadarPointCloudPPortPrototype_DdsProvidedServiceInstance42: service-interface-deployment=RadarPointCloudServiceInterface_DdsDeployment, dds-event-qos-props=EventRadarPointCloudDdsDeployment, service-instance-id=20226
    tptarget_obj_DdsProvidedServiceInstance38: service-interface-deployment=FusionObjectArrayDdsInterfaceDeployment, dds-event-qos-props=FusionObjectArrayEventDeployment, service-instance-id=20228
    video_encoded_frame_DdsProvidedServiceInstance49: service-interface-deployment=SensorImageServiceInterface_DdsDeployment, dds-event-qos-props=EventSensorImageDdsDeployment, service-instance-id=20247
    compressed_image_list_DdsProvidedServiceInstance41: service-interface-deployment=SensorCompressedImageListServiceInterface_DdsDeployment, dds-event-qos-props=EventCompressedImageListDdsDeployment, service-instance-id=20210
    radarpackets_DdsProvidedServiceInstance42: service-interface-deployment=SensorRadarPacketServiceInterface_DdsDeployment, dds-event-qos-props=EventSensorRadarPacketDdsDeployment, service-instance-id=20219
    radarpackets_DdsProvidedServiceInstance43: service-interface-deployment=SensorRadarPacketServiceInterface_DdsDeployment, dds-event-qos-props=EventSensorRadarPacketDdsDeployment, service-instance-id=20227
    radarpackets_DdsProvidedServiceInstance44: service-interface-deployment=SensorRadarPacketServiceInterface_DdsDeployment, dds-event-qos-props=EventSensorRadarPacketDdsDeployment, service-instance-id=20230
    lidarpackets_DdsProvidedServiceInstance45: service-interface-deployment=SensorLidarPacketServiceInterface_DdsDeployment, dds-event-qos-props=EventLidarPacketDdsDeployment, service-instance-id=20231
    lidarpackets_DdsProvidedServiceInstance46: service-interface-deployment=SensorLidarPacketServiceInterface_DdsDeployment, dds-event-qos-props=EventLidarPacketDdsDeployment, service-instance-id=20232
    lidarpackets_DdsProvidedServiceInstance47: service-interface-deployment=SensorLidarPacketServiceInterface_DdsDeployment, dds-event-qos-props=EventLidarPacketDdsDeployment, service-instance-id=20234
    tpperception_vp_result_DdsProvidedServiceInstance38: service-interface-deployment=VisionSegmentServiceInterface_DdsDeployment, dds-event-qos-props=EventVisionSegmentDdsDeployment, service-instance-id=20207
    tpterrainmap_DdsProvidedServiceInstance31: service-interface-deployment=PerceptionStaticEnvServiceInterface_DdsDeployment, dds-event-qos-props=EventPerceptionStaticEnvDdsDeployment, service-instance-id=20208
    tppathplan_track_DdsProvidedServiceInstance32: service-interface-deployment=PlanningResultDdsInterfaceDeployment, dds-event-qos-props=PlanningResultEventDeployment, service-instance-id=20212
package /HuaweiMDC/instance_manifests/instanceToMachineMappings
  131 x dds service instance to machine mapping, all with communication-connector=Host0DpEthernetCommConnector:
    ImageListPPortPrototype_DdsProvidedServiceInstance1_ToDdsMachineMapping: service-instance=ImageListPPortPrototype_DdsProvidedServiceInstance1
    PointCloudPPortPrototype_DdsProvidedServiceInstance{2..4}_ToDdsMachineMapping: service-instance=PointCloudPPortPrototype_DdsProvidedServiceInstance{2..4}
    VehicleInfoPPortPrototype_DdsProvidedServiceInstance6_ToDdsMachineMapping: service-instance=VehicleInfoPPortPrototype_DdsProvidedServiceInstance6
    RPortPrototype2_DdsRequiredServiceInstance14_ToDdsMachineMapping: service-instance=RPortPrototype2_DdsRequiredServiceInstance14
    ZmqRRemoteControlPPortPrototype_DdsProvidedServiceInstance26_ToDdsMachineMapping: service-instance=ZmqRRemoteControlPPortPrototype_DdsProvidedServiceInstance26
    WheelSpeedPPortPrototype_DdsProvidedServiceInstance23_ToDdsMachineMapping: service-instance=WheelSpeedPPortPrototype_DdsProvidedServiceInstance23
    ImuPPortPrototype_DdsProvidedServiceInstance25_ToDdsMachineMapping: service-instance=ImuPPortPrototype_DdsProvidedServiceInstance25
    RPortPrototype1_DdsRequiredServiceInstance40_ToDdsMachineMapping: service-instance=RPortPrototype1_DdsRequiredServiceInstance40
    RPortPrototype2_DdsRequiredServiceInstance41_ToDdsMachineMapping: service-instance=RPortPrototype2_DdsRequiredServiceInstance41
    bag_ondemand_status_DdsProvidedServiceInstance25_ToDdsMachineMapping: service-instance=bag_ondemand_status_DdsProvidedServiceInstance25
    tpfault_data_DdsProvidedServiceInstance27_ToDdsMachineMapping: service-instance=tpfault_data_DdsProvidedServiceInstance27
    tpimu_DdsProvidedServiceInstance30_ToDdsMachineMapping: service-instance=tpimu_DdsProvidedServiceInstance30
    RPortPrototype1_DdsRequiredServiceInstance53_ToDdsMachineMapping: service-instance=RPortPrototype1_DdsRequiredServiceInstance53
    RPortPrototype3_DdsRequiredServiceInstance97_ToDdsMachineMapping: service-instance=RPortPrototype3_DdsRequiredServiceInstance97
    tpvehicle_to_can_pre_aeb_DdsProvidedServiceInstance39_ToDdsMachineMapping: service-instance=tpvehicle_to_can_pre_aeb_DdsProvidedServiceInstance39
    ivsensorgps_DdsProvidedServiceInstance45_ToDdsMachineMapping: service-instance=ivsensorgps_DdsProvidedServiceInstance45
    RPortPrototype2_DdsRequiredServiceInstance154_ToDdsMachineMapping: service-instance=RPortPrototype2_DdsRequiredServiceInstance154
    RPortPrototype2_DdsRequiredServiceInstance167_ToDdsMachineMapping: service-instance=RPortPrototype2_DdsRequiredServiceInstance167
    RPortPrototype2_DdsRequiredServiceInstance105_ToDdsMachineMapping: service-instance=RPortPrototype2_DdsRequiredServiceInstance105
    RPortPrototype4_DdsRequiredServiceInstance107_ToDdsMachineMapping: service-instance=RPortPrototype4_DdsRequiredServiceInstance107
    RPortPrototype6_DdsRequiredServiceInstance109_ToDdsMachineMapping: service-instance=RPortPrototype6_DdsRequiredServiceInstance109
    RPortPrototype3_DdsRequiredServiceInstance110_ToDdsMachineMapping: service-instance=RPortPrototype3_DdsRequiredServiceInstance110
    RPortPrototype4_DdsRequiredServiceInstance111_ToDdsMachineMapping: service-instance=RPortPrototype4_DdsRequiredServiceInstance111
    RPortPrototype1_DdsRequiredServiceInstance107_ToDdsMachineMapping: service-instance=requiredInstances/RPortPrototype1_DdsRequiredServiceInstance107
    RPortPrototype3_DdsRequiredServiceInstance109_ToDdsMachineMapping: service-instance=requiredInstances/RPortPrototype3_DdsRequiredServiceInstance109
    RPortPrototype4_DdsRequiredServiceInstance110_ToDdsMachineMapping: service-instance=requiredInstances/RPortPrototype4_DdsRequiredServiceInstance110
    RPortPrototype5_DdsRequiredServiceInstance111_wspeedToDdsMachineMapping: service-instance=RPortPrototype5_DdsRequiredServiceInstance111_wspeed
    RPortPrototype1_DdsRequiredServiceInstance107_ToDdsMachineMapping: service-instance=requiredInstances/RPortPrototype1_DdsRequiredServiceInstance107
    RPortPrototype3_DdsRequiredServiceInstance109_ToDdsMachineMapping: service-instance=requiredInstances/RPortPrototype3_DdsRequiredServiceInstance109
    RPortPrototype4_DdsRequiredServiceInstance110_ToDdsMachineMapping: service-instance=requiredInstances/RPortPrototype4_DdsRequiredServiceInstance110
    RPortPrototype5_DdsRequiredServiceInstance111_ToDdsMachineMapping: service-instance=RPortPrototype5_DdsRequiredServiceInstance111
    RPortPrototype6_DdsRequiredServiceInstance112_ToDdsMachineMapping: service-instance=RPortPrototype6_DdsRequiredServiceInstance112
    tpliodr_DdsProvidedServiceInstance36_ToDdsMachineMapping: service-instance=tpliodr_DdsProvidedServiceInstance36
    RPortPrototype7_DdsRequiredServiceInstance113_ToDdsMachineMapping: service-instance=RPortPrototype7_DdsRequiredServiceInstance113
    tpododr_DdsProvidedServiceInstance37_ToDdsMachineMapping: service-instance=tpododr_DdsProvidedServiceInstance37
    RPortPrototype8_DdsRequiredServiceInstance114_ToDdsMachineMapping: service-instance=RPortPrototype8_DdsRequiredServiceInstance114
    RPortPrototype3_DdsRequiredServiceInstance113_ToDdsMachineMapping: service-instance=RPortPrototype3_DdsRequiredServiceInstance113
    tpfusionloc_DdsProvidedServiceInstance38_ToDdsMachineMapping: service-instance=tpfusionloc_DdsProvidedServiceInstance38
    RPortPrototype5_DdsRequiredServiceInstance115_ToDdsMachineMapping: service-instance=RPortPrototype5_DdsRequiredServiceInstance115
    RPortPrototype10_DdsRequiredServiceInstance119_ToDdsMachineMapping: service-instance=RPortPrototype10_DdsRequiredServiceInstance119
    RPortPrototype12_DdsRequiredServiceInstance120_ToDdsMachineMapping: service-instance=RPortPrototype12_DdsRequiredServiceInstance120
    RPortPrototype13_DdsRequiredServiceInstance121_ToDdsMachineMapping: service-instance=RPortPrototype13_DdsRequiredServiceInstance121
    RPortPrototype14_DdsRequiredServiceInstance122_ToDdsMachineMapping: service-instance=RPortPrototype14_DdsRequiredServiceInstance122
    tplidarobjects_DdsProvidedServiceInstance39_ToDdsMachineMapping: service-instance=tplidarobjects_DdsProvidedServiceInstance39
    RadarPointCloudPPortPrototype_DdsProvidedServiceInstance40_ToDdsMachineMapping: service-instance=RadarPointCloudPPortPrototype_DdsProvidedServiceInstance40
    RPortPrototype7_DdsRequiredServiceInstance119_fradar_ToDdsMachineMapping: service-instance=RPortPrototype7_DdsRequiredServiceInstance119_fradar
    RadarPointCloudPPortPrototype_DdsProvidedServiceInstance41_ToDdsMachineMapping: service-instance=RadarPointCloudPPortPrototype_DdsProvidedServiceInstance41
    RPortPrototype8_DdsRequiredServiceInstance120_lradarToDdsMachineMapping: service-instance=RPortPrototype8_DdsRequiredServiceInstance120_lradar
    RadarPointCloudPPortPrototype_DdsProvidedServiceInstance42_ToDdsMachineMapping: service-instance=RadarPointCloudPPortPrototype_DdsProvidedServiceInstance42
    RPortPrototype9_DdsRequiredServiceInstance121_ToDdsMachineMapping: service-instance=RPortPrototype9_DdsRequiredServiceInstance121
    RPortPrototype10_DdsRequiredServiceInstance122_ToDdsMachineMapping: service-instance=RPortPrototype10_DdsRequiredServiceInstance122
    RPortPrototype4_DdsRequiredServiceInstance116_flidar_ToDdsMachineMapping: service-instance=RPortPrototype4_DdsRequiredServiceInstance116_flidar
    tptarget_obj_DdsProvidedServiceInstance38_ToDdsMachineMapping: service-instance=tptarget_obj_DdsProvidedServiceInstance38
    RPortPrototype6_DdsRequiredServiceInstance118_flidarToDdsMachineMapping: service-instance=RPortPrototype6_DdsRequiredServiceInstance118_flidar
    RPortPrototype8_DdsRequiredServiceInstance129_ToDdsMachineMapping: service-instance=RPortPrototype8_DdsRequiredServiceInstance129
    RPortPrototype4_DdsRequiredServiceInstance139_ToDdsMachineMapping: service-instance=RPortPrototype4_DdsRequiredServiceInstance139
    video_encoded_frame_DdsProvidedServiceInstance49_ToDdsMachineMapping: service-instance=video_encoded_frame_DdsProvidedServiceInstance49
    RPortPrototype2_DdsRequiredServiceInstance158_ToDdsMachineMapping: service-instance=RPortPrototype2_DdsRequiredServiceInstance158
    RPortPrototype1_DdsRequiredServiceInstance159_ToDdsMachineMapping: service-instance=RPortPrototype1_DdsRequiredServiceInstance159
    RPortPrototype6_DdsRequiredServiceInstance160_ToDdsMachineMapping: service-instance=RPortPrototype6_DdsRequiredServiceInstance160
    RPortPrototype1_DdsRequiredServiceInstance156_ToDdsMachineMapping: service-instance=RPortPrototype1_DdsRequiredServiceInstance156
    RPortPrototype5_DdsRequiredServiceInstance160_ToDdsMachineMapping: service-instance=RPortPrototype5_DdsRequiredServiceInstance160
    RPortPrototype6_DdsRequiredServiceInstance161_ToDdsMachineMapping: service-instance=RPortPrototype6_DdsRequiredServiceInstance161
    RPortPrototype8_DdsRequiredServiceInstance162_ToDdsMachineMapping: service-instance=RPortPrototype8_DdsRequiredServiceInstance162
    RPortPrototype9_DdsRequiredServiceInstance163_ToDdsMachineMapping: service-instance=RPortPrototype9_DdsRequiredServiceInstance163
    RPortPrototype10_DdsRequiredServiceInstance164_ToDdsMachineMapping: service-instance=RPortPrototype10_DdsRequiredServiceInstance164
    RPortPrototype11_DdsRequiredServiceInstance171_ToDdsMachineMapping: service-instance=RPortPrototype11_DdsRequiredServiceInstance171
    RPortPrototype10_DdsRequiredServiceInstance172_ToDdsMachineMapping: service-instance=RPortPrototype10_DdsRequiredServiceInstance172
    RPortPrototype12_DdsRequiredServiceInstance173_ToDdsMachineMapping: service-instance=RPortPrototype12_DdsRequiredServiceInstance173
    RPortPrototype13_DdsRequiredServiceInstance174_ToDdsMachineMapping: service-instance=RPortPrototype13_DdsRequiredServiceInstance174
    RPortPrototype4_DdsRequiredServiceInstance175_ToDdsMachineMapping: service-instance=RPortPrototype4_DdsRequiredServiceInstance175
    RPortPrototype5_DdsRequiredServiceInstance176_ToDdsMachineMapping: service-instance=RPortPrototype5_DdsRequiredServiceInstance176
    RPortPrototype6_DdsRequiredServiceInstance177_ToDdsMachineMapping: service-instance=RPortPrototype6_DdsRequiredServiceInstance177
    lidarpointsfront_DdsRequiredServiceInstance178_ToDdsMachineMapping: service-instance=lidarpointsfront_DdsRequiredServiceInstance178
    lidarpointsleft_DdsRequiredServiceInstance179_ToDdsMachineMapping: service-instance=lidarpointsleft_DdsRequiredServiceInstance179
    lidarpointsright_DdsRequiredServiceInstance180_ToDdsMachineMapping: service-instance=lidarpointsright_DdsRequiredServiceInstance180
    radarpointsfront_DdsRequiredServiceInstance181_ToDdsMachineMapping: service-instance=radarpointsfront_DdsRequiredServiceInstance181
    radarpointsleft_DdsRequiredServiceInstance182_ToDdsMachineMapping: service-instance=radarpointsleft_DdsRequiredServiceInstance182
    radarpointsright_DdsRequiredServiceInstance183_ToDdsMachineMapping: service-instance=radarpointsright_DdsRequiredServiceInstance183
    ivwheelspeed_DdsRequiredServiceInstance184_ToDdsMachineMapping: service-instance=ivwheelspeed_DdsRequiredServiceInstance184
    tpimu_DdsRequiredServiceInstance185_ToDdsMachineMapping: service-instance=tpimu_DdsRequiredServiceInstance185
    ivwheelspeed_DdsRequiredServiceInstance186_ToDdsMachineMapping: service-instance=ivwheelspeed_DdsRequiredServiceInstance186
    lidarpointsright_DdsRequiredServiceInstance189_ToDdsMachineMapping: service-instance=lidarpointsright_DdsRequiredServiceInstance189
    radarpointsfront_DdsRequiredServiceInstance190_ToDdsMachineMapping: service-instance=radarpointsfront_DdsRequiredServiceInstance190
    radarpointsfront_DdsRequiredServiceInstance191_ToDdsMachineMapping: service-instance=radarpointsfront_DdsRequiredServiceInstance191
    radarpointsright_DdsRequiredServiceInstance192_ToDdsMachineMapping: service-instance=radarpointsright_DdsRequiredServiceInstance192
    radarpointsleft_DdsRequiredServiceInstance193_ToDdsMachineMapping: service-instance=radarpointsleft_DdsRequiredServiceInstance193
    radarpointsright_DdsRequiredServiceInstance194_ToDdsMachineMapping: service-instance=radarpointsright_DdsRequiredServiceInstance194
    radarpointsfront_DdsRequiredServiceInstance195_ToDdsMachineMapping: service-instance=radarpointsfront_DdsRequiredServiceInstance195
    radarpointsleft_DdsRequiredServiceInstance196_ToDdsMachineMapping: service-instance=radarpointsleft_DdsRequiredServiceInstance196
    lidarpointsfront_DdsRequiredServiceInstance197_ToDdsMachineMapping: service-instance=lidarpointsfront_DdsRequiredServiceInstance197
    lidarpointsleft_DdsRequiredServiceInstance198_ToDdsMachineMapping: service-instance=lidarpointsleft_DdsRequiredServiceInstance198
    lidarpointsright_DdsRequiredServiceInstance199_ToDdsMachineMapping: service-instance=lidarpointsright_DdsRequiredServiceInstance199
    lidarpointsfront_DdsRequiredServiceInstance200_ToDdsMachineMapping: service-instance=lidarpointsfront_DdsRequiredServiceInstance200
    lidarpointsleft_DdsRequiredServiceInstance201_ToDdsMachineMapping: service-instance=lidarpointsleft_DdsRequiredServiceInstance201
    lidarpointsright_DdsRequiredServiceInstance202_ToDdsMachineMapping: service-instance=lidarpointsright_DdsRequiredServiceInstance202
    RPortPrototype1_DdsRequiredServiceInstance200_ToDdsMachineMapping: service-instance=RPortPrototype1_DdsRequiredServiceInstance200
    RPortPrototype2_DdsRequiredServiceInstance201_ToDdsMachineMapping: service-instance=RPortPrototype2_DdsRequiredServiceInstance201
    RPortPrototype3_DdsRequiredServiceInstance202_ToDdsMachineMapping: service-instance=RPortPrototype3_DdsRequiredServiceInstance202
    RPortPrototype1_DdsRequiredServiceInstance211_ToDdsMachineMapping: service-instance=RPortPrototype1_DdsRequiredServiceInstance211
    RPortPrototype1_DdsRequiredServiceInstance163_ToDdsMachineMapping: service-instance=tplidarfront
    RPortPrototype2_DdsRequiredServiceInstance164_ToDdsMachineMapping: service-instance=RPortPrototype2_DdsRequiredServiceInstance164
    compressed_image_list_DdsProvidedServiceInstance41_ToDdsMachineMapping: service-instance=compressed_image_list_DdsProvidedServiceInstance41
    RPortPrototype1_DdsRequiredServiceInstance154_ToDdsMachineMapping: service-instance=RPortPrototype1_DdsRequiredServiceInstance154
    radarpackets_DdsProvidedServiceInstance42_ToDdsMachineMapping: service-instance=radarpackets_DdsProvidedServiceInstance42
    RPortPrototype2_DdsRequiredServiceInstance155_ToDdsMachineMapping: service-instance=RPortPrototype2_DdsRequiredServiceInstance155
    radarpackets_DdsProvidedServiceInstance43_ToDdsMachineMapping: service-instance=radarpackets_DdsProvidedServiceInstance43
    radarpackets_DdsProvidedServiceInstance44_ToDdsMachineMapping: service-instance=radarpackets_DdsProvidedServiceInstance44
    lidarpackets_DdsProvidedServiceInstance45_ToDdsMachineMapping: service-instance=lidarpackets_DdsProvidedServiceInstance45
    RPortPrototype5_DdsRequiredServiceInstance158_ToDdsMachineMapping: service-instance=RPortPrototype5_DdsRequiredServiceInstance158
    lidarpackets_DdsProvidedServiceInstance46_ToDdsMachineMapping: service-instance=lidarpackets_DdsProvidedServiceInstance46
    RPortPrototype6_DdsRequiredServiceInstance159_ToDdsMachineMapping: service-instance=RPortPrototype6_DdsRequiredServiceInstance159
    lidarpackets_DdsProvidedServiceInstance47_ToDdsMachineMapping: service-instance=lidarpackets_DdsProvidedServiceInstance47
    RPortPrototype7_DdsRequiredServiceInstance160_ToDdsMachineMapping: service-instance=RPortPrototype7_DdsRequiredServiceInstance160
    RPortPrototype2_DdsRequiredServiceInstance124_ToDdsMachineMapping: service-instance=RPortPrototype2_DdsRequiredServiceInstance124
    tpperception_vp_result_DdsProvidedServiceInstance38_ToDdsMachineMapping: service-instance=tpperception_vp_result_DdsProvidedServiceInstance38
    RPortPrototype1_DdsRequiredServiceInstance125_ToDdsMachineMapping: service-instance=RPortPrototype1_DdsRequiredServiceInstance125
    tpterrainmap_DdsProvidedServiceInstance31_ToDdsMachineMapping: service-instance=tpterrainmap_DdsProvidedServiceInstance31
    RPortPrototype2_DdsRequiredServiceInstance106_ToDdsMachineMapping: service-instance=RPortPrototype2_DdsRequiredServiceInstance106
    RPortPrototype3_DdsRequiredServiceInstance107_ToDdsMachineMapping: service-instance=RPortPrototype3_DdsRequiredServiceInstance107
    tppathplan_track_DdsProvidedServiceInstance32_ToDdsMachineMapping: service-instance=tppathplan_track_DdsProvidedServiceInstance32
    RPortPrototype2_DdsRequiredServiceInstance108_ToDdsMachineMapping: service-instance=requiredInstances/RPortPrototype2_DdsRequiredServiceInstance108
    tpfront_middle_lidar_points_DdsRequiredServiceInstance109_ToDdsMachineMapping: service-instance=tpfront_middle_lidar_points_DdsRequiredServiceInstance109
    RPortPrototype1_DdsRequiredServiceInstance110_ToDdsMachineMapping: service-instance=requiredInstances/RPortPrototype1_DdsRequiredServiceInstance110
    tppathplan_recv_DdsRequiredServiceInstance111_ToDdsMachineMapping: service-instance=tppathplan_recv_DdsRequiredServiceInstance111
    RPortPrototype2_DdsRequiredServiceInstance113_ToDdsMachineMapping: service-instance=RPortPrototype2_DdsRequiredServiceInstance113
    RPortPrototype1_DdsRequiredServiceInstance110_ToDdsMachineMapping: service-instance=requiredInstances/RPortPrototype1_DdsRequiredServiceInstance110
    RPortPrototype1_DdsRequiredServiceInstance111_ToDdsMachineMapping: service-instance=RPortPrototype1_DdsRequiredServiceInstance111
    RPortPrototype2_DdsRequiredServiceInstance112_ToDdsMachineMapping: service-instance=requiredInstances/RPortPrototype2_DdsRequiredServiceInstance112
package /HuaweiMDC/instance_manifests/requiredInstances
  112 x dds required service instance, all with qos-profile=default_qos.xml, domain-id=30, transport-plugins=SHM:
    RPortPrototype2_DdsRequiredServiceInstance14: service-interface-deployment=VehicleInfomationServiceInterface_DdsDeployment, dds-event-qos-props=EventVehicleInfoDdsDeployment, required-service-instance-id=20205
    RPortPrototype1_DdsRequiredServiceInstance33: service-interface-deployment=SensorLidarPointCloudServiceInterface_DdsDeployment, dds-event-qos-props=EventPointCloud2DdsDeployment, required-service-instance-id=20201
    RPortPrototype4_DdsRequiredServiceInstance39: service-interface-deployment=RemoteControlServiceInterface_DdsDeployment, dds-event-qos-props=EventRCAppRemoteCtlDdsDeployment, required-service-instance-id=20213
    RPortPrototype2_DdsRequiredServiceInstance49: service-interface-deployment=SensorLidarPointCloudServiceInterface_DdsDeployment, dds-event-qos-props=EventPointCloud2DdsDeployment, required-service-instance-id=20202
    RPortPrototype3_DdsRequiredServiceInstance50: service-interface-deployment=SensorLidarPointCloudServiceInterface_DdsDeployment, dds-event-qos-props=EventPointCloud2DdsDeployment, required-service-instance-id=20203
    RPortPrototype1_DdsRequiredServiceInstance40: service-interface-deployment=SensorWheelSpeedServiceInterface_DdsDeployment, dds-event-qos-props=EventWheelSpeedDdsDeployment, required-service-instance-id=20204
    RPortPrototype2_DdsRequiredServiceInstance41: service-interface-deployment=SensorImuServiceInterface_DdsDeployment, dds-event-qos-props=EventSensorImuDdsDeployment, required-service-instance-id=20223
    RPortPrototype1_DdsRequiredServiceInstance48: service-interface-deployment=BagStatusServiceInterface_DdsDeployment, dds-event-qos-props=EventBagStatusDdsDeployment, required-service-instance-id=20216
    RPortPrototype1_DdsRequiredServiceInstance53: service-interface-deployment=SensorLidarPointCloudServiceInterface_DdsDeployment, dds-event-qos-props=EventPointCloud2DdsDeployment, required-service-instance-id=20201
    RPortPrototype3_DdsRequiredServiceInstance97: service-interface-deployment=FaultDataServiceInterface_DdsDeployment, dds-event-qos-props=EventFaultDataDdsDeployment, required-service-instance-id=20220
    RPortPrototype2_DdsRequiredServiceInstance154: service-interface-deployment=RemoteControlServiceInterface_DdsDeployment, dds-event-qos-props=EventRCAppRemoteCtlDdsDeployment, required-service-instance-id=20213
    RPortPrototype2_DdsRequiredServiceInstance167: service-interface-deployment=FaultDataServiceInterface_DdsDeployment, dds-event-qos-props=EventFaultDataDdsDeployment, required-service-instance-id=20220
    RPortPrototype2_DdsRequiredServiceInstance105: service-interface-deployment=LocationDdsInterfaceDeployment, dds-event-qos-props=LocationEventDeployment, required-service-instance-id=20229
    RPortPrototype4_DdsRequiredServiceInstance107: service-interface-deployment=LocationDdsInterfaceDeployment, dds-event-qos-props=LocationEventDeployment, required-service-instance-id=20229
    RPortPrototype6_DdsRequiredServiceInstance109: service-interface-deployment=LocationDdsInterfaceDeployment, dds-event-qos-props=LocationEventDeployment, required-service-instance-id=20229
    RPortPrototype3_DdsRequiredServiceInstance110: service-interface-deployment=LocationDdsInterfaceDeployment, dds-event-qos-props=LocationEventDeployment, required-service-instance-id=20229
    RPortPrototype4_DdsRequiredServiceInstance111: service-interface-deployment=SensorGpsServiceInterface_DdsDeployment, dds-event-qos-props=EventGpsDdsDeployment, required-service-instance-id=20244
    RPortPrototype1_DdsRequiredServiceInstance107: service-interface-deployment=SensorLidarPointCloudServiceInterface_DdsDeployment, dds-event-qos-props=EventPointCloud2DdsDeployment, required-service-instance-id=20201
    RPortPrototype2_DdsRequiredServiceInstance108: service-interface-deployment=SensorLidarPointCloudServiceInterface_DdsDeployment, dds-event-qos-props=EventPointCloud2DdsDeployment, required-service-instance-id=20202
    RPortPrototype3_DdsRequiredServiceInstance109: service-interface-deployment=SensorLidarPointCloudServiceInterface_DdsDeployment, dds-event-qos-props=EventPointCloud2DdsDeployment, required-service-instance-id=20203
    RPortPrototype4_DdsRequiredServiceInstance110: service-interface-deployment=SensorImuServiceInterface_DdsDeployment, dds-event-qos-props=EventSensorImuDdsDeployment, required-service-instance-id=20223
    RPortPrototype5_DdsRequiredServiceInstance111_wspeed: service-interface-deployment=SensorWheelSpeedServiceInterface_DdsDeployment, dds-event-qos-props=EventWheelSpeedDdsDeployment, required-service-instance-id=20204
    RPortPrototype1_DdsRequiredServiceInstance107: service-interface-deployment=SensorLidarPointCloudServiceInterface_DdsDeployment, dds-event-qos-props=EventPointCloud2DdsDeployment, required-service-instance-id=20201
    RPortPrototype2_DdsRequiredServiceInstance108: service-interface-deployment=SensorLidarPointCloudServiceInterface_DdsDeployment, dds-event-qos-props=EventPointCloud2DdsDeployment, required-service-instance-id=20202
    RPortPrototype3_DdsRequiredServiceInstance109: service-interface-deployment=SensorLidarPointCloudServiceInterface_DdsDeployment, dds-event-qos-props=EventPointCloud2DdsDeployment, required-service-instance-id=20203
    RPortPrototype4_DdsRequiredServiceInstance110: service-interface-deployment=SensorImuServiceInterface_DdsDeployment, dds-event-qos-props=EventSensorImuDdsDeployment, required-service-instance-id=20223
    RPortPrototype5_DdsRequiredServiceInstance111: service-interface-deployment=LocationDdsInterfaceDeployment, dds-event-qos-props=LocationEventDeployment, required-service-instance-id=20229
    RPortPrototype6_DdsRequiredServiceInstance112: service-interface-deployment=SensorWheelSpeedServiceInterface_DdsDeployment, dds-event-qos-props=EventWheelSpeedDdsDeployment, required-service-instance-id=20204
    RPortPrototype7_DdsRequiredServiceInstance113: service-interface-deployment=LocationInfoDdsInterfaceDeployment, dds-event-qos-props=LocationInfoEventDeployment, required-service-instance-id=20206
    RPortPrototype8_DdsRequiredServiceInstance114: service-interface-deployment=LocationInfoDdsInterfaceDeployment, dds-event-qos-props=LocationInfoEventDeployment, required-service-instance-id=20209
    RPortPrototype3_DdsRequiredServiceInstance113: service-interface-deployment=SensorLidarPointCloudServiceInterface_DdsDeployment, dds-event-qos-props=EventPointCloud2DdsDeployment, required-service-instance-id=20203
    RPortPrototype5_DdsRequiredServiceInstance115: service-interface-deployment=LocationInfoDdsInterfaceDeployment, dds-event-qos-props=LocationInfoEventDeployment, required-service-instance-id=20218
    RPortPrototype10_DdsRequiredServiceInstance119: service-interface-deployment=SensorLidarPointCloudServiceInterface_DdsDeployment, dds-event-qos-props=EventPointCloud2DdsDeployment, required-service-instance-id=20201
    RPortPrototype12_DdsRequiredServiceInstance120: service-interface-deployment=SensorLidarPointCloudServiceInterface_DdsDeployment, dds-event-qos-props=EventPointCloud2DdsDeployment, required-service-instance-id=20202
    RPortPrototype13_DdsRequiredServiceInstance121: service-interface-deployment=SensorLidarPointCloudServiceInterface_DdsDeployment, dds-event-qos-props=EventPointCloud2DdsDeployment, required-service-instance-id=20203
    RPortPrototype14_DdsRequiredServiceInstance122: service-interface-deployment=LocationInfoDdsInterfaceDeployment, dds-event-qos-props=LocationInfoEventDeployment, required-service-instance-id=20218
    RPortPrototype3_DdsRequiredServiceInstance115: service-interface-deployment=Object3dArrayDdsInterfaceDeployment, dds-event-qos-props=Object3dArrayEventDeployment, required-service-instance-id=20222
    RPortPrototype4_DdsRequiredServiceInstance116_flidar: service-interface-deployment=SensorLidarPointCloudServiceInterface_DdsDeployment, dds-event-qos-props=EventPointCloud2DdsDeployment, required-service-instance-id=20201
    RPortPrototype6_DdsRequiredServiceInstance118_flidar: service-interface-deployment=SensorLidarPointCloudServiceInterface_DdsDeployment, dds-event-qos-props=EventPointCloud2DdsDeployment, required-service-instance-id=20203
    RPortPrototype7_DdsRequiredServiceInstance119_fradar: service-interface-deployment=RadarPointCloudServiceInterface_DdsDeployment, dds-event-qos-props=EventRadarPointCloudDdsDeployment, required-service-instance-id=20224
    RPortPrototype8_DdsRequiredServiceInstance120_lradar: service-interface-deployment=RadarPointCloudServiceInterface_DdsDeployment, dds-event-qos-props=EventRadarPointCloudDdsDeployment, required-service-instance-id=20225
    RPortPrototype9_DdsRequiredServiceInstance121: service-interface-deployment=RadarPointCloudServiceInterface_DdsDeployment, dds-event-qos-props=EventRadarPointCloudDdsDeployment, required-service-instance-id=20226
    RPortPrototype10_DdsRequiredServiceInstance122: service-interface-deployment=LocationInfoDdsInterfaceDeployment, dds-event-qos-props=LocationInfoEventDeployment, required-service-instance-id=20218
    RPortPrototype5_DdsRequiredServiceInstance117: service-interface-deployment=FusionObjectArrayDdsInterfaceDeployment, dds-event-qos-props=FusionObjectArrayEventDeployment, required-service-instance-id=20228
    RPortPrototype8_DdsRequiredServiceInstance129: service-interface-deployment=LocationInfoDdsInterfaceDeployment, dds-event-qos-props=LocationInfoEventDeployment, required-service-instance-id=20218
    RPortPrototype3_DdsRequiredServiceInstance135: service-interface-deployment=LocationInfoDdsInterfaceDeployment, dds-event-qos-props=LocationInfoEventDeployment, required-service-instance-id=20218
    RPortPrototype4_DdsRequiredServiceInstance139: service-interface-deployment=FaultDataServiceInterface_DdsDeployment, dds-event-qos-props=EventFaultDataDdsDeployment, required-service-instance-id=20220
    RPortPrototype2_DdsRequiredServiceInstance158: service-interface-deployment=SensorImageServiceInterface_DdsDeployment, dds-event-qos-props=EventSensorImageDdsDeployment, required-service-instance-id=20247
    RPortPrototype1_DdsRequiredServiceInstance159: service-interface-deployment=SensorImageServiceInterface_DdsDeployment, dds-event-qos-props=EventSensorImageDdsDeployment, required-service-instance-id=20247
    RPortPrototype6_DdsRequiredServiceInstance160: service-interface-deployment=SensorImageServiceInterface_DdsDeployment, dds-event-qos-props=EventSensorImageDdsDeployment, required-service-instance-id=20247
    RPortPrototype1_DdsRequiredServiceInstance156: service-interface-deployment=RemoteControlServiceInterface_DdsDeployment, dds-event-qos-props=EventRCAppRemoteCtlDdsDeployment, required-service-instance-id=20213
    RPortPrototype5_DdsRequiredServiceInstance160: service-interface-deployment=BodyCommandServiceInterface_DdsDeployment, dds-event-qos-props=EventVehicleActControlDdsDeployment, required-service-instance-id=20211
    RPortPrototype6_DdsRequiredServiceInstance161: service-interface-deployment=LocationInfoDdsInterfaceDeployment, dds-event-qos-props=LocationInfoEventDeployment, required-service-instance-id=20218
    RPortPrototype8_DdsRequiredServiceInstance162: service-interface-deployment=SensorGpsServiceInterface_DdsDeployment, dds-event-qos-props=EventGpsDdsDeployment, required-service-instance-id=20244
    RPortPrototype9_DdsRequiredServiceInstance163: service-interface-deployment=VehicleInfomationServiceInterface_DdsDeployment, dds-event-qos-props=EventVehicleInfoDdsDeployment, required-service-instance-id=20205
    RPortPrototype10_DdsRequiredServiceInstance164: service-interface-deployment=FaultDataServiceInterface_DdsDeployment, dds-event-qos-props=EventFaultDataDdsDeployment, required-service-instance-id=20220
    RPortPrototype11_DdsRequiredServiceInstance171: service-interface-deployment=SensorImageListServiceInterface_DdsDeployment, dds-event-qos-props=EventImageListDdsDeployment, required-service-instance-id=20200
    RPortPrototype10_DdsRequiredServiceInstance172: service-interface-deployment=SensorLidarPointCloudServiceInterface_DdsDeployment, dds-event-qos-props=EventPointCloud2DdsDeployment, required-service-instance-id=20201
    RPortPrototype12_DdsRequiredServiceInstance173: service-interface-deployment=SensorLidarPointCloudServiceInterface_DdsDeployment, dds-event-qos-props=EventPointCloud2DdsDeployment, required-service-instance-id=20202
    RPortPrototype13_DdsRequiredServiceInstance174: service-interface-deployment=SensorLidarPointCloudServiceInterface_DdsDeployment, dds-event-qos-props=EventPointCloud2DdsDeployment, required-service-instance-id=20203
    RPortPrototype4_DdsRequiredServiceInstance175: service-interface-deployment=SensorLidarPointCloudServiceInterface_DdsDeployment, dds-event-qos-props=EventPointCloud2DdsDeployment, required-service-instance-id=20201
    RPortPrototype5_DdsRequiredServiceInstance176: service-interface-deployment=SensorLidarPointCloudServiceInterface_DdsDeployment, dds-event-qos-props=EventPointCloud2DdsDeployment, required-service-instance-id=20202
    RPortPrototype6_DdsRequiredServiceInstance177: service-interface-deployment=SensorLidarPointCloudServiceInterface_DdsDeployment, dds-event-qos-props=EventPointCloud2DdsDeployment, required-service-instance-id=20203
    lidarpointsfront_DdsRequiredServiceInstance178: service-interface-deployment=SensorLidarPointCloudServiceInterface_DdsDeployment, dds-event-qos-props=EventPointCloud2DdsDeployment, required-service-instance-id=20201
    lidarpointsleft_DdsRequiredServiceInstance179: service-interface-deployment=SensorLidarPointCloudServiceInterface_DdsDeployment, dds-event-qos-props=EventPointCloud2DdsDeployment, required-service-instance-id=20202
    lidarpointsright_DdsRequiredServiceInstance180: service-interface-deployment=SensorLidarPointCloudServiceInterface_DdsDeployment, dds-event-qos-props=EventPointCloud2DdsDeployment, required-service-instance-id=20203
    radarpointsfront_DdsRequiredServiceInstance181: service-interface-deployment=RadarPointCloudServiceInterface_DdsDeployment, dds-event-qos-props=EventRadarPointCloudDdsDeployment, required-service-instance-id=20225
    radarpointsleft_DdsRequiredServiceInstance182: service-interface-deployment=RadarPointCloudServiceInterface_DdsDeployment, dds-event-qos-props=EventRadarPointCloudDdsDeployment, required-service-instance-id=20226
    radarpointsright_DdsRequiredServiceInstance183: service-interface-deployment=RadarPointCloudServiceInterface_DdsDeployment, dds-event-qos-props=EventRadarPointCloudDdsDeployment, required-service-instance-id=20224
    ivwheelspeed_DdsRequiredServiceInstance184: service-interface-deployment=SensorWheelSpeedServiceInterface_DdsDeployment, dds-event-qos-props=EventWheelSpeedDdsDeployment, required-service-instance-id=20204
    tpimu_DdsRequiredServiceInstance185: service-interface-deployment=LocationDdsInterfaceDeployment, dds-event-qos-props=LocationEventDeployment, required-service-instance-id=20229
    ivwheelspeed_DdsRequiredServiceInstance186: service-interface-deployment=SensorWheelSpeedServiceInterface_DdsDeployment, dds-event-qos-props=EventWheelSpeedDdsDeployment, required-service-instance-id=20204
    lidarpointsright_DdsRequiredServiceInstance189: service-interface-deployment=SensorLidarPointCloudServiceInterface_DdsDeployment, dds-event-qos-props=EventPointCloud2DdsDeployment, required-service-instance-id=20203
    radarpointsfront_DdsRequiredServiceInstance190: service-interface-deployment=RadarPointCloudServiceInterface_DdsDeployment, dds-event-qos-props=EventRadarPointCloudDdsDeployment, required-service-instance-id=20224
    radarpointsfront_DdsRequiredServiceInstance191: service-interface-deployment=RadarPointCloudServiceInterface_DdsDeployment, dds-event-qos-props=EventRadarPointCloudDdsDeployment, required-service-instance-id=20225
    radarpointsright_DdsRequiredServiceInstance192: service-interface-deployment=RadarPointCloudServiceInterface_DdsDeployment, dds-event-qos-props=EventRadarPointCloudDdsDeployment, required-service-instance-id=20224
    radarpointsleft_DdsRequiredServiceInstance193: service-interface-deployment=RadarPointCloudServiceInterface_DdsDeployment, dds-event-qos-props=EventRadarPointCloudDdsDeployment, required-service-instance-id=20226
    radarpointsright_DdsRequiredServiceInstance194: service-interface-deployment=RadarPointCloudServiceInterface_DdsDeployment, dds-event-qos-props=EventRadarPointCloudDdsDeployment, required-service-instance-id=20224
    radarpointsfront_DdsRequiredServiceInstance195: service-interface-deployment=RadarPointCloudServiceInterface_DdsDeployment, dds-event-qos-props=EventRadarPointCloudDdsDeployment, required-service-instance-id=20225
    radarpointsleft_DdsRequiredServiceInstance196: service-interface-deployment=RadarPointCloudServiceInterface_DdsDeployment, dds-event-qos-props=EventRadarPointCloudDdsDeployment, required-service-instance-id=20226
    lidarpointsfront_DdsRequiredServiceInstance197: service-interface-deployment=SensorLidarPointCloudServiceInterface_DdsDeployment, dds-event-qos-props=EventPointCloud2DdsDeployment, required-service-instance-id=20201
    lidarpointsleft_DdsRequiredServiceInstance198: service-interface-deployment=SensorLidarPointCloudServiceInterface_DdsDeployment, dds-event-qos-props=EventPointCloud2DdsDeployment, required-service-instance-id=20202
    lidarpointsright_DdsRequiredServiceInstance199: service-interface-deployment=SensorLidarPointCloudServiceInterface_DdsDeployment, dds-event-qos-props=EventPointCloud2DdsDeployment, required-service-instance-id=20203
    lidarpointsfront_DdsRequiredServiceInstance200: service-interface-deployment=SensorLidarPointCloudServiceInterface_DdsDeployment, dds-event-qos-props=EventPointCloud2DdsDeployment, required-service-instance-id=20201
    lidarpointsleft_DdsRequiredServiceInstance201: service-interface-deployment=SensorLidarPointCloudServiceInterface_DdsDeployment, dds-event-qos-props=EventPointCloud2DdsDeployment, required-service-instance-id=20202
    lidarpointsright_DdsRequiredServiceInstance202: service-interface-deployment=SensorLidarPointCloudServiceInterface_DdsDeployment, dds-event-qos-props=EventPointCloud2DdsDeployment, required-service-instance-id=20203
    RPortPrototype1_DdsRequiredServiceInstance200: service-interface-deployment=VehicleInfomationServiceInterface_DdsDeployment, dds-event-qos-props=EventVehicleInfoDdsDeployment, required-service-instance-id=20205
    RPortPrototype2_DdsRequiredServiceInstance201: service-interface-deployment=VehicleInfomationServiceInterface_DdsDeployment, dds-event-qos-props=EventVehicleInfoDdsDeployment, required-service-instance-id=20205
    RPortPrototype3_DdsRequiredServiceInstance202: service-interface-deployment=VehicleInfomationServiceInterface_DdsDeployment, dds-event-qos-props=EventVehicleInfoDdsDeployment, required-service-instance-id=20205
    RPortPrototype1_DdsRequiredServiceInstance211: service-interface-deployment=Object3dArrayDdsInterfaceDeployment, dds-event-qos-props=Object3dArrayEventDeployment, required-service-instance-id=20222
    tplidarfront: service-interface-deployment=SensorLidarPointCloudServiceInterface_DdsDeployment, dds-event-qos-props=EventPointCloud2DdsDeployment, required-service-instance-id=20201
    RPortPrototype2_DdsRequiredServiceInstance164: service-interface-deployment=SensorImageListServiceInterface_DdsDeployment, dds-event-qos-props=EventImageListDdsDeployment, required-service-instance-id=20200
    RPortPrototype1_DdsRequiredServiceInstance154: service-interface-deployment=SensorCompressedImageListServiceInterface_DdsDeployment, dds-event-qos-props=EventCompressedImageListDdsDeployment, required-service-instance-id=20210
    RPortPrototype2_DdsRequiredServiceInstance155: service-interface-deployment=SensorRadarPacketServiceInterface_DdsDeployment, dds-event-qos-props=EventSensorRadarPacketDdsDeployment, required-service-instance-id=20219
    RPortPrototype3_DdsRequiredServiceInstance156: service-interface-deployment=SensorRadarPacketServiceInterface_DdsDeployment, dds-event-qos-props=EventSensorRadarPacketDdsDeployment, required-service-instance-id=20227
    RPortPrototype4_DdsRequiredServiceInstance157: service-interface-deployment=SensorRadarPacketServiceInterface_DdsDeployment, dds-event-qos-props=EventSensorRadarPacketDdsDeployment, required-service-instance-id=20230
    RPortPrototype5_DdsRequiredServiceInstance158: service-interface-deployment=SensorLidarPacketServiceInterface_DdsDeployment, dds-event-qos-props=EventLidarPacketDdsDeployment, required-service-instance-id=20231
    RPortPrototype6_DdsRequiredServiceInstance159: service-interface-deployment=SensorLidarPacketServiceInterface_DdsDeployment, dds-event-qos-props=EventLidarPacketDdsDeployment, required-service-instance-id=20232
    RPortPrototype7_DdsRequiredServiceInstance160: service-interface-deployment=SensorLidarPacketServiceInterface_DdsDeployment, dds-event-qos-props=EventLidarPacketDdsDeployment, required-service-instance-id=20234
    RPortPrototype2_DdsRequiredServiceInstance124: service-interface-deployment=SensorImageListServiceInterface_DdsDeployment, dds-event-qos-props=EventImageListDdsDeployment, required-service-instance-id=20200
    RPortPrototype1_DdsRequiredServiceInstance125: service-interface-deployment=VisionSegmentServiceInterface_DdsDeployment, dds-event-qos-props=EventVisionSegmentDdsDeployment, required-service-instance-id=20207
    RPortPrototype2_DdsRequiredServiceInstance106: service-interface-deployment=PerceptionStaticEnvServiceInterface_DdsDeployment, dds-event-qos-props=EventPerceptionStaticEnvDdsDeployment, required-service-instance-id=20208
    RPortPrototype3_DdsRequiredServiceInstance107: service-interface-deployment=FusionObjectArrayDdsInterfaceDeployment, dds-event-qos-props=FusionObjectArrayEventDeployment, required-service-instance-id=20228
    RPortPrototype2_DdsRequiredServiceInstance108: service-interface-deployment=PlanningResultDdsInterfaceDeployment, dds-event-qos-props=PlanningResultEventDeployment, required-service-instance-id=20212
    tpfront_middle_lidar_points_DdsRequiredServiceInstance109: service-interface-deployment=SensorLidarPointCloudServiceInterface_DdsDeployment, dds-event-qos-props=EventPointCloud2DdsDeployment, required-service-instance-id=20201
    RPortPrototype1_DdsRequiredServiceInstance110: service-interface-deployment=RadarPointCloudServiceInterface_DdsDeployment, dds-event-qos-props=EventRadarPointCloudDdsDeployment, required-service-instance-id=20225
    tppathplan_recv_DdsRequiredServiceInstance111: service-interface-deployment=PlanningResultDdsInterfaceDeployment, dds-event-qos-props=PlanningResultEventDeployment, required-service-instance-id=20212
    RPortPrototype2_DdsRequiredServiceInstance112: service-interface-deployment=LocationInfoDdsInterfaceDeployment, dds-event-qos-props=LocationInfoEventDeployment, required-service-instance-id=20218
    RPortPrototype2_DdsRequiredServiceInstance113: service-interface-deployment=LocationInfoDdsInterfaceDeployment, dds-event-qos-props=LocationInfoEventDeployment, required-service-instance-id=20218
    RPortPrototype1_DdsRequiredServiceInstance110: service-interface-deployment=SensorLidarPointCloudServiceInterface_DdsDeployment, dds-event-qos-props=EventPointCloud2DdsDeployment, required-service-instance-id=20201
    RPortPrototype1_DdsRequiredServiceInstance111: service-interface-deployment=SensorLidarPointCloudServiceInterface_DdsDeployment, dds-event-qos-props=EventPointCloud2DdsDeployment, required-service-instance-id=20202
    RPortPrototype2_DdsRequiredServiceInstance112: service-interface-deployment=VehicleInfomationServiceInterface_DdsDeployment, dds-event-qos-props=EventVehicleInfoDdsDeployment, required-service-instance-id=20205
